## package/batocera/ports/droidports/Config.in
```kconfig
config BR2_PACKAGE_DROIDPORTS
	bool "droidports"
	select BR2_PACKAGE_OPENAL
	select BR2_PACKAGE_LIBZLIB
	select BR2_PACKAGE_LIBZIP
	select BR2_PACKAGE_BZIP2
	select BR2_PACKAGE_LIBPNG
	select BR2_PACKAGE_FREETYPE
	select BR2_PACKAGE_SDL2
	depends on BR2_INSTALL_LIBSTDCPP
	help
	  A repository for experimenting with elf loading and in-place patching of android native libraries on non-android operating systems.

	  https://github.com/JohnnyonFlame/droidports

comment "BR2_PACKAGE_DROIDPORTS needs a toolchain w/ C++"
	depends on !BR2_INSTALL_LIBSTDCPP
```

## package/batocera/ports/f2bgl/Config.in
```kconfig
config BR2_PACKAGE_F2BGL
	bool "f2bgl"
	depends on BR2_INSTALL_LIBSTDCPP
	select BR2_PACKAGE_SDL2
	select BR2_PACKAGE_SDL2_MIXER

	help
	  Fade To Black.

	  https://github.com/cyxx/f2bgl

comment "BR2_PACKAGE_f2bgl needs a toolchain w/ C++"
	depends on !BR2_INSTALL_LIBSTDCPP
```

## package/batocera/ports/fallout1/Config.in
```kconfig
config BR2_PACKAGE_FALLOUT1
	bool "fallout1"
	select BR2_PACKAGE_SDL2
	select BR2_PACKAGE_SDL2_IMAGE
	select BR2_PACKAGE_SDL2_MIXER
	select BR2_PACKAGE_SDL2_NET
	select BR2_PACKAGE_SDL2_TTF

	depends on BR2_INSTALL_LIBSTDCPP
	help
	  Open source Fallout
```

## package/batocera/ports/hcl/Config.in
```kconfig
config BR2_PACKAGE_HCL
	bool "hcl"
	depends on BR2_INSTALL_LIBSTDCPP
	select BR2_PACKAGE_SDL2
	select BR2_PACKAGE_SDL2_MIXER

	help
	  Hydra Castle Labyrinth is a platform game with some old
	  school action. Its also reminiscent of games of the 16bit era.

	  http://ptitseb.github.io/hydracastlelabyrinth

comment "BR2_PACKAGE_HCL needs a toolchain w/ C++"
	depends on !BR2_INSTALL_LIBSTDCPP
```

## package/batocera/ports/hode/Config.in
```kconfig
config BR2_PACKAGE_HODE
	bool "hode"
	depends on BR2_INSTALL_LIBSTDCPP
	select BR2_PACKAGE_SDL2
	select BR2_PACKAGE_SDL2_MIXER

	help
	  Heart of Darkness

	  https://github.com/usineur/hode

comment "BR2_PACKAGE_HODE needs a toolchain w/ C++"
	depends on !BR2_INSTALL_LIBSTDCPP
```

## package/batocera/ports/ionfury/Config.in
```kconfig
config BR2_PACKAGE_IONFURY
	bool "ionfury"
    depends on BR2_INSTALL_LIBSTDCPP
    select BR2_PACKAGE_SDL2
    select BR2_PACKAGE_FLAC
    select BR2_PACKAGE_LIBVPX
	help
	  Ion Fury is a 2019 cyberpunk first-person shooter video game developed by Voidpoint and published by 3D Realms

	  https://voidpoint.io/terminx/eduke32
```

## package/batocera/ports/nblood/Config.in
```kconfig
config BR2_PACKAGE_NBLOOD
	bool "nblood"
	depends on BR2_INSTALL_LIBSTDCPP
	select BR2_PACKAGE_SDL2
	select BR2_PACKAGE_FLAC
	select BR2_PACKAGE_LIBVPX

	help
	  Reverse-engineered ports of Build games using EDuke32 engine technology and development principles (NBlood/Rednukem/PCExhumed)

	  https://lerppu.net/wannabethesis/
```

## package/batocera/ports/nukem2/Config.in
```kconfig
config BR2_PACKAGE_NUKEM2
	bool "nukem2"
	depends on BR2_INSTALL_LIBSTDCPP
	select BR2_PACKAGE_SDL2
	select BR2_PACKAGE_SDL2_MIXER

	help
	  A modern re-implementation of the classic DOS
	  game Duke Nukem II.

	  https://github.com/lethal-guitar/RigelEngine

comment "BR2_PACKAGE_NUKEM2 needs a toolchain w/ C++"
	depends on !BR2_INSTALL_LIBSTDCPP
```

## package/batocera/ports/omf2097/Config.in
```kconfig
config BR2_PACKAGE_OMF2097
	bool "OMF2097"
	depends on BR2_INSTALL_LIBSTDCPP
	select BR2_PACKAGE_ENET
	select BR2_PACKAGE_LIBCONFUSE
	select BR2_PACKAGE_SDL2
	select BR2_PACKAGE_SDL2_MIXER

	help
	  One Must Fall 2097 Remake

	  www.openomf.org

comment "BR2_PACKAGE_OMF2097 needs a toolchain w/ C++"
	depends on !BR2_INSTALL_LIBSTDCPP
```

## package/batocera/ports/openclaw/Config.in
```kconfig
config BR2_PACKAGE_OPENCLAW
	bool "openclaw"
	depends on BR2_INSTALL_LIBSTDCPP
	select BR2_PACKAGE_SDL2
	select BR2_PACKAGE_SDL2_MIXER
	select BR2_PACKAGE_SDL2_IMAGE
	select BR2_PACKAGE_SDL2_TTF
	select BR2_PACKAGE_SDL2_GFX

	help
	  Reimplementation of Captain Claw (1997) platformer.

	  https://github.com/pjasicek/OpenClaw

comment "BR2_PACKAGE_OPENCLAW needs a toolchain w/ C++"
	depends on !BR2_INSTALL_LIBSTDCPP
```

## package/batocera/ports/openjazz/Config.in
```kconfig
config BR2_PACKAGE_OPENJAZZ
	bool "OPENJAZZ"
	depends on BR2_INSTALL_LIBSTDCPP
	select BR2_PACKAGE_SDL
	help
	  OPENJAZZ
	  is a free, open-source version of the classic Jazz Jackrabbit games.

	  https://github.com/AlisterT/openjazz
```

## package/batocera/ports/openjk/Config.in
```kconfig
config BR2_PACKAGE_OPENJK
	bool "openjk"
	depends on BR2_INSTALL_LIBSTDCPP
	select BR2_PACKAGE_LIBJPEG
	select BR2_PACKAGE_LIBPNG
	select BR2_PACKAGE_SDL2
	select BR2_PACKAGE_ZLIB

	help
	  Community effort to maintain and improve
	  - Jedi Academy (SP & MP)
	  - Jedi Outcast (SP only)
	  Released by Raven Software

	  https://github.com/JACoders/OpenJK
```

## package/batocera/ports/openlara/Config.in
```kconfig
config BR2_PACKAGE_OPENLARA
	bool "openlara"
	select BR2_PACKAGE_OPENAL
	select BR2_PACKAGE_SDL2
	select BR2_PACKAGE_SDL2_MIXER
	select BR2_PACKAGE_ZLIB

	help
	  Classic Tomb Raider open-source engine

	  https://github.com/XProger/OpenLara
```

## package/batocera/ports/opentyrian2000/Config.in
```kconfig
config BR2_PACKAGE_OPENTYRIAN2000
	bool "opentyrian2000"
	depends on BR2_PACKAGE_SDL2
	depends on BR2_PACKAGE_SDL2_MIXER
	depends on BR2_PACKAGE_SDL2_TTF
	depends on BR2_PACKAGE_OPENAL
	depends on BR2_INSTALL_LIBSTDCPP
	help
	  OpenTyrian2000 is an open-source port of the DOS game Tyrian. It is a fork of
	  OpenTyrian, with the end goal being to replicate the experience of Tyrian 2000
	  as closely as possible

comment "BR2_PACKAGE_OPENTYRIAN2000 needs a toolchain w/ C++"
	depends on !BR2_INSTALL_LIBSTDCPP
```

## package/batocera/ports/prototype/Config.in
```kconfig
config BR2_PACKAGE_PROTOTYPE
	bool "Prototype"
	depends on BR2_PACKAGE_SDL2
	depends on BR2_PACKAGE_SDL2_MIXER
	depends on BR2_PACKAGE_SDL2_IMAGE
	select BR2_PACKAGE_GL4ES if !BR2_PACKAGE_BATOCERA_XORG
	select BR2_PACKAGE_GLU   if !BR2_PACKAGE_BATOCERA_XORG
	depends on BR2_INSTALL_LIBSTDCPP
	help
	 This is ProtoType, an RType remake from Dark Castle Software.

	  http://ptitseb.github.io/prototype

comment "BR2_PACKAGE_PROTOTYPE needs a toolchain w/ C++"
	depends on !BR2_INSTALL_LIBSTDCPP
```

## package/batocera/ports/quake/quake2/Config.in
```kconfig
config BR2_PACKAGE_QUAKE2
	bool "quake2"
	select BR2_PACKAGE_YQUAKE2_CLIENT
	select BR2_PACKAGE_YQUAKE2_CTF
	select BR2_PACKAGE_YQUAKE2_REFVK
	select BR2_PACKAGE_YQUAKE2_ROGUE
	select BR2_PACKAGE_YQUAKE2_XATRIX
	select BR2_PACKAGE_YQUAKE2_ZAERO

	help
	  Yamagi Quake II is an enhanced client for id Software's
	  Quake II

	  https://github.com/yquake2/yquake2

source "$BR2_EXTERNAL_BATOCERA_PATH/package/batocera/ports/quake/quake2/yquake2-client/Config.in"
source "$BR2_EXTERNAL_BATOCERA_PATH/package/batocera/ports/quake/quake2/yquake2-ctf/Config.in"
source "$BR2_EXTERNAL_BATOCERA_PATH/package/batocera/ports/quake/quake2/yquake2-refvk/Config.in"
source "$BR2_EXTERNAL_BATOCERA_PATH/package/batocera/ports/quake/quake2/yquake2-rogue/Config.in"
source "$BR2_EXTERNAL_BATOCERA_PATH/package/batocera/ports/quake/quake2/yquake2-xatrix/Config.in"
source "$BR2_EXTERNAL_BATOCERA_PATH/package/batocera/ports/quake/quake2/yquake2-zaero/Config.in"
```

## package/batocera/ports/quake/quake2/yquake2-refvk/Config.in
```kconfig
config BR2_PACKAGE_YQUAKE2_REFVK
	bool "yquake2-refvk"

	help
	  Optional Vulkan renderer lib for Yamagi Quake II

	  https://github.com/yquake2
```

## package/batocera/ports/quake/quake3/Config.in
```kconfig
config BR2_PACKAGE_QUAKE3
    bool "quake3"
    select BR2_PACKAGE_SDL2
    select BR2_PACKAGE_SDL2_NET
    help
      The ioquake3 community effort to continue supporting/developing id's Quake III Arena.
      
      https://www.ioquake3.org/
```

## package/batocera/ports/quake/quakespasm/Config.in
```kconfig
config BR2_PACKAGE_QUAKESPASM
	bool "quakespasm"
	depends on BR2_INSTALL_LIBSTDCPP
	select BR2_PACKAGE_SDL2
	select BR2_PACKAGE_SDL2_IMAGE

	help
	  QuakeSpasm is a *Nix friendly Quake Engine based on the SDL port of the popular FitzQuake.

	  http://quakespasm.sourceforge.net/
```

## package/batocera/ports/quake/vkquake/Config.in
```kconfig
config BR2_PACKAGE_VKQUAKE
	bool "vkquake"
	depends on BR2_INSTALL_LIBSTDCPP
	select BR2_PACKAGE_SDL2
	select BR2_PACKAGE_SDL2_IMAGE

	help
	  Vulkan Quake port based on QuakeSpasm/

	  https://github.com/Novum/vkQuake
```

## package/batocera/ports/quake/xatrix/Config.in
```kconfig
config BR2_PACKAGE_XATRIX
	bool "Quake2_Reckon"
	depends on BR2_INSTALL_LIBSTDCPP
	select BR2_PACKAGE_SDL2
	select BR2_PACKAGE_SDL2_MIXER

	help
	  The Reckoning for Yamagi Quake II

	  https://github.com/yquake2/yquake2

comment "BR2_PACKAGE_XATRIX needs a toolchain w/ C++"
	depends on !BR2_INSTALL_LIBSTDCPP
```

## package/batocera/ports/quake/yquake2/Config.in
```kconfig
config BR2_PACKAGE_YQUAKE2
	bool "yquake2"
	depends on BR2_PACKAGE_BATOCERA_SDL2 || BR2_PACKAGE_BATOCERA_SDL3

	  help
	  Quake II port, focused on authenticity to the original.

	  https://www.yamagi.org/quake2/
```

## package/batocera/ports/quake/yquake2/yquake2-refvk/Config.in
```kconfig
config BR2_PACKAGE_YQUAKE2_REFVK
	bool "yquake2-refvk"
	depends on BR2_PACKAGE_YQUAKE2

	help
	  Optional Vulkan renderer lib for Yamagi Quake II

	  https://github.com/yquake2
```

## package/batocera/ports/quake/yquake2_refvk/Config.in
```kconfig
config BR2_PACKAGE_YQUAKE2_REFVK
	bool "yquake2_vulkan"
	depends on BR2_INSTALL_LIBSTDCPP

	help
	  Optional Vulkan renderer lib for Yamagi Quake II

	  https://github.com/yquake2

comment "BR2_PACKAGE_YQUAKE2_REFVK needs a toolchain w/ C++"
	depends on !BR2_INSTALL_LIBSTDCPP
```

## package/batocera/ports/quake/yrogue/Config.in
```kconfig
config BR2_PACKAGE_YROGUE
	bool "Quake2_GZero"
	depends on BR2_INSTALL_LIBSTDCPP
	select BR2_PACKAGE_SDL2
	select BR2_PACKAGE_SDL2_MIXER

	help
	  Ground Zero for Yamagi Quake II

	  https://github.com/yquake2/rogue

comment "BR2_PACKAGE_YROGUE needs a toolchain w/ C++"
	depends on !BR2_INSTALL_LIBSTDCPP
```
