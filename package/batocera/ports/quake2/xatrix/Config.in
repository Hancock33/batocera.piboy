## package/batocera/ports/quake2/xatrix/Config.in
```kconfig
config BR2_PACKAGE_XATRIX
	bool "Quake2_Reckon"
	select BR2_PACKAGE_SDL2
	select BR2_PACKAGE_SDL2_MIXER
	depends on BR2_INSTALL_LIBSTDCPP
	help
	  The Reckoning for Yamagi Quake II

	  https://github.com/yquake2/yquake2

comment "BR2_PACKAGE_XATRIX needs a toolchain w/ C++"
	depends on !BR2_INSTALL_LIBSTDCPP
```

## package/batocera/ports/quake2/yquake2/Config.in
```kconfig
config BR2_PACKAGE_YQUAKE2
	bool "yqauke2"
	select BR2_PACKAGE_SDL2
	select BR2_PACKAGE_SDL2_MIXER
	depends on BR2_INSTALL_LIBSTDCPP
	help
	  Yamagi Quake II is an enhanced client for id Software's Quake II 

	  https://github.com/yquake2/yquake2

comment "BR2_PACKAGE_YQUAKE2 needs a toolchain w/ C++"
	depends on !BR2_INSTALL_LIBSTDCPP
```

## package/batocera/ports/quake2/yrogue/Config.in
```kconfig
config BR2_PACKAGE_YROGUE
	bool "Quake2_GZero"
	select BR2_PACKAGE_SDL2
	select BR2_PACKAGE_SDL2_MIXER
	depends on BR2_INSTALL_LIBSTDCPP
	help
	  Ground Zero for Yamagi Quake II

	  https://github.com/yquake2/rogue

comment "BR2_PACKAGE_YROGUE needs a toolchain w/ C++"
	depends on !BR2_INSTALL_LIBSTDCPP
```

## package/batocera/ports/raptorcots/Config.in
```kconfig
config BR2_PACKAGE_RAPTORCOTS
	bool "raptorcots"
	depends on BR2_INSTALL_LIBSTDCPP
	select BR2_PACKAGE_SDL2
	select BR2_PACKAGE_SDL2_MIXER
	select BR2_PACKAGE_SDL2_TTF

	help
	  Reversed-engineered source port from
	  Raptor Call Of The Shadows

	  https://github.com/skynettx/raptor

comment "BR2_PACKAGE_NUKEM2 needs a toolchain w/ C++"
	depends on !BR2_INSTALL_LIBSTDCPP
```

## package/batocera/ports/roadfighter/Config.in
```kconfig
config BR2_PACKAGE_ROADFIGHTER
    bool "roadfighter"
    depends on BR2_PACKAGE_SDL
    depends on BR2_PACKAGE_SDL_IMAGE
    depends on BR2_PACKAGE_SDL_MIXER
    depends on BR2_PACKAGE_SDL_SOUND
    depends on BR2_PACKAGE_SDL_TTF

      help
        Port of Roadfighter from Brain Games
```

## package/batocera/ports/rott/Config.in
```kconfig
config BR2_PACKAGE_ROTT
	bool "rott"
	depends on BR2_INSTALL_LIBSTDCPP
	select BR2_PACKAGE_SDL2
	select BR2_PACKAGE_SDL2_MIXER

	help
	  ROTT
	  SDL2 port of Rise of the Triad.

	  https://github.com/fabiangreffrath/taradino
```

## package/batocera/ports/samtfe/Config.in
```kconfig
config BR2_PACKAGE_SAMTFE
	bool "samtfe"
	select BR2_PACKAGE_SDL2
	select BR2_PACKAGE_SDL2_MIXER
	depends on BR2_INSTALL_LIBSTDCPP
	help
		Serious Sam Classic open source project based on https://github.com/Croteam-official/Serious-Engine 
		and linux port https://github.com/icculus/Serious-Engine
		
comment "BR2_PACKAGE_SAMTFE needs a toolchain w/ C++"
	depends on !BR2_INSTALL_LIBSTDCPP
```

## package/batocera/ports/sm64port/Config.in
```kconfig
config BR2_PACKAGE_SM64PORT
	bool "sm64port"
	depends on BR2_INSTALL_LIBSTDCPP
	select BR2_PACKAGE_SDL2

	help
	  A Super Mario 64 decomplication, brought to you by a
	  bunch of clever folks.

	  https://github.com/sm64pc/sm64ex

comment "BR2_PACKAGE_SM64PORT needs a toolchain w/ C++"
	depends on !BR2_INSTALL_LIBSTDCPP
```

## package/batocera/ports/sonic/sonic2013/Config.in
```kconfig
config BR2_PACKAGE_SONIC2013
	bool "sonic2013"
	select BR2_PACKAGE_LIBGLU		if BR2_PACKAGE_XORG7
	select BR2_PACKAGE_LIBGLEW		if BR2_PACKAGE_XORG7
	select BR2_PACKAGE_LIBGLFW		if BR2_PACKAGE_XORG7
	select BR2_PACKAGE_LIBOGG
	select BR2_PACKAGE_LIBTHEORA
	select BR2_PACKAGE_PORTAUDIO
	select BR2_PACKAGE_PORTAUDIO_ALSA
	select BR2_PACKAGE_SDL2

	help
	  The Sonic 2013 decompilation is for the
	  Android & iOS ports of Sonic 1 and 2

	  https://github.com/Rubberduckycooly/Sonic-1-2-2013-Decompilation
```

## package/batocera/ports/sonic/sonicmania/Config.in
```kconfig
config BR2_PACKAGE_SONICMANIA
	bool "sonicmania"
		select BR2_PACKAGE_SDL2
		select BR2_PACKAGE_SDL2_NET
		select BR2_PACKAGE_SDL2_MIXER
		select BR2_PACKAGE_LIBOGG
		select BR2_PACKAGE_LIBVORBIS

    help
      A complete decompilation of Sonic Mania (2017)

	  https://github.com/Rubberduckycooly/Sonic-Mania-Decompilation
```

## package/batocera/ports/sonic/sonicnexus/Config.in
```kconfig
config BR2_PACKAGE_SONICNEXUS
	bool "sonicnexus"
	select BR2_PACKAGE_LIBOGG
	select BR2_PACKAGE_LIBVORBIS
	select BR2_PACKAGE_SDL2
	select BR2_PACKAGE_SDL2_NET
	select BR2_PACKAGE_SDL2_MIXER

	help
	  A decomplication of the 2008 Retro-Sonic Engine Demo
	  of Sonic Nexus

	  https://github.com/Rubberduckycooly/Sonic-Nexus-Decompilation
```

## package/batocera/ports/sonic/srb2/Config.in
```kconfig
config BR2_PACKAGE_SRB2
	bool "srb2"
	select BR2_PACKAGE_SDL2
	select BR2_PACKAGE_SDL2_MIXER
	select BR2_PACKAGE_LIBGME
	select BR2_PACKAGE_LIBOPENMPT

	depends on BR2_INSTALL_LIBSTDCPP

	help
	  Sonic Robo Blast 2 is a 3D open-source Sonic the Hedgehog fangame built using a modified version of the Doom Legacy port of Doom.

	  https://www.srb2.org/
```

## package/batocera/ports/sonic/srb2kart/Config.in
```kconfig
config BR2_PACKAGE_SRB2KART
	bool "srb2kart"
	depends on BR2_INSTALL_LIBSTDCPP
	select BR2_PACKAGE_SDL2
	select BR2_PACKAGE_SDL2_MIXER
	select BR2_PACKAGE_LIBGME

	help
	  SRB2Kart is a kart racing mod based on the 3D Sonic the
	  Hedgehog fangame Sonic Robo Blast 2

	  https://www.srb.org/
```

## package/batocera/ports/spacecadetpinball/Config.in
```kconfig
config BR2_PACKAGE_SPACECADETPINBALL
	bool "spacecadetpinball"
	select BR2_PACKAGE_SDL2
	select BR2_PACKAGE_SDL2_MIXER
	depends on BR2_INSTALL_LIBSTDCPP
	help
	  Decompilation of 3D Pinball for Windows – Space Cadet

	  https://github.com/k4zmu2a/SpaceCadetPinball

comment "BR2_PACKAGE_SPACECADETPINBALL needs a toolchain w/ C++"
	depends on !BR2_INSTALL_LIBSTDCPP
```

## package/batocera/ports/stalker/Config.in
```kconfig
config BR2_PACKAGE_STALKER
	bool "stalker"
	depends on BR2_INSTALL_LIBSTDCPP
	select BR2_PACKAGE_SDL2
	select BR2_PACKAGE_SDL2_MIXER

	help
	  Improved version of the X-Ray Engine, the game engine used
	  in the world-famous S.T.A.L.K.E.R. game series by
	  GSC Game World.

	  https://github.com/OpenXRay/xray-16/

comment "BR2_PACKAGE_STALKER needs a toolchain w/ C++"
	depends on !BR2_INSTALL_LIBSTDCPP
```

## package/batocera/ports/stk/Config.in
```kconfig
config BR2_PACKAGE_STK
	bool "stk"
	depends on BR2_INSTALL_LIBSTDCPP
	select BR2_PACKAGE_SDL2
	select BR2_PACKAGE_SDL2_MIXER
	select BR2_PACKAGE_SHADERC

	help
	  SuperTuxKart is a free kart racing game.
	  It focuses on fun and not on realistic kart physics.

	  https://supertuxkart.net/
```

## package/batocera/ports/stuntcar/Config.in
```kconfig
config BR2_PACKAGE_STUNTCAR
	bool "stuntcar"
	depends on BR2_PACKAGE_SDL2
	depends on BR2_PACKAGE_SDL2_MIXER
	depends on BR2_PACKAGE_SDL2_TTF
	depends on BR2_PACKAGE_OPENAL
	depends on BR2_INSTALL_LIBSTDCPP

	help
	  This is a port of the old Stunt Car Racer from the AtariST/Amiga time.

	  http://ptitseb.github.io/stuntcarremake

comment "BR2_PACKAGE_STUNTCAR needs a toolchain w/ C++"
	depends on !BR2_INSTALL_LIBSTDCPP
```

## package/batocera/ports/supertux2/Config.in
```kconfig
config BR2_PACKAGE_SUPERTUX2
	bool "supertux2"
	select BR2_PACKAGE_BOOST
	select BR2_PACKAGE_BOOST_DATE_TIME
	select BR2_PACKAGE_BOOST_FILESYSTEM
	select BR2_PACKAGE_BOOST_LOCALE
	select BR2_PACKAGE_BOOST_SYSTEM
	select BR2_PACKAGE_FREETYPE
	select BR2_PACKAGE_LIBCURL
	select BR2_PACKAGE_LIBOGG
	select BR2_PACKAGE_LIBPNG
	select BR2_PACKAGE_LIBVORBIS
	select BR2_PACKAGE_OPENAL
	select BR2_PACKAGE_PHYSFS
	select BR2_PACKAGE_SDL2
	select BR2_PACKAGE_SDL2_IMAGE
	select BR2_PACKAGE_ZLIB

	help
	  SuperTux is a free classic 2D jump'n run sidescroller game in
	  a style similar to the original Super Mario games covered
	  under the GNU GPL.

	  http://supertux.github.io/
```

## package/batocera/ports/tekwar/Config.in
```kconfig
config BR2_PACKAGE_TEKWAR
	bool "tekwar"
	depends on BR2_INSTALL_LIBSTDCPP
	select BR2_PACKAGE_SDL2
	select BR2_PACKAGE_SDL2_IMAGE

	help
	  Tekwar
	  No-promises port of TekWar.

	  https://github.com/jonof/jftekwar
```

## package/batocera/ports/vcmi/Config.in
```kconfig
config BR2_PACKAGE_VCMI
	bool "vcmi"
	depends on BR2_PACKAGE_SDL2
	depends on BR2_PACKAGE_SDL2_IMAGE
	depends on BR2_PACKAGE_SDL2_MIXER
	depends on BR2_PACKAGE_SDL2_TTF
	depends on BR2_PACKAGE_FFMPEG
	select BR2_PACKAGE_TBB
	select BR2_PACKAGE_BOOST_PROGRAM_OPTIONS

	help
	  Heroes of Might and Magic 3 engine.

	  https://vcmi.eu
```

## package/batocera/ports/wip/avp/Config.in
```kconfig
config BR2_PACKAGE_AVP
	bool "AVP"
	select BR2_PACKAGE_SDL2
	select BR2_PACKAGE_SDL2_MIXER
	depends on BR2_INSTALL_LIBSTDCPP
	help
	  Want to play Aliens versus Predator (1999) in Linux?

	  http://icculus.org/avp/

comment "BR2_PACKAGE_AVP needs a toolchain w/ C++"
	depends on !BR2_INSTALL_LIBSTDCPP
```

## package/batocera/ports/wip/candc/Config.in
```kconfig
config BR2_PACKAGE_CANDC
	bool "candc"
	select BR2_PACKAGE_SDL2
	depends on BR2_INSTALL_LIBSTDCPP
	help
	  Vanilla Conquer provides clean, cross-platform builds of the C&C Remastered Collection and the standalone legacy games.

	  https://github.com/TheAssemblyArmada/Vanilla-Conquer

comment "BR2_PACKAGE_CANDC needs a toolchain w/ C++"
	depends on !BR2_INSTALL_LIBSTDCPP
```

## package/batocera/ports/wip/doom/gzdoom/Config.in
```kconfig
config BR2_PACKAGE_GZDOOM
	bool "GZDOOM"
	select BR2_PACKAGE_SDL2
	select BR2_PACKAGE_SDL2_MIXER
	select BR2_PACKAGE_ZMUSIC
	select BR2_HOST_PACKAGE_ZMUSIC
	depends on BR2_INSTALL_LIBSTDCPP
	help
	  GZDoom is a feature centric port for all Doom engine games, based on ZDoom, adding an OpenGL renderer and powerful scripting capabilities

	  gzdoom.drdteam.org

comment "BR2_PACKAGE_GZDOOM needs a toolchain w/ C++"
	depends on !BR2_INSTALL_LIBSTDCPP
```

## package/batocera/ports/wip/doom3/Config.in
```kconfig
config BR2_PACKAGE_DOOM3
	bool "doom3"
	select BR2_PACKAGE_SDL2
	select BR2_PACKAGE_SDL2_MIXER
	depends on BR2_INSTALL_LIBSTDCPP
	help
	  dhewm 3 is a Doom 3 GPL source port

	  https://dhewm3.org/

comment "BR2_PACKAGE_DOOM3 needs a toolchain w/ C++"
	depends on !BR2_INSTALL_LIBSTDCPP
```

## package/batocera/ports/wip/doom3bfg/Config.in
```kconfig
config BR2_PACKAGE_DOOM3BFG
	bool "doom3bfg"
	select BR2_PACKAGE_SDL2
	select BR2_PACKAGE_SDL2_MIXER
	depends on BR2_INSTALL_LIBSTDCPP
	help
	  Doom 3 BFG Edition

	  https://github.com/RobertBeckebans/RBDOOM-3-BFG

comment "BR2_PACKAGE_DOOM3BFG needs a toolchain w/ C++"
	depends on !BR2_INSTALL_LIBSTDCPP
```
