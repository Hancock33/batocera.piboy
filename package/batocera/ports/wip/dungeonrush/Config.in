## package/batocera/ports/wip/dungeonrush/Config.in
```kconfig
config BR2_PACKAGE_DUNGEONRUSH
	bool "dungeonrush"
	select BR2_PACKAGE_SDL2
	select BR2_PACKAGE_SDL2_IMAGE
	select BR2_PACKAGE_SDL2_MIXER
	select BR2_PACKAGE_SDL2_NET
	select BR2_PACKAGE_SDL2_TTF

	depends on BR2_INSTALL_LIBSTDCPP
	help
	  A opensource game inspired by Snake, written in pure C with SDL

	  https://github.com/rapiz1/DungeonRush
```

## package/batocera/ports/wip/fallout2/Config.in
```kconfig
config BR2_PACKAGE_FALLOUT2
	bool "fallout2"
	select BR2_PACKAGE_SDL2
	select BR2_PACKAGE_SDL2_IMAGE
	select BR2_PACKAGE_SDL2_MIXER
	select BR2_PACKAGE_SDL2_NET
	select BR2_PACKAGE_SDL2_TTF

	depends on BR2_INSTALL_LIBSTDCPP
	help
	  Open source Fallout 2
```

## package/batocera/ports/wip/halflife2/Config.in
```kconfig
config BR2_PACKAGE_HALFLIFE2
	bool "halflife2"
	select BR2_PACKAGE_SDL2
	select BR2_PACKAGE_SDL2_MIXER
    select BR2_PACKAGE_SDL2_IMAGE
	select BR2_PACKAGE_SDL2_TTF
	select BR2_PACKAGE_FREETYPE
	select BR2_PACKAGE_FONTCONFIG

	depends on BR2_INSTALL_LIBSTDCPP
	help
	  Modified source engine (2017) developed by valve and leaked in 2020.

	  https://github.com/nillerusr/source-engine
```

## package/batocera/ports/wip/maelstrom/Config.in
```kconfig
config BR2_PACKAGE_MAELSTROM
	bool "maelstrom"
	select BR2_PACKAGE_SDL2
	select BR2_PACKAGE_SDL2_NET
	help
	  Maelstrom 3.0 is a GPL'd port of the original shareware game for the
	  Macintosh.  It is a fast-action, high resolution (640x480) asteroids-like
	  game, with detailed graphics and original sounds.

	  https://www.libsdl.org/projects/Maelstrom/
```

## package/batocera/ports/wip/raptorclone/Config.in
```kconfig
config BR2_PACKAGE_RAPTORCLONE
	bool "nukem2"
	select BR2_PACKAGE_SDL2
	select BR2_PACKAGE_SDL2_MIXER
	select BR2_PACKAGE_SDL2_TTF	
	depends on BR2_INSTALL_LIBSTDCPP
	help
      Clone of DOS game Raptor: Call of the Shadows, developed by Cygnus Studio 
      (now Mountain King Studios) and released in 1994 by Apogee.

	  https://github.com/aroldanju/raptor-call-of-the-shadows

comment "BR2_PACKAGE_NUKEM2 needs a toolchain w/ C++"
	depends on !BR2_INSTALL_LIBSTDCPP
```

## package/batocera/ports/wip/stalker/Config.in
```kconfig
config BR2_PACKAGE_STALKER
	bool "stalker"
	select BR2_PACKAGE_SDL2
	select BR2_PACKAGE_SDL2_MIXER
	depends on BR2_INSTALL_LIBSTDCPP
	help
	  dhewm 3 is a Doom 3 GPL source port

	  https://dhewm3.org/

comment "BR2_PACKAGE_STALKER needs a toolchain w/ C++"
	depends on !BR2_INSTALL_LIBSTDCPP
```

## package/batocera/ports/wip/xbox-xcloud-client/Config.in
```kconfig
config BR2_PACKAGE_XBOX_XCLOUD_CLIENT
	bool "xbox-xcloud-client"
	select BR2_PACKAGE_LIBNSS
	select BR2_PACKAGE_AT_SPI2_ATK

	help
	  Xbox-xCloud-Client is an open-source client for Xbox home streaming
	  made in Javascript and Typescript.

	  https://github.com/unknownskl/xbox-xcloud-client
```

## package/batocera/ports/wip/yabause/Config.in
```kconfig
config BR2_PACKAGE_YABAUSE
    bool "yabause"
    depends on BR2_PACKAGE_SDL2
    depends on BR2_PACKAGE_BOOST
    depends on BR2_PACKAGE_OPENAL
    depends on BR2_PACKAGE_ZLIB

    help
        Yabause is a Sega Saturn emulator and took over as Yaba Sanshiro
```

## package/batocera/ports/witchaven/Config.in
```kconfig
config BR2_PACKAGE_WITCHAVEN
	bool "witchaven"
	depends on BR2_INSTALL_LIBSTDCPP
	select BR2_PACKAGE_SDL2
	select BR2_PACKAGE_SDL2_IMAGE
	help
	  Witchaven
	  No-promises port of Witchaven.

	  https://github.com/jonof/jfwhaven
```

## package/batocera/ports/xbox-xcloud-client/Config.in
```kconfig
config BR2_PACKAGE_XBOX_XCLOUD_CLIENT
	bool "xbox-xcloud-client"
	select BR2_PACKAGE_LIBNSS

	help
	  Xbox-xCloud-Client is an open-source client for
	  Xbox home streaming made in Javascript and Typescript.

	  https://github.com/unknownskl/xbox-xcloud-client
```

## package/batocera/python/python-adafruit-circuitpython-typing/Config.in
```kconfig
config BR2_PACKAGE_PYTHON_ADAFRUIT_CIRCUITPYTHON_TYPING
	bool "python-adafruit-circuitpython-typing"
	select BR2_PACKAGE_PYTHON_ADAFRUIT_BLINKA
	select BR2_PACKAGE_PYTHON_TYPING_EXTENSIONS

	help
	  Types needed for type annotation that are not in `typing`.

	  https://github.com/adafruit/Adafruit_CircuitPython_Typing
```

## package/batocera/python/python-lgpio/Config.in
```kconfig
config BR2_PACKAGE_PYTHON_LGPIO
	bool "python-lgpio"
	select BR2_PACKAGE_LIBLGPIO

	help
	  Linux SBC GPIO module.

	  http://abyz.me.uk/lg/py_lgpio.html
```

## package/batocera/python/python-pyftdi/Config.in
```kconfig
config BR2_PACKAGE_PYTHON_PYFTDI
	bool "python-pyftdi"
	select BR2_PACKAGE_PYTHON_PYUSB
	select BR2_PACKAGE_PYTHON_SERIAL

	help
	  FTDI device driver (pure Python).

	  http://github.com/eblot/pyftdi
```

## package/batocera/sources/libretro-mame-src/Config.in
```kconfig
config BR2_PACKAGE_LIBRETRO_MAME_SRC
	bool "libretro-mame-src"
	depends on BR2_PACKAGE_RETROARCH
	depends on BR2_INSTALL_LIBSTDCPP
	select BR2_PACKAGE_ALSA_LIB

	help
	  A libretro mame core for Mame.

	  http://www.libretro.com

comment "LIBRETRO_MAME_SRC needs a toolchain w/ C++"
	depends on !BR2_INSTALL_LIBSTDCPP
```

## package/batocera/utils/7zip/Config.in
```kconfig
config BR2_PACKAGE_7ZIP
	bool "7zip"
	depends on BR2_TOOLCHAIN_HAS_SYNC_4 # __sync_*_4 intrisics
	depends on BR2_INSTALL_LIBSTDCPP
	depends on BR2_TOOLCHAIN_HAS_THREADS
	depends on BR2_USE_WCHAR
	help
	  7-Zip is a file archiver with a high compression ratio.
	  
	  http://www.7-zip.org
```

## package/batocera/utils/fastfetch/Config.in
```kconfig
config BR2_PACKAGE_FASTFETCH
	bool "fastfetch"

	help
	  A maintained, feature-rich and performance oriented,
	  neofetch like system information tool.

	  https://github.com/fastfetch-cli/fastfetch.git
```

## package/batocera/utils/nlohmann-json/Config.in
```kconfig
config BR2_PACKAGE_NLOHMANN_JSON
    bool "nlohmann-json"
    depends on BR2_x86_64

    help
      JSON for Modern C++

      json.nlohmann.me
```

## package/batocera/utils/ntfs-plus/Config.in
```kconfig
config BR2_PACKAGE_NTFS_PLUS
	bool "ntfs-plus"
	depends on BR2_USE_WCHAR
	depends on BR2_TOOLCHAIN_HAS_THREADS
	depends on BR2_USE_MMU
	depends on !BR2_STATIC_LIBS
	help
	  NTFS filesystem userspace utilities

	  https://github.com/ntfsprogs-plus/ntfsprogs-plus

if BR2_PACKAGE_NTFS_PLUS

config BR2_PACKAGE_NTFS_PLUS_ENCRYPTED
	bool "encrypted volumes"
	depends on BR2_PACKAGE_LIBGPG_ERROR_ARCH_SUPPORTS # libgcrypt
	select BR2_PACKAGE_GNUTLS
	select BR2_PACKAGE_LIBGCRYPT
	help
	  Enable support for NTFS encrypted volumes.

config BR2_PACKAGE_NTFS_PLUS_NTFSPROGS
	bool "ntfsprogs"
	help
	  Install NTFS utilities.

endif

comment "ntfs-plus needs a toolchain w/ wchar, threads, dynamic library"
	depends on BR2_USE_MMU
	depends on !BR2_USE_WCHAR || !BR2_TOOLCHAIN_HAS_THREADS || BR2_STATIC_LIBS
```

## package/batocera/utils/shadps4-qtlauncher/Config.in
```kconfig
config BR2_PACKAGE_SHADPS4_QTLAUNCHER
	bool "shadps4_qtlauncher"
	depends on BR2_TOOLCHAIN_GCC_AT_LEAST_8
	select BR2_HOST_CMAKE_AT_LEAST_3_24
	select BR2_PACKAGE_QT6BASE
	select BR2_PACKAGE_QT6MULTIMEDIA
	select BR2_PACKAGE_QT6SVG
	select BR2_PACKAGE_QT6TOOLS
	select BR2_PACKAGE_SHADPS4

	help
	  The official Qt launcher for shadps4 emulator.

	  https://github.com/shadps4-emu/shadps4-qtlauncher
```

## package/batocera/utils/tvtextviewer/Config.in
```kconfig
config BR2_PACKAGE_TVTEXTVIEWER
	bool "tvtextviewer"
	depends on BR2_INSTALL_LIBSTDCPP
	select BR2_PACKAGE_SDL2

	help
	  Full-screen text viewer tool with gamepad controls.
```

## package/batocera/utils/warehouse/Config.in
```kconfig
config BR2_PACKAGE_WAREHOUSE
	bool "warehouse"
	select BR2_PACKAGE_APPSTREAM
	select BR2_PACKAGE_FLATPAK
	select BR2_PACKAGE_LIBGTK4
	select BR2_PACKAGE_LIBGTK4_GSTREAMER  if BR2_PACKAGE_BATOCERA_TARGET_X86_64_ANY
	select BR2_PACKAGE_LIBGTK4_WAYLAND    if BR2_PACKAGE_BATOCERA_WAYLAND
	select BR2_PACKAGE_LIBGTK4_X11        if BR2_PACKAGE_XORG7

	help
	  A versatile toolbox for viewing flatpak info,
	  managing user data, and batch managing installed flatpaks

	  https://github.com/flattool/warehouse
```

## package/batocera/utils/xkbd/Config.in
```kconfig
config BR2_PACKAGE_XKBD
	bool "xkbd"
	select BR2_PACKAGE_XLIB_LIBXPM
	select BR2_PACKAGE_XLIB_LIBXFT

	help
	  onscreen soft keyboard for X11
```

## package/batocera/wine/d7vk/Config.in
```kconfig
config BR2_PACKAGE_D7VK
	bool "d7vk"
	depends on BR2_i386 || BR2_x86_64
	# Wine unconditionally builds shared libraries
	depends on !BR2_STATIC_LIBS
	depends on BR2_PACKAGE_SPIRV_HEADERS

	help
	  Vulkan-based implementation of D3D7 for Linux / Wine,
	  spun off from DXVK.

	  https://github.com/WinterSnowfall/d7vk

comment "d7vk needs a toolchain w/ dynamic library"
	depends on BR2_STATIC_LIBS
```

## package/batocera/wine/wine-proton/Config.in
```kconfig
config BR2_PACKAGE_WINE_PROTON
	bool "wine-proton"
	# Wine unconditionally builds shared libraries
	depends on !BR2_STATIC_LIBS

	help
	  Proton is a Wine build modified by Valve and other 
	  contributors.	  It contains many useful patches 
	  (primarily for a better gaming experience),some of
	  them are unique and not present in other builds.
	  The differences from the official Steam's Proton are
	  the lack of the Proton's python script and the lack of
	  some builtin dlls (like DXVK and vkd3d-proton).

	  https://github.com/ValveSoftware/wine.git

comment "wine needs a toolchain w/ dynamic library"
	depends on BR2_PACKAGE_WINE_ARCH_SUPPORTS
	depends on BR2_STATIC_LIBS
```
