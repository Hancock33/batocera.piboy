## package/batocera/ports/doom/uzdoom/Config.in.host
```kconfig
config BR2_PACKAGE_HOST_UZDOOM
	bool "host uzdoom tools"

	help
	  This package is required for building uzdoom.
```

## package/batocera/ports/freedroid/Config.in
```kconfig
config BR2_PACKAGE_FREEDROID
	bool "freedroid"
	depends on BR2_INSTALL_LIBSTDCPP
	select BR2_PACKAGE_LIBJPEG
	select BR2_PACKAGE_SDL3
	select BR2_PACKAGE_SDL3_IMAGE
	select BR2_PACKAGE_SDL3_MIXER
	select BR2_PACKAGE_SDL3_TTF

	help
	  The original Freedroid, a free & open-source clone
	  of the C64 classic Paradroid.

	  https://github.com/ReinhardPrix/FreedroidClassic

comment "BR2_PACKAGE_FREEDROID needs a toolchain w/ C++"
	depends on !BR2_INSTALL_LIBSTDCPP
```

## package/batocera/ports/rtcw/Config.in
```kconfig
config BR2_PACKAGE_RTCW
	bool "rtcw"
	select BR2_PACKAGE_OPENAL
	select BR2_PACKAGE_SDL2

	help
	  Return to Castle Wolfenstein port using
	  IOQuake3 functionality.

	  https://github.com/iortcw/iortcw
```

## package/batocera/ports/serioussam/Config.in
```kconfig
config BR2_PACKAGE_SERIOUSSAM
	bool "serioussam"
	depends on BR2_INSTALL_LIBSTDCPP
	select BR2_PACKAGE_IMAGEMAGICK
	select BR2_PACKAGE_SDL2
	select BR2_PACKAGE_SDL2_MIXER

	help
	  Serious Sam Classic open source project based on
	  https://github.com/Croteam-official/Serious-Engine
	  and linux port https://github.com/icculus/Serious-Engine

comment "BR2_PACKAGE_SERIOUSSAM needs a toolchain w/ C++"
	depends on !BR2_INSTALL_LIBSTDCPP
```

## package/batocera/ports/uqm/Config.in
```kconfig
config BR2_PACKAGE_UQM
	bool "uqm"
	depends on !BR2_STATIC_LIBS # sdl2
	select BR2_PACKAGE_LIBPNG
	select BR2_PACKAGE_LIBVORBIS
	select BR2_PACKAGE_LIBZIP
	select BR2_PACKAGE_SDL2

	help
	  The Ur-Quan Masters

	  https://sc2.sourceforge.net/
```

## package/batocera/sources/mono-src/Config.in
```kconfig
config BR2_PACKAGE_MONO_SRC
	bool "mono-src"
	depends on BR2_PACKAGE_MONO_ARCH_SUPPORTS
	depends on BR2_INSTALL_LIBSTDCPP
	depends on BR2_TOOLCHAIN_HAS_THREADS_NPTL # pthread_getattr_np()
	depends on !BR2_STATIC_LIBS
	select BR2_PACKAGE_LIBATOMIC_OPS

	help
	  An open source, cross-platform, implementation of C#
	  and the CLR that is binary compatible with Microsoft.NET.

	  http://download.mono-project.com/sources/mono/
```

## package/batocera/utils/batocera-pygame/Config.in
```kconfig
config BR2_PACKAGE_BATOCERA_PYGAME
	bool "batocera-pygame"

	select BR2_PACKAGE_EVMAPY
	select BR2_PACKAGE_PYTHON_PYGAME2
```

## package/batocera/utils/xwiimote/Config.in
```kconfig
config BR2_PACKAGE_XWIIMOTE
	bool "xwiimote"
	depends on BR2_PACKAGE_HAS_UDEV
	select BR2_PACKAGE_NCURSES

	help
	  a tool to analyse the wiimote events
```
