## package/batocera/audio/alsa-topology/Config.in
```kconfig
config BR2_PACKAGE_ALSA_TOPOLOGY
	bool "alsa-topology"

	help
	  ALSA topology configuration files.

	  https://github.com/alsa-project/alsa-topology-conf
```

## package/batocera/emulators/dsperate/Config.in
```kconfig
config BR2_PACKAGE_DSPERATE
	bool "dsperate"
	select BR2_PACKAGE_LIBCURL
	select BR2_PACKAGE_SDL2
	select BR2_PACKAGE_VULKAN_HEADERS

	help
	  DSperate, a Nintendo DS and DSi emulator aiming at
	  DraStic-level performance on ARM handhelds.

	  https://github.com/beebono/DSperate
```

## package/batocera/emulators/eden/Config.in
```kconfig
config BR2_PACKAGE_EDEN
	bool "eden"
	depends on BR2_x86_64
	depends on BR2_PACKAGE_XORG7
	depends on BR2_PACKAGE_BATOCERA_VULKAN
	select BR2_PACKAGE_BATOCERA_QT6
	select BR2_PACKAGE_BOOST
	select BR2_PACKAGE_BOOST_CONTEXT
	select BR2_PACKAGE_BOOST_FILESYSTEM
	select BR2_PACKAGE_CUBEB
	select BR2_PACKAGE_ENET
	select BR2_PACKAGE_FFMPEG
	select BR2_PACKAGE_FFMPEG_SWSCALE
	select BR2_PACKAGE_LIBUSB
	select BR2_PACKAGE_LZ4
	select BR2_PACKAGE_OPENSSL
	select BR2_PACKAGE_OPUS
	select BR2_PACKAGE_QT6CHARTS
	select BR2_PACKAGE_SDL3
	select BR2_PACKAGE_SPIRV_HEADERS
	select BR2_PACKAGE_VULKAN_HEADERS
	select BR2_PACKAGE_VULKAN_LOADER
	select BR2_PACKAGE_VULKAN_UTILITY_LIBRARIES
	select BR2_PACKAGE_ZLIB
	select BR2_PACKAGE_ZSTD

	help
	  Eden: Nintendo Switch Emulator

	  https://eden-emu.dev/
```

## package/batocera/emulators/flycast/Config.in
```kconfig
config BR2_PACKAGE_FLYCAST
	bool "flycast"
	depends on BR2_INSTALL_LIBSTDCPP
	depends on BR2_GCC_ENABLE_OPENMP
	depends on BR2_PACKAGE_HAS_UDEV
	depends on BR2_PACKAGE_HAS_LIBGL || BR2_PACKAGE_HAS_LIBGLES
	select BR2_PACKAGE_BATOCERA_LAUNCH_FLYCAST
	select BR2_PACKAGE_GLSLANG if BR2_PACKAGE_BATOCERA_VULKAN
	select BR2_PACKAGE_LIBAO
	select BR2_PACKAGE_LIBCURL
	select BR2_PACKAGE_LIBMINIUPNPC
	select BR2_PACKAGE_LIBZIP
	select BR2_PACKAGE_SDL2
	select BR2_PACKAGE_ZLIB

	help
	  Flycast is a multi-platform Sega emulator for
	  - Dreamcast
	  - Naomi
	  - Atomiswave

	  https://github.com/flyinghead/flycast

comment "flycast needs a toolchain w/ C++ and OpenMP, udev and OpenGL or OpenGL ES"
	depends on !BR2_INSTALL_LIBSTDCPP || !BR2_GCC_ENABLE_OPENMP || \
		!BR2_PACKAGE_HAS_UDEV || \
		(!BR2_PACKAGE_HAS_LIBGL && !BR2_PACKAGE_HAS_LIBGLES)
```

## package/batocera/emulators/lichii/Config.in
```kconfig
config BR2_PACKAGE_LICHII
	bool "lichii"
	depends on BR2_x86_64
	depends on BR2_PACKAGE_XORG7
	depends on BR2_PACKAGE_BATOCERA_VULKAN
	select BR2_PACKAGE_BATOCERA_QT6
	select BR2_PACKAGE_BOOST
	select BR2_PACKAGE_BOOST_CONTEXT
	select BR2_PACKAGE_BOOST_FILESYSTEM
	select BR2_PACKAGE_CUBEB
	select BR2_PACKAGE_ENET
	select BR2_PACKAGE_FFMPEG
	select BR2_PACKAGE_FFMPEG_SWSCALE
	select BR2_PACKAGE_FMT
	select BR2_PACKAGE_JSON_FOR_MODERN_CPP
	select BR2_PACKAGE_LIBUSB
	select BR2_PACKAGE_LZ4
	select BR2_PACKAGE_OPENSSL
	select BR2_PACKAGE_SDL3
	select BR2_PACKAGE_SPIRV_HEADERS
	select BR2_PACKAGE_VULKAN_HEADERS
	select BR2_PACKAGE_VULKAN_LOADER
	select BR2_PACKAGE_VULKAN_UTILITY_LIBRARIES
	select BR2_PACKAGE_ZLIB
	select BR2_PACKAGE_ZSTD

	help
	  Lichii: experimental Nintendo Switch and Switch 2 emulator,
	  a fork of Eden.

	  https://github.com/zortos293/Lichii
```

## package/batocera/emulators/retroarch/libretro/libretro-anybor/Config.in
```kconfig
config BR2_PACKAGE_LIBRETRO_ANYBOR
	bool "libretro-anybor"
	depends on BR2_INSTALL_LIBSTDCPP
	select BR2_PACKAGE_HOST_PYTHON3

	help
	  A libretro openbor emulator

	  http://www.libretro.com

comment "LIBRETRO_ANYBOR needs a toolchain w/ C++"
	depends on !BR2_INSTALL_LIBSTDCPP
```

## package/batocera/emulators/retroarch/libretro/libretro-anygm/Config.in
```kconfig
config BR2_PACKAGE_LIBRETRO_ANYGM
	bool "libretro-anygm"
	depends on BR2_INSTALL_LIBSTDCPP
	depends on BR2_TOOLCHAIN_HAS_THREADS

	help
	  AnyGM: a portable runtime and libretro core for GameMaker content
	  (GameMaker 5.3 to Studio 2.x). Runs unprotected content only; no game
	  data is included.

	  https://github.com/retrodiv/AnyGM-libretro

comment "LIBRETRO_ANYGM needs a toolchain w/ C++ and threads"
	depends on !BR2_INSTALL_LIBSTDCPP || !BR2_TOOLCHAIN_HAS_THREADS
```

## package/batocera/emulators/retroarch/libretro/libretro-armsx2/Config.in
```kconfig
config BR2_PACKAGE_LIBRETRO_ARMSX2
	bool "libretro-armsx2"
	depends on BR2_INSTALL_LIBSTDCPP
	depends on BR2_PACKAGE_HAS_UDEV
	select BR2_PACKAGE_DBUS
	select BR2_PACKAGE_ECM            if BR2_PACKAGE_BATOCERA_WAYLAND
	select BR2_PACKAGE_FONTCONFIG
	select BR2_PACKAGE_FREETYPE
	select BR2_PACKAGE_JPEG
	select BR2_PACKAGE_LIBCURL
	select BR2_PACKAGE_LIBPCAP
	select BR2_PACKAGE_LIBPNG
	select BR2_PACKAGE_LZ4
	select BR2_PACKAGE_PLUTOSVG
	select BR2_PACKAGE_PLUTOVG
	select BR2_PACKAGE_SDL3
	select BR2_PACKAGE_SHADERC        if BR2_PACKAGE_BATOCERA_VULKAN
	select BR2_PACKAGE_WAYLAND        if BR2_PACKAGE_BATOCERA_WAYLAND
	select BR2_PACKAGE_WEBP
	select BR2_PACKAGE_XLIB_LIBX11    if BR2_PACKAGE_XORG7
	select BR2_PACKAGE_XLIB_LIBXRANDR if BR2_PACKAGE_XORG7
	select BR2_PACKAGE_ZLIB
	select BR2_PACKAGE_ZSTD

	help
	  A libretro core for PS2

	  http://www.libretro.com

comment "LIBRETRO_ARMSX2 needs a toolchain w/ C++"
	depends on !BR2_INSTALL_LIBSTDCPP
```

## package/batocera/emulators/retroarch/libretro/libretro-azahar/Config.in
```kconfig
config BR2_PACKAGE_LIBRETRO_AZAHAR
	bool "libretro-azahar"
	select BR2_PACKAGE_OPENSSL

	help
	  Azahar is a Citra fork and emulator for the Nintendo 3DS.

	  https://github.com/azahar-emu/azahar

comment "LIBRETRO_AZAHAR needs a toolchain w/ C++"
	depends on !BR2_INSTALL_LIBSTDCPP
```

## package/batocera/emulators/retroarch/libretro/libretro-bennugd/Config.in
```kconfig
config BR2_PACKAGE_LIBRETRO_BENNUGD
	bool "libretro-bennugd"
	depends on BR2_INSTALL_LIBSTDCPP
	select BR2_PACKAGE_FREETYPE
	select BR2_PACKAGE_LIBOGG
	select BR2_PACKAGE_LIBPNG
	select BR2_PACKAGE_LIBVORBIS
	select BR2_PACKAGE_OPENSSL
	select BR2_PACKAGE_ZLIB

	help
	  libretro core for for BennuGD

	  https://github.com/diekleinekuh/BennuGD_libretro

comment "BR2_PACKAGE_LIBRETRO_BENNUGD needs a toolchain w/ C++"
	depends on !BR2_INSTALL_LIBSTDCPP
```

## package/batocera/emulators/retroarch/libretro/libretro-bk/Config.in
```kconfig
config BR2_PACKAGE_LIBRETRO_BK
	bool "libretro-bk"
	depends on BR2_INSTALL_LIBSTDCPP

	help
	  A libretro BK computer serie emulator core.

	  http://www.libretro.com

comment "LIBRETRO_BK needs a toolchain w/ C++"
	depends on !BR2_INSTALL_LIBSTDCPP
```

## package/batocera/emulators/retroarch/libretro/libretro-dolphin/Config.in
```kconfig
config BR2_PACKAGE_LIBRETRO_DOLPHIN
	bool "libretro-dolphin"
	depends on BR2_PACKAGE_HAS_UDEV
	select BR2_PACKAGE_BLUEZ5_UTILS
	select BR2_PACKAGE_BZIP2
	select BR2_PACKAGE_FMT
	select BR2_PACKAGE_LIBCURL
	select BR2_PACKAGE_LZ4
	select BR2_PACKAGE_PUGIXML
	select BR2_PACKAGE_XZ
	select BR2_PACKAGE_ZLIB
	select BR2_PACKAGE_ZSTD

	help
	  A libretro core for GameCube / Wii emulation.

	  http://www.libretro.com
	  https://github.com/libretro/dolphin
```

## package/batocera/emulators/retroarch/libretro/libretro-ep128emu-core/Config.in
```kconfig
config BR2_PACKAGE_LIBRETRO_EP128EMU_CORE
	bool "libretro-ep128emu-core"
	depends on BR2_INSTALL_LIBSTDCPP

	help
	  Libretro core version of ep128emu.

	  http://www.libretro.com

comment "LIBRETRO_EP128EMU_CORE needs a toolchain w/ C++"
	depends on !BR2_INSTALL_LIBSTDCPP
```

## package/batocera/emulators/retroarch/libretro/libretro-flycast/Config.in
```kconfig
config BR2_PACKAGE_LIBRETRO_FLYCAST
	bool "libretro-flycast"
	depends on BR2_INSTALL_LIBSTDCPP
	depends on BR2_GCC_ENABLE_OPENMP
	depends on BR2_PACKAGE_HAS_LIBGLES || BR2_PACKAGE_HAS_LIBGL
	select BR2_PACKAGE_GLSLANG if BR2_PACKAGE_BATOCERA_VULKAN

	help
	  Flycast libretro core, a Sega Dreamcast, Naomi and
	  Atomiswave emulator.

	  https://github.com/flyinghead/flycast

comment "libretro-flycast needs a toolchain w/ C++ and OpenMP, and OpenGL or OpenGL ES"
	depends on !BR2_INSTALL_LIBSTDCPP || !BR2_GCC_ENABLE_OPENMP || \
		(!BR2_PACKAGE_HAS_LIBGLES && !BR2_PACKAGE_HAS_LIBGL)
```

## package/batocera/emulators/retroarch/libretro/libretro-nuance/Config.in
```kconfig
config BR2_PACKAGE_LIBRETRO_NUANCE
	bool "libretro-nuance"
	depends on BR2_INSTALL_LIBSTDCPP

	help
	  Nuance libretro core: an emulator of the NUON (VM Labs), the
	  media processor built into a few DVD players. The 64-bit JIT
	  (asmjit) is x86_64 only.

	  https://github.com/andkrau/NuanceResurrection

comment "LIBRETRO_NUANCE needs a toolchain w/ C++ and OpenGL"
	depends on !BR2_INSTALL_LIBSTDCPP || !BR2_PACKAGE_HAS_LIBGL
```

## package/batocera/emulators/retroarch/libretro/libretro-odin/Config.in
```kconfig
config BR2_PACKAGE_LIBRETRO_ODIN
	bool "libretro-odin"
	depends on BR2_INSTALL_LIBSTDCPP
	depends on BR2_x86_64
	select BR2_PACKAGE_LIBGLVND

	help
	  Odin libretro core: a low-level emulator of the SEGA Hikaru
	  and Gaelco PowerVR arcade boards, drawing with OpenGL 4.3 or
	  Vulkan. Hard fork of Valkyrie.

	  https://github.com/WizzardSK/odin-libretro

comment "LIBRETRO_ODIN needs a toolchain w/ C++ and OpenGL"
	depends on BR2_x86_64
	depends on !BR2_INSTALL_LIBSTDCPP || !BR2_PACKAGE_HAS_LIBGL
```

## package/batocera/emulators/retroarch/libretro/libretro-panda3ds/Config.in
```kconfig
config BR2_PACKAGE_LIBRETRO_PANDA3DS
	bool "libretro-panda3ds"
	depends on BR2_INSTALL_LIBSTDCPP
	select BR2_PACKAGE_GLSLANG        if BR2_PACKAGE_BATOCERA_VULKAN
	select BR2_PACKAGE_SDL2
	select BR2_PACKAGE_VULKAN_HEADERS if BR2_PACKAGE_BATOCERA_VULKAN
	select BR2_PACKAGE_VULKAN_LOADER  if BR2_PACKAGE_BATOCERA_VULKAN

	help
	  Panda3DS is an HLE, red-panda-themed Nintendo 3DS emulator.

	  https://github.com/wheremyfoodat/Panda3DS

comment "LIBRETRO_PANDA3DS needs a toolchain w/ C++"
	depends on !BR2_INSTALL_LIBSTDCPP
```

## package/batocera/emulators/retroarch/libretro/libretro-scummvm/Config.in
```kconfig
config BR2_PACKAGE_LIBRETRO_SCUMMVM
	bool "libretro-scummvm"
	depends on BR2_INSTALL_LIBSTDCPP
	select BR2_PACKAGE_FAAD2
	select BR2_PACKAGE_FLAC
	select BR2_PACKAGE_FREETYPE
	select BR2_PACKAGE_GIFLIB
	select BR2_PACKAGE_JPEG
	select BR2_PACKAGE_LIBFRIBIDI
	select BR2_PACKAGE_LIBMAD
	select BR2_PACKAGE_LIBMPEG2
	select BR2_PACKAGE_LIBOGG
	select BR2_PACKAGE_LIBPNG
	select BR2_PACKAGE_LIBTHEORA
	select BR2_PACKAGE_LIBVORBIS
	select BR2_PACKAGE_ZLIB

	help
	  A libretro SCUMMVM emulator core for ARM.

	  http://www.libretro.com

comment "LIBRETRO_SCUMMVM needs a toolchain w/ C++"
	depends on !BR2_INSTALL_LIBSTDCPP
```

## package/batocera/emulators/retroarch/libretro/libretro-skyemu/Config.in
```kconfig
config BR2_PACKAGE_LIBRETRO_SKYEMU
	bool "libretro-skyemu"
	depends on BR2_INSTALL_LIBSTDCPP

	help
	  Game Boy Advance, Game Boy, Game Boy Colour, and DS Emulator

	  https://github.com/skylersaleh/SkyEmu

comment "LIBRETRO_SKYEMU needs a toolchain w/ C++"
	depends on !BR2_INSTALL_LIBSTDCPP
```

## package/batocera/emulators/retroarch/libretro/libretro-snes9x/Config.in
```kconfig
config BR2_PACKAGE_LIBRETRO_SNES9X
	bool "libretro-snes9x"
	depends on BR2_INSTALL_LIBSTDCPP

	help
	  Snes9x - Portable Super Nintendo Entertainment System emulator

	  http://www.libretro.com

comment "LIBRETRO_SNES9X needs a toolchain w/ C++"
	depends on !BR2_INSTALL_LIBSTDCPP
```

## package/batocera/emulators/retroarch/libretro/libretro-swanstation/Config.in
```kconfig
config BR2_PACKAGE_LIBRETRO_SWANSTATION
	bool "libretro-swanstation"
	depends on BR2_INSTALL_LIBSTDCPP
	depends on BR2_GCC_ENABLE_OPENMP

	help
	  SwanStation - PlayStation 1, aka. PSX Emulator

	  https://github.com/libretro/swanstation
```

## package/batocera/emulators/retroarch/libretro/libretro-zesarpcw/Config.in
```kconfig
config BR2_PACKAGE_LIBRETRO_ZESARPCW
	bool "libretro-zesarpcw"
	help
	  An Amstrad PCW (8256 / 8512) libretro core derived from ZEsarUX.
	  No BIOS required.

	  https://github.com/retrodiv/ZEsarPCW-libretro
```

## package/batocera/emulators/shadps4/Config.in
```kconfig
config BR2_PACKAGE_SHADPS4
	bool "shadps4"
	depends on BR2_TOOLCHAIN_GCC_AT_LEAST_13
	depends on BR2_PACKAGE_PROTOBUF_ARCH_SUPPORTS
	select BR2_PACKAGE_ALSA_LIB
	select BR2_PACKAGE_BOOST
	select BR2_PACKAGE_BOOST_CONTEXT
	select BR2_PACKAGE_BOOST_EXCEPTION
	select BR2_PACKAGE_BOOST_RANDOM
	select BR2_PACKAGE_CLI11
	select BR2_PACKAGE_FFMPEG
	select BR2_PACKAGE_FMT
	select BR2_PACKAGE_FREETYPE
	select BR2_PACKAGE_GLSLANG
	select BR2_PACKAGE_HAS_UDEV
	select BR2_PACKAGE_JSON_FOR_MODERN_CPP
	select BR2_PACKAGE_LIBABSEIL_CPP
	select BR2_PACKAGE_LIBEVDEV
	select BR2_PACKAGE_LIBMINIUPNPC
	select BR2_PACKAGE_LIBPNG
	select BR2_PACKAGE_LIBZLIB
	select BR2_PACKAGE_OPENAL
	select BR2_PACKAGE_PROTOBUF
	select BR2_PACKAGE_PUGIXML
	select BR2_PACKAGE_PULSEAUDIO
	select BR2_PACKAGE_SDL3
	select BR2_PACKAGE_VULKAN_HEADERS
	select BR2_PACKAGE_VULKAN_LOADER
	select BR2_PACKAGE_VULKAN_VALIDATIONLAYERS
	select BR2_PACKAGE_XXHASH
	select BR2_PACKAGE_ZSTD

	help
	  Sony PlayStation 4 emulator.

	  https://github.com/shadps4-emu/shadPS4
	  https://shadps4.net/
```

## package/batocera/emulators/vice/Config.in
```kconfig
config BR2_PACKAGE_VICE
	bool "vice"
	select BR2_PACKAGE_ALSA_LIB
	select BR2_PACKAGE_FLAC
	select BR2_PACKAGE_GIFLIB
	select BR2_PACKAGE_HOST_DOS2UNIX
	select BR2_PACKAGE_HOST_XA
	select BR2_PACKAGE_LAME
	select BR2_PACKAGE_LIBCURL
	select BR2_PACKAGE_LIBPNG
	select BR2_PACKAGE_LIBVORBIS
	select BR2_PACKAGE_SDL2
	select BR2_PACKAGE_SDL2_IMAGE
	select BR2_PACKAGE_ZLIB

	help
	  VICE, the Versatile Commodore Emulator: C64, C64DTV,
	  SuperCPU64, C128, VIC-20, Plus/4 and PET.

	  https://vice-emu.sourceforge.io/
```

## package/batocera/emulators/xemu-chihiro/Config.in
```kconfig
config BR2_PACKAGE_XEMU_CHIHIRO
	bool "xemu-chihiro"
	depends on BR2_TOOLCHAIN_GCC_AT_LEAST_8
	select BR2_PACKAGE_BATOCERA_LAUNCH_XEMU_CHIHIRO if BR2_PACKAGE_BATOCERA_LAUNCH
	select BR2_PACKAGE_JSON_FOR_MODERN_CPP
	select BR2_PACKAGE_LIBCURL
	select BR2_PACKAGE_LIBEPOXY
	select BR2_PACKAGE_LIBGLIB2
	select BR2_PACKAGE_LIBGTK3
	select BR2_PACKAGE_LIBPCAP
	select BR2_PACKAGE_LIBSAMPLERATE
	select BR2_PACKAGE_PIXMAN
	select BR2_PACKAGE_SDL3
	select BR2_PACKAGE_SLIRP
	select BR2_PACKAGE_VULKAN_HEADERS if BR2_PACKAGE_BATOCERA_TARGET_X86
	select BR2_PACKAGE_VULKAN_LOADER  if BR2_PACKAGE_BATOCERA_TARGET_X86
	select BR2_PACKAGE_ZLIB

	help
	  Sega Chihiro emulator, a fork of xemu

	  https://github.com/Tovarichtch/xemu
```
