## package/batocera/libraries/lib32bit/Config.in
```kconfig
config BR2_PACKAGE_LIB32BIT
    bool "lib32bit"
    help
      32bit libs precompiled for RPI4

      https://github.com/Hancock33/batocera-rp4-32bit-libs
```

## package/batocera/libraries/libdate/Config.in
```kconfig
config BR2_PACKAGE_LIBDATE
	bool "libdate"

	help
	  A date and time library based on the C++11/14/17
	  <chrono> header
```

## package/batocera/libraries/libgme/Config.in
```kconfig
config BR2_PACKAGE_LIBGME
	bool "libgme"

	help
	  The approximate regex matching library and agrep command line tool.
```

## package/batocera/libraries/libiconv-kodi/Config.in
```kconfig
config BR2_PACKAGE_LIBICONV_KODI
	bool "libiconv-kodi"
	help
	  unicode conversion library

	  http://ftp.gnu.org/pub/gnu/libiconv
```

## package/batocera/libraries/libtre/Config.in
```kconfig
config BR2_PACKAGE_LIBTRE
	bool "libtre"
	help
	  The approximate regex matching library and agrep command line tool.
```

## package/batocera/libraries/lunasvg/Config.in
```kconfig
config BR2_PACKAGE_LUNASVG
	bool "lunasvg"
	depends on BR2_INSTALL_LIBSTDCPP

	help
	  lunasvg is a standalone SVG rendering library in C++

	  https://github.com/stenzek/lunasvg

comment "BR2_PACKAGE_LUNASVG needs a toolchain w/ C++"
	depends on !BR2_INSTALL_LIBSTDCPP
```

## package/batocera/libraries/miniz/Config.in
```kconfig
config BR2_PACKAGE_MINIZ
	bool "miniz"

	help
	  Single C source file zlib-replacement library,
	  originally from code.google.com/p/miniz

	  https://github.com/richgel999/miniz
```

## package/batocera/libraries/mono-bin/Config.in
```kconfig
config BR2_PACKAGE_MONO_BIN
	bool "mono-bin"

	depends on BR2_INSTALL_LIBSTDCPP
	depends on BR2_TOOLCHAIN_HAS_THREADS_NPTL # pthread_getattr_np()
	depends on !BR2_STATIC_LIBS
	select BR2_PACKAGE_LIBATOMIC_OPS

	help
	  An open source, cross-platform, implementation of C#
	  and the CLR that is binary compatible with Microsoft.NET.

	  http://download.mono-project.com/sources/mono/
```

## package/batocera/libraries/muparser/Config.in
```kconfig
config BR2_PACKAGE_MUPARSER
	bool "muparser"
        depends on BR2_INSTALL_LIBSTDCPP

	help
	  muparser fast math parser library.

	  https://github.com/beltoforion/muparser
```

## package/batocera/libraries/plutosvg/Config.in
```kconfig
config BR2_PACKAGE_PLUTOSVG
	bool "plutosvg"
	depends on BR2_INSTALL_LIBSTDCPP

	help
	  plutosvg is a tiny SVG rendering library in C

	  https://github.com/stenzek/plutosvg

comment "BR2_PACKAGE_PLUTOSVG needs a toolchain w/ C++"
	depends on !BR2_INSTALL_LIBSTDCPP
```

## package/batocera/libraries/plutovg/Config.in
```kconfig
config BR2_PACKAGE_PLUTOVG
	bool "plutosvg"
	depends on BR2_INSTALL_LIBSTDCPP

	help
	  PlutoVG is a standalone 2D vector graphics library.

	  https://github.com/sammycage/plutovg

comment "BR2_PACKAGE_PLUTOVG needs a toolchain w/ C++"
	depends on !BR2_INSTALL_LIBSTDCPP
```

## package/batocera/libraries/pm_auto/Config.in
```kconfig
config BR2_PACKAGE_PM_AUTO
	bool "pm_auto"
	select BR2_PACKAGE_PYTHON_ADAFRUIT_CIRCUITPYTHON_NEOPIXEL_SPI
	select BR2_PACKAGE_PYTHON_ADAFRUIT_CIRCUITPYTHON_REQUESTS
	select BR2_PACKAGE_PYTHON_GPIOZERO
	select BR2_PACKAGE_PYTHON_INFLUXDB
	select BR2_PACKAGE_PYTHON_LGPIO
	select BR2_PACKAGE_PYTHON_PILLOW
	select BR2_PACKAGE_PYTHON_PSUTIL
	select BR2_PACKAGE_PYTHON_SMBUS3
	select BR2_PACKAGE_PYTHON_GPIOD

	help
	  Library for monitoring Raspberry Pi system status.

	  https://github.com/sunfounder/pm_auto
```

## package/batocera/libraries/pm_dashboard/Config.in
```kconfig
config BR2_PACKAGE_PM_DASHBOARD
	bool "pm_dashboard"
	select BR2_PACKAGE_INFLUXDB
	select BR2_PACKAGE_PYTHON_FLASK
	select BR2_PACKAGE_PYTHON_FLASK_CORS
	select BR2_PACKAGE_PYTHON_INFLUXDB

	help
	  Pironman Dashboard.

	  https://github.com/sunfounder/pm_dashboard
```

## package/batocera/libraries/python-adafruit-circuitpython-busdevice/Config.in
```kconfig
config BR2_PACKAGE_PYTHON_ADAFRUIT_CIRCUITPYTHON_BUSDEVICE
	bool "python-adafruit-circuitpython-busdevice"
	select BR2_PACKAGE_PYTHON_ADAFRUIT_BLINKA
	select BR2_PACKAGE_PYTHON_ADAFRUIT_CIRCUITPYTHON_TYPING

	help
	  CircuitPython bus device classes to manage bus sharing.

	  https://github.com/adafruit/Adafruit_CircuitPython_BusDevice
```

## package/batocera/libraries/python-adafruit-circuitpython-neopixel-spi/Config.in
```kconfig
config BR2_PACKAGE_PYTHON_ADAFRUIT_CIRCUITPYTHON_NEOPIXEL_SPI
	bool "python-adafruit-circuitpython-neopixel-spi"
	select BR2_PACKAGE_PYTHON_ADAFRUIT_BLINKA
	select BR2_PACKAGE_PYTHON_ADAFRUIT_CIRCUITPYTHON_BUSDEVICE
	select BR2_PACKAGE_PYTHON_ADAFRUIT_CIRCUITPYTHON_PIXELBUF
	help
	  SPI driven CircuitPython driver for neopixels.

	  https://github.com/adafruit/Adafruit_CircuitPython_NeoPixel_SPI
```

## package/batocera/libraries/python-adafruit-circuitpython-pixelbuf/Config.in
```kconfig
config BR2_PACKAGE_PYTHON_ADAFRUIT_CIRCUITPYTHON_PIXELBUF
	bool "python-adafruit-circuitpython-pixelbuf"
	select BR2_PACKAGE_PYTHON_ADAFRUIT_BLINKA
	help
	  A pure Python implementation of adafruit_pixelbuf for
	  smaller boards.

	  https://github.com/adafruit/Adafruit_CircuitPython_Pixelbuf.git
```

## package/batocera/libraries/python-adafruit-circuitpython-requests/Config.in
```kconfig
config BR2_PACKAGE_PYTHON_ADAFRUIT_CIRCUITPYTHON_REQUESTS
	bool "python-adafruit-circuitpython-requests"
	select BR2_PACKAGE_PYTHON_ADAFRUIT_BLINKA
	select BR2_PACKAGE_PYTHON_ADAFRUIT_CIRCUITPYTHON_CONNECTIONMANAGER
	help
	  A requests-like library for web interfacing.

	  https://github.com/adafruit/Adafruit_CircuitPython_Requests
```

## package/batocera/libraries/python-binho-host-adapter/Config.in
```kconfig
config BR2_PACKAGE_PYTHON_BINHO_HOST_ADAPTER
	bool "python-binho-host-adapter"
	select BR2_PACKAGE_PYTHON_SERIAL

	help
	  Python Libraries for Binho Multi-Protocol USB Host Adapters.

	  https://binho.io
```

## package/batocera/libraries/python-gpiod/Config.in
```kconfig
config BR2_PACKAGE_PYTHON_GPIOD
	bool "python-gpiod"

	help
	  gpiod Python library with almost the same
	  usage as libgpiodcxx.

	  https://pypi.org/project/gpiod/
```

## package/batocera/libraries/python-lgpio/Config.in
```kconfig
config BR2_PACKAGE_PYTHON_LGPIO
	bool "python-lgpio"
	select BR2_PACKAGE_LIBLGPIO
	help
	  lgpio is a module for Linux Single Board Computers
	  which allows control of the General Purpose Input Outputs.

	  https://pypi.org/project/lgpio
```

## package/batocera/libraries/python-proxy-tools/Config.in
```kconfig
config BR2_PACKAGE_PYTHON_PROXY_TOOLS
	bool "python-proxy-tools"
	help
	  Proxy Implementation.

	  http://github.com/jtushman/proxy_tools
```

## package/batocera/libraries/python-smbus3/Config.in
```kconfig
config BR2_PACKAGE_PYTHON_SMBUS3
	bool "python-smbus3"
	help
	  smbus3 is a drop-in replacement for smbus2, smbus-cffi,
	  smbus-python written in pure Python, intended for use with
	  Python 3.8+ on Unix-like systems.

	  https://github.com/eindiran/smbus3
```

## package/batocera/libraries/python-sysv-ipc/Config.in
```kconfig
config BR2_PACKAGE_PYTHON_SYSV_IPC
	bool "python-sysv-ipc"

	help
	  System V IPC primitives for Python

	  https://pypi.org/project/sysv-ipc
```

## package/batocera/libraries/sdl12-compat/Config.in
```kconfig
config BR2_PACKAGE_SDL12_COMPAT
	bool "sdl12-compat"
	select BR2_PACKAGE_SDL2

	help
	  An SDL-1.2 compatibility layer that uses SDL 2.0 behind the scenes.
```

## package/batocera/libraries/sdl2-compat/Config.in
```kconfig
config BR2_PACKAGE_SDL2_COMPAT
    bool "sdl2-compat"
    select BR2_PACKAGE_SDL2

      help
        An SDL-1.2 compatibility layer that uses SDL 2.0 behind the scenes.
```
