## package/batocera/libraries/sdl3/Config.in
```kconfig
config BR2_PACKAGE_SDL3
	bool "sdl3"
	depends on !BR2_STATIC_LIBS
	depends on BR2_PACKAGE_XORG7
	select BR2_PACKAGE_LIBDRM
	select BR2_PACKAGE_LIBXKBCOMMON
	select BR2_PACKAGE_WAYLAND_PROTOCOLS
	select BR2_PACKAGE_XLIB_LIBX11
	select BR2_PACKAGE_XLIB_LIBXEXT

	help
	  Simple DirectMedia Layer 3 - SDL2 is a library that allows
	  programs portable low level access to a video framebuffer,
	  audio output, mouse, and keyboard.

	  http://www.libsdl.org/
```

## package/batocera/libraries/semver/Config.in
```kconfig
config BR2_PACKAGE_SEMVER
	bool "semver"

	help
	  Lightweight C++ command line option parser.
```

## package/batocera/libraries/sf_rpi_status/Config.in
```kconfig
config BR2_PACKAGE_SF_RPI_STATUS
	bool "sf_rpi_status"
	select BR2_PACKAGE_PYTHON_PSUTIL
	select BR2_PACKAGE_PYTHON_REQUESTS

	help
	  SunFounder Raspberry Pi Status python package.

	  https://github.com/sunfounder/sf_rpi_status
```

## package/batocera/ports/32bit/box86/Config.in
```kconfig
config BR2_PACKAGE_BOX86
	bool "box86"
	select BR2_PACKAGE_OPENAL
	select BR2_PACKAGE_LIBZLIB
	select BR2_PACKAGE_LIBZIP
	select BR2_PACKAGE_BZIP2
	select BR2_PACKAGE_LIBPNG
	select BR2_PACKAGE_FREETYPE
	select BR2_PACKAGE_SDL2
	select BR2_PACKAGE_SDL2_IMAGE
	depends on BR2_INSTALL_LIBSTDCPP

	help
	  Box86 - Linux Userspace x86 Emulator with a twist, targeted at ARM Linux devices

	  https://github.com/ptitseb/box86

comment "BR2_PACKAGE_BOX86 needs a toolchain w/ C++"
	depends on !BR2_INSTALL_LIBSTDCPP
```

## package/batocera/ports/32bit/droidports/Config.in
```kconfig
config BR2_PACKAGE_DROIDPORTS
	bool "droidports"
	select BR2_PACKAGE_OPENAL
	select BR2_PACKAGE_LIBZLIB
	select BR2_PACKAGE_LIBZIP
	select BR2_PACKAGE_BZIP2
	select BR2_PACKAGE_LIBPNG
	select BR2_PACKAGE_FREETYPE
	select BR2_PACKAGE_SDL2
	select BR2_PACKAGE_SDL2_IMAGE
	depends on BR2_INSTALL_LIBSTDCPP
	help
	  GMLoader - play GameMaker Studio games for Android on non-Android operating systems.

	  https://github.com/JohnnyonFlame/droidports

comment "BR2_PACKAGE_DROIDPORTS needs a toolchain w/ C++"
	depends on !BR2_INSTALL_LIBSTDCPP
```

## package/batocera/ports/32bit/lib32bit-packager/Config.in
```kconfig
config BR2_PACKAGE_LIB32BIT_PACKAGER
    bool "lib32bit-packager"
    help
      32bit libs packer
```

## package/batocera/ports/32bit/sorr/Config.in
```kconfig
config BR2_PACKAGE_SORR
	bool "bennugd-bgdi"
	depends on BR2_INSTALL_LIBSTDCPP
	select BR2_PACKAGE_SDL2
	select BR2_PACKAGE_SDL2_MIXER
	select BR2_PACKAGE_LIBOGG
	select BR2_PACKAGE_LIBPNG
	select BR2_PACKAGE_LIBTHEORA
	select BR2_PACKAGE_LIBVORBIS

	help
	  BennuGD is an open source video game development language,
	  with a modular design designed to facilitate the portability
	  of the projects carried out in it, making this language
	  one of the best.
```

## package/batocera/ports/alephone/Config.in
```kconfig
config BR2_PACKAGE_ALEPHONE
	bool "alephone"
	depends on BR2_INSTALL_LIBSTDCPP
	depends on BR2_PACKAGE_BOOST
	select BR2_PACKAGE_OPENAL
	select BR2_PACKAGE_SDL2
	select BR2_PACKAGE_SDL2_IMAGE
	select BR2_PACKAGE_SDL2_TTF
	select BR2_PACKAGE_SDL2_NET

	help
	  Aleph One is the open source continuation of
	  Bungies Marathon 2 game engine.

	  https://alephone.lhowon.org/
```

## package/batocera/ports/avp/Config.in
```kconfig
config BR2_PACKAGE_AVP
	bool "AVP"
	depends on BR2_INSTALL_LIBSTDCPP
	select BR2_PACKAGE_BATOCERA_SDL3

	help
	  Want to play Aliens versus Predator (1999) in Linux?

	  http://icculus.org/avp/
```

## package/batocera/ports/awgl/Config.in
```kconfig
config BR2_PACKAGE_AWGL
	bool "awgl"
	depends on BR2_INSTALL_LIBSTDCPP
	select BR2_PACKAGE_MT32EMU
	select BR2_PACKAGE_SDL2
	select BR2_PACKAGE_SDL2_MIXER

	help
	  awgl is a re-implementation of the engine used in the
	  game Another World.

	  https://github.com/cyxx/rawgl

comment "BR2_PACKAGE_AWGL needs a toolchain w/ C++"
	depends on !BR2_INSTALL_LIBSTDCPP
```

## package/batocera/ports/bermuda/Config.in
```kconfig
config BR2_PACKAGE_BERMUDA
	bool "BERMUDA"
	select BR2_PACKAGE_SDL2
	select BR2_PACKAGE_SDL2_MIXER
	depends on BR2_INSTALL_LIBSTDCPP
	help
	  Bermuda Syndrome - Open Source Engine.

	  https://github.com/cyxx/bermuda

comment "BR2_PACKAGE_BERMUDA needs a toolchain w/ C++"
	depends on !BR2_INSTALL_LIBSTDCPP
```

## package/batocera/ports/blues/Config.in
```kconfig
config BR2_PACKAGE_BLUES
	bool "blues"
	depends on BR2_INSTALL_LIBSTDCPP
	select BR2_PACKAGE_SDL2
	select BR2_PACKAGE_SDL2_MIXER

	help
	  This is a rewrite of
	  - Blues Brothers
	  - Blues Brothers: Jukebox Adventure
	  game engines developed by Titus Interactive.

	  There is also support for Prehistorik 2.

	  https://github.com/cyxx/blues

comment "BR2_PACKAGE_BLUES needs a toolchain w/ C++"
	depends on !BR2_INSTALL_LIBSTDCPP
```

## package/batocera/ports/box64/Config.in
```kconfig
config BR2_PACKAGE_BOX64
	bool "box64"
	select BR2_PACKAGE_OPENAL
	select BR2_PACKAGE_LIBZLIB
	select BR2_PACKAGE_LIBZIP
	select BR2_PACKAGE_BZIP2
	select BR2_PACKAGE_LIBPNG
	select BR2_PACKAGE_FREETYPE
	select BR2_PACKAGE_SDL2
	select BR2_PACKAGE_SDL2_IMAGE
	depends on BR2_INSTALL_LIBSTDCPP

	help
	  Box64 - Linux Userspace x86_64 Emulator with a twist, targeted at ARM64 Linux devices

	  https://github.com/ptitseb/box64

comment "BR2_PACKAGE_BOX64 needs a toolchain w/ C++"
	depends on !BR2_INSTALL_LIBSTDCPP
```

## package/batocera/ports/broguece/Config.in
```kconfig
config BR2_PACKAGE_BROGUECE
	bool "broguece"
	depends on BR2_PACKAGE_SDL2
	depends on BR2_PACKAGE_SDL2_IMAGE
	help
	  Brogue Community Edition - a community-lead fork of the much-loved minimalist roguelike game.

	  https://github.com/tmewett/BrogueCE
```

## package/batocera/ports/bstone/Config.in
```kconfig
config BR2_PACKAGE_BSTONE
	bool "bstone"

	depends on BR2_INSTALL_LIBSTDCPP
	select BR2_PACKAGE_OPENAL
	select BR2_PACKAGE_SDL2
	select BR2_PACKAGE_SDL2_MIXER

	help
	  Unofficial source port for Blake Stone series
	  (Aliens Of Gold and Planet Strike).

	  https://github.com/bibendovsky/bstone
```

## package/batocera/ports/cdogs/Config.in
```kconfig
config BR2_PACKAGE_CDOGS
	bool "cdogs"
	depends on BR2_INSTALL_LIBSTDCPP
	select BR2_PACKAGE_SDL2
	select BR2_PACKAGE_SDL2_IMAGE
	select BR2_PACKAGE_SDL2_MIXER
	select BR2_PACKAGE_ENET

	help
	  Classic overhead run-and-gun game

	  https://cxong.github.io/cdogs-sdl/

comment "BR2_PACKAGE_CDOGS needs a toolchain w/ C++"
	depends on !BR2_INSTALL_LIBSTDCPP
```

## package/batocera/ports/corsixth/Config.in
```kconfig
config BR2_PACKAGE_CORSIXTH
    bool "corsixth"
	select BR2_PACKAGE_LPEG
	select BR2_PACKAGE_LUA
	select BR2_PACKAGE_LUA_LPEG_PATTERNS
	select BR2_PACKAGE_LUAFILESYSTEM
	select BR2_PACKAGE_LUASEC
	select BR2_PACKAGE_LUASOCKET
	select BR2_PACKAGE_SDL2
	select BR2_PACKAGE_SDL2_IMAGE

    help
	  CorsixTH - Theme Hospital engine

	  https://github.com/CorsixTH/CorsixTH
```

## package/batocera/ports/devilutionx/Config.in
```kconfig
config BR2_PACKAGE_DEVILUTIONX
	bool "devilutionx"
	select BR2_PACKAGE_BZIP2
	select BR2_PACKAGE_FMT
	select BR2_PACKAGE_LIBSODIUM
	select BR2_PACKAGE_LPEG
	select BR2_PACKAGE_LUA
	select BR2_PACKAGE_LUA_LPEG_PATTERNS
	select BR2_PACKAGE_LUAFILESYSTEM
	select BR2_PACKAGE_LUASEC
	select BR2_PACKAGE_SDL2
	select BR2_PACKAGE_SDL2_IMAGE

	help
	  A Diablo 1 port for modern operating systems.

	  https://github.com/diasurgical/devilutionX/
```

## package/batocera/ports/doom/doom3/Config.in
```kconfig
config BR2_PACKAGE_DOOM3
	bool "doom3"
	select BR2_PACKAGE_DHEWM3
	select BR2_PACKAGE_BLOODMOD
	select BR2_PACKAGE_CDOOM
	select BR2_PACKAGE_D3LE
	select BR2_PACKAGE_DENTONMOD
	select BR2_PACKAGE_DESOLATED
	select BR2_PACKAGE_ELDOOM
	select BR2_PACKAGE_FITZ
	select BR2_PACKAGE_GRIMM
	select BR2_PACKAGE_HARDCORPS
	select BR2_PACKAGE_PERFECTED
	select BR2_PACKAGE_REALGIBS
	select BR2_PACKAGE_RIVENSIN
	select BR2_PACKAGE_SIKKMOD

	help
	  dhewm 3 is a Doom 3 GPL source port

	  https://dhewm3.org/

source "$BR2_EXTERNAL_BATOCERA_PATH/package/batocera/ports/doom/doom3/bloodmod/Config.in"
source "$BR2_EXTERNAL_BATOCERA_PATH/package/batocera/ports/doom/doom3/cdoom/Config.in"
source "$BR2_EXTERNAL_BATOCERA_PATH/package/batocera/ports/doom/doom3/d3le/Config.in"
source "$BR2_EXTERNAL_BATOCERA_PATH/package/batocera/ports/doom/doom3/dentonmod/Config.in"
source "$BR2_EXTERNAL_BATOCERA_PATH/package/batocera/ports/doom/doom3/desolated/Config.in"
source "$BR2_EXTERNAL_BATOCERA_PATH/package/batocera/ports/doom/doom3/dhewm3/Config.in"
source "$BR2_EXTERNAL_BATOCERA_PATH/package/batocera/ports/doom/doom3/eldoom/Config.in"
source "$BR2_EXTERNAL_BATOCERA_PATH/package/batocera/ports/doom/doom3/fitz/Config.in"
source "$BR2_EXTERNAL_BATOCERA_PATH/package/batocera/ports/doom/doom3/grimm/Config.in"
source "$BR2_EXTERNAL_BATOCERA_PATH/package/batocera/ports/doom/doom3/hardcorps/Config.in"
source "$BR2_EXTERNAL_BATOCERA_PATH/package/batocera/ports/doom/doom3/perfected/Config.in"
source "$BR2_EXTERNAL_BATOCERA_PATH/package/batocera/ports/doom/doom3/realgibs/Config.in"
source "$BR2_EXTERNAL_BATOCERA_PATH/package/batocera/ports/doom/doom3/rivensin/Config.in"
source "$BR2_EXTERNAL_BATOCERA_PATH/package/batocera/ports/doom/doom3/sikkmod/Config.in"
```

## package/batocera/ports/doom/doomretro/Config.in
```kconfig
config BR2_PACKAGE_DOOMRETRO
	bool "doomretro"
	depends on BR2_INSTALL_LIBSTDCPP
	select BR2_PACKAGE_SDL2
	select BR2_PACKAGE_SDL2_IMAGE
	select BR2_PACKAGE_SDL2_MIXER

	help
	  The classic, refined DOOM source port.

	  www.doomretro.com

comment "BR2_PACKAGE_DOOMRETRO needs a toolchain w/ C++"
	depends on !BR2_INSTALL_LIBSTDCPP
```

## package/batocera/ports/doom/gzdoom/Config.in
```kconfig
config BR2_PACKAGE_GZDOOM
	bool "gzdoom"
    depends on BR2_INSTALL_LIBSTDCPP
    select BR2_PACKAGE_SDL2
    select BR2_PACKAGE_SDL2_NET
    select BR2_PACKAGE_SDL2_MIXER
    select BR2_PACKAGE_LIBJPEG
    select BR2_PACKAGE_LIBGL
    select BR2_PACKAGE_OPENAL
    select BR2_PACKAGE_ZMUSIC
	select BR2_HOST_PACKAGE_ZMUSIC

	help
	  GZDoom is a feature centric port for all Doom engine games, based on ZDoom, adding an OpenGL renderer and powerful scripting capabilities

	  gzdoom.drdteam.org
```

## package/batocera/ports/doom/lzdoom/Config.in
```kconfig
config BR2_PACKAGE_LZDOOM
	bool "lzdoom"
    depends on BR2_INSTALL_LIBSTDCPP
    select BR2_PACKAGE_SDL2
    select BR2_PACKAGE_SDL2_NET
    select BR2_PACKAGE_SDL2_MIXER
    select BR2_PACKAGE_LIBJPEG
    select BR2_PACKAGE_LIBGL
    select BR2_PACKAGE_OPENAL
    select BR2_PACKAGE_ZMUSIC
	select BR2_HOST_PACKAGE_ZMUSIC

	help
	  LZDoom is a classic style GZDoom fork with lower system requirements

	  gzdoom.drdteam.org
```

## package/batocera/ports/doom/raze/Config.in
```kconfig
config BR2_PACKAGE_RAZE
	bool "RAZE"
	select BR2_PACKAGE_SDL2
	select BR2_PACKAGE_SDL2_MIXER
	select BR2_PACKAGE_ZMUSIC
	select BR2_HOST_PACKAGE_ZMUSIC
	depends on BR2_INSTALL_LIBSTDCPP
	help
	  RBuild engine port backed by GZDoom tech. Currently supports Duke Nukem 3D, Blood, Shadow Warrior, Redneck Rampage and Powerslave/Exhumed.

	  https://github.com/coelckers/Raze

comment "BR2_PACKAGE_RAZE needs a toolchain w/ C++"
	depends on !BR2_INSTALL_LIBSTDCPP
```

## package/batocera/ports/doom/zdoom/Config.in
```kconfig
config BR2_PACKAGE_ZDOOM
	bool "zdoom"
	select BR2_PACKAGE_SDL2
	select BR2_PACKAGE_SDL2_MIXER
	select BR2_PACKAGE_ZMUSIC
	select BR2_HOST_PACKAGE_ZMUSIC
	depends on BR2_INSTALL_LIBSTDCPP
	help
	  Highly moddable Doom engine with support for all Doom engine games
```

## package/batocera/ports/doom/zmusic/Config.in
```kconfig
config BR2_PACKAGE_ZMUSIC
	bool "zmusic"
    select BR2_PACKAGE_ALSA_LIB
    select BR2_PACKAGE_FLUIDSYNTH
    select BR2_PACKAGE_LIBSNDFILE
    select BR2_PACKAGE_MPG123
    select BR2_PACKAGE_ZLIB
	help
	  GZDoom's music system as a standalone library

	  gzdoom.drdteam.org

comment "BR2_PACKAGE_ZMUSIC needs a toolchain w/ C++"
	depends on !BR2_INSTALL_LIBSTDCPP
```
