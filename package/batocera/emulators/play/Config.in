## package/batocera/emulators/play/Config.in
```kconfig
config BR2_PACKAGE_PLAY
    bool "play"
    select BR2_PACKAGE_PCRE2
    select BR2_PACKAGE_LIBCURL
    select BR2_PACKAGE_LIBCURL_OPENSSL
    select BR2_PACKAGE_LIBGLEW                   if  BR2_PACKAGE_BATOCERA_TARGET_X86_64_ANY
    select BR2_PACKAGE_OPENAL
    select BR2_PACKAGE_SQLITE
    select BR2_PACKAGE_VULKAN_HEADERS            if  BR2_PACKAGE_BATOCERA_VULKAN
    select BR2_PACKAGE_VULKAN_LOADER             if  BR2_PACKAGE_BATOCERA_VULKAN
    # QT6
    select BR2_PACKAGE_QT6                       if BR2_PACKAGE_BATOCERA_TARGET_X86_64_ANY
    select BR2_PACKAGE_QT6BASE                   if BR2_PACKAGE_BATOCERA_TARGET_X86_64_ANY
    select BR2_PACKAGE_QT6BASE_CONCURRENT        if BR2_PACKAGE_BATOCERA_TARGET_X86_64_ANY
    select BR2_PACKAGE_QT6BASE_DBUS              if BR2_PACKAGE_BATOCERA_TARGET_X86_64_ANY
    select BR2_PACKAGE_QT6BASE_EGLFS             if BR2_PACKAGE_BATOCERA_TARGET_X86_64_ANY
    select BR2_PACKAGE_QT6BASE_FONTCONFIG        if BR2_PACKAGE_BATOCERA_TARGET_X86_64_ANY
    select BR2_PACKAGE_QT6BASE_GIF               if BR2_PACKAGE_BATOCERA_TARGET_X86_64_ANY
    select BR2_PACKAGE_QT6BASE_GUI               if BR2_PACKAGE_BATOCERA_TARGET_X86_64_ANY
    select BR2_PACKAGE_QT6BASE_HARFBUZZ          if BR2_PACKAGE_BATOCERA_TARGET_X86_64_ANY
    select BR2_PACKAGE_QT6BASE_JPEG              if BR2_PACKAGE_BATOCERA_TARGET_X86_64_ANY
    select BR2_PACKAGE_QT6BASE_NETWORK           if BR2_PACKAGE_BATOCERA_TARGET_X86_64_ANY
    select BR2_PACKAGE_QT6BASE_OPENGL_DESKTOP    if BR2_PACKAGE_BATOCERA_TARGET_X86_64_ANY
    select BR2_PACKAGE_QT6BASE_PNG               if BR2_PACKAGE_BATOCERA_TARGET_X86_64_ANY
    select BR2_PACKAGE_QT6BASE_PRINTSUPPORT      if BR2_PACKAGE_BATOCERA_TARGET_X86_64_ANY
    select BR2_PACKAGE_QT6SVG                    if BR2_PACKAGE_BATOCERA_TARGET_X86_64_ANY
    select BR2_PACKAGE_QT6BASE_WIDGETS           if BR2_PACKAGE_BATOCERA_TARGET_X86_64_ANY
    select BR2_PACKAGE_QT6BASE_XCB               if BR2_PACKAGE_BATOCERA_TARGET_X86_64_ANY
    select BR2_PACKAGE_QT6BASE_XML               if BR2_PACKAGE_BATOCERA_TARGET_X86_64_ANY
    help
      Play! is a PlayStation2 emulator.

      https://purei.org/
```

## package/batocera/emulators/ppsspp/Config.in
```kconfig
config BR2_PACKAGE_PPSSPP
	bool "ppsspp"
	select BR2_PACKAGE_LIBGLEW        if BR2_PACKAGE_BATOCERA_TARGET_X86_ANY
	select BR2_PACKAGE_LIBGLU         if BR2_PACKAGE_BATOCERA_TARGET_X86_ANY
	select BR2_PACKAGE_LIBZIP
	select BR2_PACKAGE_SDL3
	select BR2_PACKAGE_SDL3_TTF

	help
	  A  PSP emulator
```

## package/batocera/emulators/retroarch/libretro-core-info/Config.in
```kconfig
config BR2_PACKAGE_LIBRETRO_CORE_INFO
	bool "libretro-core-info"

	help
	  libretro core info files.

	  http://www.libretro.com
```

## package/batocera/emulators/retroarch/libretro/libretro-a5200/Config.in
```kconfig
config BR2_PACKAGE_LIBRETRO_A5200
	bool "libretro-a5200"
	depends on BR2_PACKAGE_RETROARCH
	depends on BR2_INSTALL_LIBSTDCPP
	help
	  A libretro Atari 5200 emulator.

	  http://www.libretro.com
```

## package/batocera/emulators/retroarch/libretro/libretro-arduous/Config.in
```kconfig
config BR2_PACKAGE_LIBRETRO_ARDUOUS
    bool "libretro-arduous"
    depends on BR2_PACKAGE_RETROARCH
    depends on BR2_INSTALL_LIBSTDCPP
    depends on BR2_GCC_ENABLE_OPENMP

    help
      A Libretro emulator core for the Arduboy

	  http://www.libretro.com
```

## package/batocera/emulators/retroarch/libretro/libretro-azahar/Config.in
```kconfig
config BR2_PACKAGE_LIBRETRO_AZAHAR
	bool "libretro-azahar"
	depends on BR2_INSTALL_LIBSTDCPP
	select BR2_PACKAGE_AZAHAR

	help
	  Azahar is a Citra fork and emulator for the Nintendo 3DS.

	  https://github.com/azahar-emu/azahar


comment "LIBRETRO_AZAHAR needs a toolchain w/ C++"
	depends on !BR2_INSTALL_LIBSTDCPP
```

## package/batocera/emulators/retroarch/libretro/libretro-bennugd/Config.in
```kconfig
config BR2_PACKAGE_LIBRETRO_BENNUGD
	bool "libretro-bennugd"
	depends on BR2_INSTALL_LIBSTDCPP

	help
	  libretro core for for BennuGD

	  https://github.com/diekleinekuh/BennuGD_libretro

comment "BR2_PACKAGE_LIBRETRO_BENNUGD needs a toolchain w/ C++"
	depends on !BR2_INSTALL_LIBSTDCPP
```

## package/batocera/emulators/retroarch/libretro/libretro-bk-emulator/Config.in
```kconfig
config BR2_PACKAGE_LIBRETRO_BK_EMULATOR
	bool "libretro-bk"
	depends on BR2_PACKAGE_RETROARCH
	depends on BR2_INSTALL_LIBSTDCPP

	help
	  A libretro BK computer serie emulator core.

	  http://www.libretro.com

comment "LIBRETRO_BK_EMULATOR needs a toolchain w/ C++"
	depends on !BR2_INSTALL_LIBSTDCPP
```

## package/batocera/emulators/retroarch/libretro/libretro-boom3/Config.in
```kconfig
config BR2_PACKAGE_LIBRETRO_BOOM3
        bool "libretro-boom3"
	depends on BR2_PACKAGE_RETROARCH
	depends on BR2_INSTALL_LIBSTDCPP
        help
          A libretro Doom 3 engine

	  http://www.libretro.com

comment "LIBRETRO_BOOM3 needs a toolchain w/ C++"
	depends on !BR2_INSTALL_LIBSTDCPP
```

## package/batocera/emulators/retroarch/libretro/libretro-brimir/Config.in
```kconfig
config BR2_PACKAGE_LIBRETRO_BRIMIR
	bool "libretro-brimir"

	help
	  Sega Saturn emulation for RetroArch via libretro.
	  Performance-focused fork built on Ymir.

	  https://github.com/coredds/brimir
```

## package/batocera/emulators/retroarch/libretro/libretro-bsnes-jg/Config.in
```kconfig
config BR2_PACKAGE_LIBRETRO_BSNES_JG
	bool "libretro-bsnes-jg"
	depends on BR2_INSTALL_LIBSTDCPP

	help
	  bsnes-jg is a cycle accurate emulator for the
	  Super Famicom/Super Nintendo Entertainment System,
	  including support for the Super Game Boy, BS-X
	  Satellaview, and Sufami Turbo.

	  https://github.com/libretro/bsnes-jg
```

## package/batocera/emulators/retroarch/libretro/libretro-cannonball/Config.in
```kconfig
config BR2_PACKAGE_LIBRETRO_CANNONBALL
	bool "libretro-cannonball"
	depends on BR2_PACKAGE_RETROARCH
	depends on BR2_INSTALL_LIBSTDCPP

	help
	  Cannonball: An Enhanced OutRun Engine.

	  http://www.libretro.com

comment "LIBRETRO_CANNONBALL needs a toolchain w/ C++"
	depends on !BR2_INSTALL_LIBSTDCPP
```

## package/batocera/emulators/retroarch/libretro/libretro-clownmdemu/Config.in
```kconfig
config BR2_PACKAGE_LIBRETRO_CLOWNMDEMU
	bool "libretro-clownmdemu"

	depends on BR2_INSTALL_LIBSTDCPP

	  help
	  This is ClownMDEmu, a Sega Mega Drive emulator.

	  https://github.com/Clownacy/clownmdemu-libretro

comment "LIBRETRO_CLOWNMDEMU needs a toolchain w/ C++"
    depends on !BR2_INSTALL_LIBSTDCPP
```

## package/batocera/emulators/retroarch/libretro/libretro-dolphin/Config.in
```kconfig
config BR2_PACKAGE_LIBRETRO_DOLPHIN
	bool "libretro-dolphin"
	depends on BR2_PACKAGE_RETROARCH
	depends on BR2_INSTALL_LIBSTDCPP
	select BR2_PACKAGE_FFMPEG
	select BR2_PACKAGE_LIBCURL
	select BR2_PACKAGE_BLUEZ5_UTILS
	help
	  A libretro Nintendo WII core

	  http`://www.libretro.com

comment "LIBRETRO_DOLPHIN needs a toolchain w/ C++"
	depends on !BR2_INSTALL_LIBSTDCPP
```

## package/batocera/emulators/retroarch/libretro/libretro-doublecherrygb/Config.in
```kconfig
config BR2_PACKAGE_LIBRETRO_DOUBLECHERRYGB
	bool "libretro-doublecherrygb"
	depends on BR2_PACKAGE_RETROARCH
	depends on BR2_INSTALL_LIBSTDCPP

	help
	  A libretro gameboy core with up to 16 players support

	  https://timoelrichs.is-a.dev/

comment "LIBRETRO_DOUBLECHERRYGB needs a toolchain w/ C++"
	depends on !BR2_INSTALL_LIBSTDCPP
```

## package/batocera/emulators/retroarch/libretro/libretro-duckstation/Config.in
```kconfig
config BR2_PACKAGE_LIBRETRO_DUCKSTATION
	bool "libretro-duckstation"

	help
	  LR-Duckstation - PlayStation1 PSX Emulator
```

## package/batocera/emulators/retroarch/libretro/libretro-ecwolf/Config.in
```kconfig
config BR2_PACKAGE_LIBRETRO_ECWOLF
	bool "libretro-ecwolf"
	depends on BR2_PACKAGE_RETROARCH
	depends on BR2_INSTALL_LIBSTDCPP
	help	
	  A libretro Wolfenstein 3D source port game engine.
	  
	  http://www.libretro.com

comment "LIBRETRO_ECWOLF needs a toolchain w/ C++"
	depends on !BR2_INSTALL_LIBSTDCPP
```

## package/batocera/emulators/retroarch/libretro/libretro-ep128emu/Config.in
```kconfig
config BR2_PACKAGE_LIBRETRO_EP128EMU
	bool "libretro-ep128emu"
	depends on BR2_PACKAGE_RETROARCH
	depends on BR2_INSTALL_LIBSTDCPP

	help
	  Libretro core version of ep128emu.

	  http://www.libretro.com

comment "LIBRETRO_EP128EMU needs a toolchain w/ C++"
	depends on !BR2_INSTALL_LIBSTDCPP
```

## package/batocera/emulators/retroarch/libretro/libretro-fake08/Config.in
```kconfig
config BR2_PACKAGE_LIBRETRO_FAKE08
	bool "libretro-retro8"
	depends on BR2_PACKAGE_RETROARCH
	depends on BR2_INSTALL_LIBSTDCPP
	help
	  A Pico-8 player/emulator for console homebrew

comment "LIBRETRO_FAKE08 needs a toolchain w/ C++"
	depends on !BR2_INSTALL_LIBSTDCPP
```

## package/batocera/emulators/retroarch/libretro/libretro-ffmpeg/Config.in
```kconfig
config BR2_PACKAGE_LIBRETRO_FFMPEG
	bool "libretro-ffmpeg"
	depends on BR2_PACKAGE_RETROARCH
	depends on BR2_INSTALL_LIBSTDCPP
	help
	  Video/music player implemented in libretro.

	  http://www.libretro.com

comment "LIBRETRO_FFMPEG needs a toolchain w/ C++"
	depends on !BR2_INSTALL_LIBSTDCPP
```

## package/batocera/emulators/retroarch/libretro/libretro-flycast2021/Config.in
```kconfig
config BR2_PACKAGE_LIBRETRO_FLYCAST2021
	bool "libretro-flycast2021"
	depends on BR2_PACKAGE_RETROARCH
	depends on BR2_INSTALL_LIBSTDCPP
	depends on BR2_GCC_ENABLE_OPENMP
	help
	  A libretro dreamcast emulator core.

	  http://www.libretro.com

comment "LIBRETRO_FLYCAST2021 needs a toolchain w/ C++"
	depends on !BR2_INSTALL_LIBSTDCPP
```

## package/batocera/emulators/retroarch/libretro/libretro-flycast2022/Config.in
```kconfig
config BR2_PACKAGE_LIBRETRO_FLYCAST2022
        bool "libretro-flycast2022"
	depends on BR2_PACKAGE_RETROARCH
	depends on BR2_INSTALL_LIBSTDCPP
	depends on BR2_GCC_ENABLE_OPENMP
        help
          A libretro dreamcast emulator core.

	  http://www.libretro.com

comment "LIBRETRO_FLYCAST2022 needs a toolchain w/ C++"
	depends on !BR2_INSTALL_LIBSTDCPP
```

## package/batocera/emulators/retroarch/libretro/libretro-freej2me/Config.in
```kconfig
config BR2_PACKAGE_LIBRETRO_FREEJ2ME
	bool "libretro-freej2me"
	depends on BR2_INSTALL_LIBSTDCPP
	select BR2_PACKAGE_OPENJDK
	select BR2_PACKAGE_OPENJDK_X11

	help
	  A free J2ME emulator.

	  http://libretro.com

comment "LIBRETRO_FREEJ2ME needs a toolchain w/ C++"
	depends on !BR2_INSTALL_LIBSTDCPP
```

## package/batocera/emulators/retroarch/libretro/libretro-geargrafx/Config.in
```kconfig
config BR2_PACKAGE_LIBRETRO_GEARGRAFX
	bool "libretro-geargrafx"
	depends on BR2_INSTALL_LIBSTDCPP

	help
	  Geargrafx is an accurate cross-platform TurboGrafx-16 /
	  PC Engine emulator

	  https://github.com/drhelius/Geargrafx

comment "LIBRETRO_GEARGRAFX needs a toolchain w/ C++"
	depends on !BR2_INSTALL_LIBSTDCPP
```

## package/batocera/emulators/retroarch/libretro/libretro-geolith/Config.in
```kconfig
config BR2_PACKAGE_LIBRETRO_GEOLITH
	bool "libretro-geolith"
	depends on BR2_PACKAGE_RETROARCH
	depends on BR2_INSTALL_LIBSTDCPP
	help
	  Highly accurate emulator for the Neo Geo AES and MVS Cartridge Systems.

	  http://www.libretro.com

comment "BR2_PACKAGE_LIBRETRO_GEOLITH needs a toolchain w/ C++"
	depends on !BR2_INSTALL_LIBSTDCPP
```
