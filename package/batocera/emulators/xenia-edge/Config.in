## package/batocera/emulators/xenia-edge/Config.in
```kconfig
config BR2_PACKAGE_XENIA_EDGE
	bool "xenia-edge"
	depends on BR2_x86_64 || BR2_aarch64
	depends on BR2_PACKAGE_XORG7 # libgtk3 X11 backend
	depends on BR2_PACKAGE_HAS_LIBGL
	select BR2_PACKAGE_EXPAT
	select BR2_PACKAGE_LIBCURL
	select BR2_PACKAGE_LIBGTK3
	select BR2_PACKAGE_LIBGTK3_X11
	select BR2_PACKAGE_LZ4
	select BR2_PACKAGE_ZLIB
	# Runtime only: the binary uses the system libSDL3.so.0 and
	# dlopen()s libvulkan
	select BR2_PACKAGE_SDL3
	select BR2_PACKAGE_VULKAN_LOADER

	help
	  Xenia is an open source research project for emulating
	  Xbox 360 games on modern PCs.

	  https://github.com/has207/xenia-edge

comment "xenia-edge needs X.org and OpenGL"
	depends on BR2_x86_64 || BR2_aarch64
	depends on !BR2_PACKAGE_XORG7 || !BR2_PACKAGE_HAS_LIBGL
```

## package/batocera/emulators/ymir/Config.in
```kconfig
config BR2_PACKAGE_YMIR
	bool "ymir"
	select BR2_PACKAGE_CEREAL
	select BR2_PACKAGE_CXXOPTS
	select BR2_PACKAGE_FMT
	select BR2_PACKAGE_JSON_FOR_MODERN_CPP
	select BR2_PACKAGE_LIBCURL
	select BR2_PACKAGE_DATE
	select BR2_PACKAGE_LZ4
	select BR2_PACKAGE_MINIZ
	select BR2_PACKAGE_OPENSSL
	select BR2_PACKAGE_RTMIDI
	select BR2_PACKAGE_SDL3
	select BR2_PACKAGE_TOMLPLUSPLUS
	select BR2_PACKAGE_XXHASH
	select BR2_PACKAGE_ZLIB
	select BR2_PACKAGE_ZSTD
	help
	  Sega Saturn emulator.

	  https://github.com/ymir-emu/Ymir
```

## package/batocera/engines/scummvm/Config.in
```kconfig
config BR2_PACKAGE_SCUMMVM
	bool "scummvm"
	depends on BR2_INSTALL_LIBSTDCPP
	depends on BR2_PACKAGE_FLUIDSYNTH
	select BR2_PACKAGE_FAAD2
	select BR2_PACKAGE_FLAC
	select BR2_PACKAGE_FREETYPE
	select BR2_PACKAGE_JPEG
	select BR2_PACKAGE_LIBMAD
	select BR2_PACKAGE_LIBMPEG2
	select BR2_PACKAGE_LIBOGG
	select BR2_PACKAGE_LIBPNG
	select BR2_PACKAGE_LIBTHEORA
	select BR2_PACKAGE_LIBVORBIS if !(BR2_arm || BR2_mipsel)
	select BR2_PACKAGE_SDL3
	select BR2_PACKAGE_TREMOR if BR2_arm || BR2_mipsel
	select BR2_PACKAGE_ZLIB

	help
	  ScummVM lets you run classic point-and-click adventure and
	  role-playing games, provided you have their data files.

	  https://www.scummvm.org/

comment "scummvm needs a toolchain w/ C++ and fluidsynth"
	depends on !BR2_INSTALL_LIBSTDCPP || !BR2_PACKAGE_FLUIDSYNTH
```

## package/batocera/engines/tic80/Config.in
```kconfig
config BR2_PACKAGE_TIC80
	bool "tic80"
	depends on BR2_PACKAGE_HAS_LIBGL || BR2_PACKAGE_HAS_LIBGLES
	depends on !BR2_STATIC_LIBS # sdl2
	select BR2_PACKAGE_LIBCURL
	select BR2_PACKAGE_LIBGLU if BR2_PACKAGE_HAS_LIBGL
	select BR2_PACKAGE_SDL2

	help
	  TIC-80 is a fantasy computer for making, playing and sharing
	  tiny games.

	  https://tic80.com/
	  https://github.com/nesbox/TIC-80
```

## package/batocera/engines/vpinball/bgfx/Config.in
```kconfig
config BR2_PACKAGE_BGFX
	bool "bgfx"
	select BR2_PACKAGE_XLIB_LIBX11

	help
	  Cross-platform rendering library, built with the bgfx.cmake
	  build scripts.

	  https://github.com/bkaradzic/bgfx.cmake
```

## package/batocera/engines/vpinball/libaltsound/Config.in
```kconfig
config BR2_PACKAGE_LIBALTSOUND
	bool "libaltsound"

	help
	  A cross platform compilation of altsound that is baked
	  directly into VPinMAME.

	  https://github.com/vpinball/libaltsound
	  www.vpforums.org
```

## package/batocera/engines/vpinball/libpinmame/Config.in
```kconfig
config BR2_PACKAGE_LIBPINMAME
	bool "libpinmame"

	help
	  PinMAME - Pinball Multiple Arcade Machine Emulator.

	  https://github.com/vpinball/pinmame
	  www.vpforums.org
```

## package/batocera/engines/vpinball/libvni/Config.in
```kconfig
config BR2_PACKAGE_LIBVNI
	bool "libvni"
	select BR2_PACKAGE_LIBFRAMEUTIL

	help
	  A simple platform-independent conversion to C++
	  of the VNI converter of LibDmd which written in C#,
	  keeping the same license GPLv2. LibDmd is part of
	  DMD Extensions.

	  https://github.com/PPUC/libvni
	  www.vpforums.org
```

## package/batocera/engines/vpinball/vpinball/Config.in
```kconfig
config BR2_PACKAGE_VPINBALL
	bool "vpinball"
	select BR2_HOST_CMAKE_AT_LEAST_3_25
	select BR2_PACKAGE_BGFX
	select BR2_PACKAGE_FFMPEG
	select BR2_PACKAGE_FFMPEG_SWSCALE
	select BR2_PACKAGE_LIBALTSOUND
	select BR2_PACKAGE_LIBDMDUTIL
	select BR2_PACKAGE_LIBDOF
	select BR2_PACKAGE_LIBFREEIMAGE
	select BR2_PACKAGE_LIBMYSOFA
	select BR2_PACKAGE_LIBOGG
	select BR2_PACKAGE_LIBPINMAME
	select BR2_PACKAGE_LIBPUPDMD
	select BR2_PACKAGE_LIBSERUM
	select BR2_PACKAGE_LIBSPATIALAUDIO
	select BR2_PACKAGE_LIBVNI
	select BR2_PACKAGE_LIBWINEVBS
	select BR2_PACKAGE_OPENXR_SDK
	select BR2_PACKAGE_OPUS
	select BR2_PACKAGE_OPUSFILE
	select BR2_PACKAGE_SDL3
	select BR2_PACKAGE_SDL3_IMAGE
	select BR2_PACKAGE_SDL3_TTF
	select BR2_PACKAGE_ZLIB

	help
	  Visual Pinball X, standalone BGFX build.

	  https://github.com/vpinball/vpinball
```

## package/batocera/ports/doom/doom3/bloodmod/Config.in
```kconfig
config BR2_PACKAGE_BLOODMOD
	bool "bloodmod"
	select BR2_PACKAGE_DHEWM3

	help
	  Bloodmod, a mod for Dhewm3.

	  https://github.com/dhewm/dhewm3-sdk/tree/bloodmod
```

## package/batocera/ports/doom/doom3/cdoom/Config.in
```kconfig
config BR2_PACKAGE_CDOOM
	bool "cdoom"
	select BR2_PACKAGE_DHEWM3

	help
	  Classic Doom port for Dhewm3

	  https://github.com/dhewm/dhewm3-sdk/tree/cdoom
```

## package/batocera/ports/doom/doom3/d3le/Config.in
```kconfig
config BR2_PACKAGE_D3LE
	bool "d3le"
	select BR2_PACKAGE_DHEWM3

	help
	  dhewm3 port of the Doom3: The Lost Mission mod..

	  https://github.com/dhewm/dhewm3-sdk/tree/d3le
```

## package/batocera/ports/doom/doom3/dentonmod/Config.in
```kconfig
config BR2_PACKAGE_DENTONMOD
	bool "dentonmod"
	select BR2_PACKAGE_DHEWM3

	help
	  Dentonmod, a mod for Dhewm3.

	  https://github.com/dhewm/dhewm3-sdk/tree/dentonmod
```

## package/batocera/ports/doom/doom3/desolated/Config.in
```kconfig
config BR2_PACKAGE_DESOLATED
	bool "desolated"
	select BR2_PACKAGE_DHEWM3

	help
	  Desolated, a mod for Dhewm3.

	  https://github.com/dhewm/dhewm3-sdk/tree/desolated
```

## package/batocera/ports/doom/doom3/eldoom/Config.in
```kconfig
config BR2_PACKAGE_ELDOOM
	bool "eldoom"
	select BR2_PACKAGE_DHEWM3

	help
	  Eldoom, a mod for Dhewm3.

	  https://github.com/dhewm/dhewm3-sdk/tree/eldoom
```

## package/batocera/ports/doom/doom3/eoc/Config.in
```kconfig
config BR2_PACKAGE_EOC
	bool "eoc"
	select BR2_PACKAGE_DHEWM3
	help
	  HeXen: Edge Of Chaos, a mod for Dhewm3.

	  https://github.com/dhewm/dhewm3-sdk/tree/eoc
```

## package/batocera/ports/doom/doom3/fitz/Config.in
```kconfig
config BR2_PACKAGE_FITZ
	bool "fitz"
	select BR2_PACKAGE_DHEWM3

	help
	  Fitz, a mod for Dhewm3.

	  https://github.com/dhewm/dhewm3-sdk/tree/fitz
```

## package/batocera/ports/doom/doom3/grimm/Config.in
```kconfig
config BR2_PACKAGE_GRIMM
	bool "grimm"
	select BR2_PACKAGE_DHEWM3

	help
	  Grimm, a mod for Dhewm3.

	  https://github.com/dhewm/dhewm3-sdk/tree/grimm
```

## package/batocera/ports/doom/doom3/hardcorps/Config.in
```kconfig
config BR2_PACKAGE_HARDCORPS
	bool "hardcorps"
	select BR2_PACKAGE_DHEWM3

	help
	  Hardcorps, a mod for Dhewm3.

	  https://github.com/dhewm/dhewm3-sdk/tree/hardcorps
```

## package/batocera/ports/doom/doom3/perfected/Config.in
```kconfig
config BR2_PACKAGE_PERFECTED
	bool "perfected"
	select BR2_PACKAGE_DHEWM3

	help
	  Perfected, a mod for Dhewm3.

	  https://github.com/dhewm/dhewm3-sdk/tree/perfected
```

## package/batocera/ports/doom/doom3/realgibs/Config.in
```kconfig
config BR2_PACKAGE_REALGIBS
	bool "realgibs"
	select BR2_PACKAGE_DHEWM3

	help
	  Realgibs, a mod for Dhewm3.

	  https://github.com/dhewm/dhewm3-sdk/tree/realgibs
```

## package/batocera/ports/doom/doom3/rivensin/Config.in
```kconfig
config BR2_PACKAGE_RIVENSIN
	bool "rivensin"
	select BR2_PACKAGE_DHEWM3

	help
	  Rivensin, a mod for Dhewm3.

	  https://github.com/dhewm/dhewm3-sdk/tree/rivensin
```

## package/batocera/ports/doom/doom3/sikkmod/Config.in
```kconfig
config BR2_PACKAGE_SIKKMOD
	bool "sikkmod"
	select BR2_PACKAGE_DHEWM3

	help
	  Sikkmod, a mod for Dhewm3.

	  https://github.com/dhewm/dhewm3-sdk/tree/sikkmod
```

## package/batocera/sources/libretro-mame-src/Config.in
```kconfig
config BR2_PACKAGE_LIBRETRO_MAME_SRC
	bool "libretro-mame-src"
	depends on BR2_PACKAGE_RETROARCH
	depends on BR2_INSTALL_LIBSTDCPP
	select BR2_PACKAGE_ALSA_LIB
	select BR2_PACKAGE_FONTCONFIG
	select BR2_PACKAGE_SDL2
	select BR2_PACKAGE_SDL2_TTF
	select BR2_PACKAGE_ZLIB

	help
	  A libretro mame core for Mame.

	  http://www.libretro.com

comment "LIBRETRO_MAME_SRC needs a toolchain w/ C++"
	depends on !BR2_INSTALL_LIBSTDCPP
```

## package/batocera/sources/mame-src/Config.in
```kconfig
config BR2_PACKAGE_MAME_SRC
	bool "mame"
	depends on BR2_INSTALL_LIBSTDCPP
	depends on BR2_TOOLCHAIN_HAS_THREADS # portaudio
	depends on BR2_USE_WCHAR # flac
	select BR2_PACKAGE_ALSA_LIB
	select BR2_PACKAGE_ASIO
	select BR2_PACKAGE_EXPAT
	select BR2_PACKAGE_FLAC
	select BR2_PACKAGE_FONTCONFIG
	select BR2_PACKAGE_GLM
	select BR2_PACKAGE_JPEG
	select BR2_PACKAGE_LIBPNG
	select BR2_PACKAGE_LIBPORTMIDI
	select BR2_PACKAGE_PORTAUDIO
	select BR2_PACKAGE_PUGIXML
	select BR2_PACKAGE_RAPIDJSON
	select BR2_PACKAGE_SDL2
	select BR2_PACKAGE_SDL2_TTF
	select BR2_PACKAGE_SQLITE
	select BR2_PACKAGE_ZLIB
	select BR2_PACKAGE_ZSTD

	help
	  MAME emulator standalone package

	  https://mamedev.org
```
