## package/batocera/emulators/retroarch/libretro/libretro-vircon32/Config.in
```kconfig
config BR2_PACKAGE_LIBRETRO_VIRCON32
	bool "libretro-vircon32"
	depends on BR2_PACKAGE_RETROARCH
	depends on BR2_INSTALL_LIBSTDCPP
	help
	  Vircon32 is a virtual game console, inspired by classic 16 & 32 bit systems as well as the arcade era.

	  http://www.libretro.com

comment "LIBRETRO_VIRCON32 needs a toolchain w/ C++"
	depends on !BR2_INSTALL_LIBSTDCPP
```

## package/batocera/emulators/retroarch/libretro/libretro-vitaquake3/Config.in
```kconfig
config BR2_PACKAGE_LIBRETRO_VITAQUAKE3
	bool "libretro-vitaquake3"
	depends on BR2_PACKAGE_RETROARCH
	depends on BR2_INSTALL_LIBSTDCPP

	help
	  A libretro Quake 3 core.

	  http://www.libretro.com

comment "LIBRETRO_VITAQUAKE3 needs a toolchain w/ C++"
	depends on !BR2_INSTALL_LIBSTDCPP
```

## package/batocera/emulators/retroarch/libretro/libretro-vitavoyager/Config.in
```kconfig
config BR2_PACKAGE_LIBRETRO_VITAVOYAGER
	bool "libretro-vitavoyager"
	depends on BR2_PACKAGE_RETROARCH
	depends on BR2_INSTALL_LIBSTDCPP
	help
	  A libretro Star Trek Voyager: Elite Force Holomatch core.

	  http://www.libretro.com

comment "LIBRETRO_VITAVOYAGER needs a toolchain w/ C++"
	depends on !BR2_INSTALL_LIBSTDCPP
```

## package/batocera/emulators/retroarch/libretro/libretro-wasm/Config.in
```kconfig
config BR2_PACKAGE_LIBRETRO_WASM
    bool "libretro-wasm"
    depends on BR2_PACKAGE_RETROARCH
    depends on BR2_INSTALL_LIBSTDCPP
    depends on BR2_GCC_ENABLE_OPENMP

    help
      Build retro games using WebAssembly for a fantasy console.

	    https://github.com/aduros/wasm4
```

## package/batocera/emulators/retroarch/libretro/libretro-xrick/Config.in
```kconfig
config BR2_PACKAGE_LIBRETRO_XRICK
	bool "libretro-xrick"
	depends on BR2_PACKAGE_RETROARCH
	depends on BR2_INSTALL_LIBSTDCPP
	select BR2_PACKAGE_RECALBOX_ROMFS_RICKDANGEROUS
	help
	  A libretro clone of Rick Dangerous.

	  http://www.libretro.com

comment "LIBRETRO_XRICK needs a toolchain w/ C++"
	depends on !BR2_INSTALL_LIBSTDCPP
```

## package/batocera/emulators/retroarch/libretro/libretro-yabause/Config.in
```kconfig
config BR2_PACKAGE_LIBRETRO_YABAUSE
	bool "libretro-yabause"

	help
	  Yabause libretro port (Sega Saturn emulator).

	  http://www.libretro.com
```

## package/batocera/emulators/retroarch/libretro/libretro-zc250x/Config.in
```kconfig
config BR2_PACKAGE_LIBRETRO_ZC250X
	bool "libretro-zc250x"
	depends on BR2_PACKAGE_RETROARCH
	depends on BR2_INSTALL_LIBSTDCPP
	help
	  A libretro Zelda Classic 2.50.1 core

	  http://www.libretro.com

comment "LIBRETRO_ZC250X needs a toolchain w/ C++"
	depends on !BR2_INSTALL_LIBSTDCPP
```

## package/batocera/emulators/retroarch/shaders/retrocrisis/Config.in
```kconfig
config BR2_PACKAGE_RETROCRISIS
	bool "retrocrisis"
	depends on BR2_PACKAGE_RETROARCH

	help
	  Retro Crisis libretro CRT shader presets, based on Guest Advanced NTSC shader

	  https://github.com/RetroCrisis/Retro-Crisis-GDV-NTSC
```

## package/batocera/emulators/rpcs3/Config.in
```kconfig
config BR2_PACKAGE_RPCS3
    bool "rpcs3"
    depends on BR2_TOOLCHAIN_GCC_AT_LEAST_8
    select BR2_PACKAGE_LIBXML2
    select BR2_PACKAGE_MESA3D
    select BR2_PACKAGE_OPENAL
    select BR2_PACKAGE_ALSA_LIB
    select BR2_PACKAGE_LIBEVDEV
    select BR2_PACKAGE_LIBGLEW
    select BR2_PACKAGE_LIBUSB
    select BR2_PACKAGE_LIBGLU
    select BR2_PACKAGE_FFMPEG_SWSCALE
    select BR2_PACKAGE_NCURSES
    select BR2_PACKAGE_FAUDIO
    select BR2_PACKAGE_WOLFSSL
    select BR2_PACKAGE_WOLFSSL_ALL
	# QT6
	select BR2_PACKAGE_QT6
	select BR2_PACKAGE_QT6BASE
	select BR2_PACKAGE_QT6BASE_CONCURRENT
	select BR2_PACKAGE_QT6BASE_DBUS
	select BR2_PACKAGE_QT6BASE_EGLFS
	select BR2_PACKAGE_QT6BASE_FONTCONFIG
	select BR2_PACKAGE_QT6BASE_GIF
	select BR2_PACKAGE_QT6BASE_GUI
	select BR2_PACKAGE_QT6BASE_HARFBUZZ
	select BR2_PACKAGE_QT6BASE_JPEG
	select BR2_PACKAGE_QT6BASE_NETWORK
	select BR2_PACKAGE_QT6BASE_OPENGL_DESKTOP
	select BR2_PACKAGE_QT6BASE_PNG
	select BR2_PACKAGE_QT6BASE_PRINTSUPPORT
	select BR2_PACKAGE_QT6BASE_WIDGETS
	select BR2_PACKAGE_QT6BASE_XCB
	select BR2_PACKAGE_QT6BASE_XML
	select BR2_PACKAGE_QT6SVG
	select BR2_PACKAGE_QT6TOOLS
	select BR2_PACKAGE_QT6MULTIMEDIA
	select BR2_PACKAGE_QT6SVG

    help
      RPCS3 is a multi-platform open-source Sony PlayStation 3 emulator.

      https://rpcs3.net/
```

## package/batocera/emulators/ruffle/Config.in
```kconfig
config BR2_PACKAGE_RUFFLE
	bool "ruffle"
	depends on BR2_PACKAGE_HOST_RUSTC_TARGET_ARCH_SUPPORTS
	depends on BR2_PACKAGE_HAS_UDEV
	select BR2_PACKAGE_ALSA_LIB
	select BR2_PACKAGE_HOST_RUSTC
	select BR2_PACKAGE_OPENSSL
	select BR2_PACKAGE_NGHTTP2

	help
	  ruffle is a Flash Player emulator built in the Rust
	  programming language.

	  https://ruffle.rs/
```

## package/batocera/emulators/ryujinxNG/Config.in
```kconfig
config BR2_PACKAGE_RYUJINXNG
	bool "ryujinxng"
	depends on BR2_PACKAGE_XORG7
	select BR2_PACKAGE_SDL2
	select BR2_PACKAGE_OPENAL
	select BR2_PACKAGE_HICOLOR_ICON_THEME
	select BR2_PACKAGE_ADWAITA_ICON_THEME
	select BR2_PACKAGE_LIBRSVG

	help
	  Ryujinx is an open-source Nintendo Switch emulator created by gdkchan and written in C sharp.

	  https://ryujinx.org
```

## package/batocera/emulators/touchhle/Config.in
```kconfig
config BR2_PACKAGE_TOUCHHLE
	bool "touchHLE"
	depends on BR2_PACKAGE_BATOCERA_TARGET_X86_64_ANY
	depends on BR2_PACKAGE_HOST_RUSTC_TARGET_ARCH_SUPPORTS
	select BR2_PACKAGE_HOST_RUSTC
	select BR2_PACKAGE_HOST_CMAKE
	select BR2_PACKAGE_BOOST
	select BR2_PACKAGE_BATOCERA_SDL2
	select BR2_PACKAGE_OPENAL

	help
	  touchHLE is a high-level emulator for early iPhone OS apps.

	  https://github.com/touchHLE/touchHLE
```

## package/batocera/emulators/vice/Config.in
```kconfig
config BR2_PACKAGE_VICE
	bool "vice"
	select BR2_PACKAGE_ALSA_LIB
	select BR2_PACKAGE_FFMPEG4
	select BR2_PACKAGE_GIFLIB
	select BR2_PACKAGE_HOST_DOS2UNIX
	select BR2_PACKAGE_HOST_XA
	select BR2_PACKAGE_JPEG
	select BR2_PACKAGE_LAME
	select BR2_PACKAGE_LIBCURL
	select BR2_PACKAGE_PNG
	select BR2_PACKAGE_SDL2
	select BR2_PACKAGE_SDL2_IMAGE
	select BR2_PACKAGE_ZLIB

	help
	  VICE is an emulator collection which emulates the
	  - C64,
	  - C64-DTV,
	  - C128,
	  - VIC20
	  - practically all PET models,
	  - PLUS4
	  - CBM-II (aka C610).

comment "Vice  needs a toolchain w/ OpenGl,  SDL"
```

## package/batocera/emulators/virtualjaguar/Config.in
```kconfig
config BR2_PACKAGE_VIRTUALJAGUAR
	bool "virtualjaguar"
	select BR2_PACKAGE_SDL12_COMPAT

	help
	  Virtual Jaguar, an Atari Jaguar emulator, with integrated debugger

	  https://github.com/djipi/Virtual-Jaguar-Rx
```

## package/batocera/emulators/vita3k/Config.in
```kconfig
config BR2_PACKAGE_VITA3K
	bool "vita3k"
	select BR2_PACKAGE_BOOST
	select BR2_PACKAGE_BOOST_FILESYSTEM
	select BR2_PACKAGE_BOOST_SYSTEM
	select BR2_PACKAGE_FMT
	select BR2_PACKAGE_LIBCURL
	select BR2_PACKAGE_LIBGTK3
	select BR2_PACKAGE_LIBOGG
	select BR2_PACKAGE_LIBVORBIS
	select BR2_PACKAGE_PYTHON_RUAMEL_YAML
	select BR2_PACKAGE_SDL3
	select BR2_PACKAGE_ZLIB

	help
	  Experimental PlayStation Vita emulator

	  https://github.com/vita3k/vita3k
```

## package/batocera/emulators/vpinball/libdof/Config.in
```kconfig
config BR2_PACKAGE_LIBDOF
	bool "libdof"
	select BR2_PACKAGE_CARGS
	select BR2_PACKAGE_HIDAPI
	select BR2_PACKAGE_LIBSERIALPORT
	select BR2_PACKAGE_LIBFTDI1
	select BR2_PACKAGE_SOCKPP

	help
	  A cross platform library for performing Direct Output
	  Framework tasks.

	  https://github.com/jsm174/libdof
```

## package/batocera/emulators/vpinball/libframeutil/Config.in
```kconfig
config BR2_PACKAGE_LIBFRAMEUTIL
	bool "libframeutil"

	help
	  Some DMD frame utilities used by libzedmd and libdmdutil

	  https://github.com/ppuc/libframeutil/
```

## package/batocera/emulators/vpinball/libpupdmd/Config.in
```kconfig
config BR2_PACKAGE_LIBPUPDMD
	bool "libpupdmd"

	help
	  Emit PUP triggers from DMD frames

	  https://github.com/ppuc/libpupdmd/
```

## package/batocera/emulators/vpinball/sockpp/Config.in
```kconfig
config BR2_PACKAGE_SOCKPP
    bool "sockpp"
    help
      Modern C++ socket library.

      https://github.com/fpagliughi/sockpp
```

## package/batocera/emulators/xenia-edge/Config.in
```kconfig
config BR2_PACKAGE_XENIA_EDGE
	bool "xenia-edge"
	select BR2_PACKAGE_ALSA_LIB
	select BR2_PACKAGE_LZ4
	select BR2_PACKAGE_PYTHON_TOML
	select BR2_PACKAGE_QT6BASE
	select BR2_PACKAGE_SDL2
	select BR2_PACKAGE_VULKAN_HEADERS
	select BR2_PACKAGE_VULKAN_LOADER

	  help
	  Xenia is an open source research project for emulating
	  Xbox 360 games on modern PCs.

	  https://xenia.jp/
```

## package/batocera/emulators/xenia-native/Config.in
```kconfig
config BR2_PACKAGE_XENIA_NATIVE
    bool "xenia"
    depends on BR2_x86_64
    depends on BR2_PACKAGE_XORG7
    select BR2_PACKAGE_ALSA_LIB
    select BR2_PACKAGE_BATOCERA_VULKAN
    select BR2_PACKAGE_FMT
    select BR2_PACKAGE_FREETYPE
    select BR2_PACKAGE_LIBGTK3
    select BR2_PACKAGE_LIBPNG
    select BR2_PACKAGE_LZ4
    select BR2_PACKAGE_SDL2
    select BR2_PACKAGE_ZLIB

    help
        Xenia is an open source research project for emulating Xbox 360 games on modern PCs.

        https://xenia.jp/
```

## package/batocera/emulators/yabasanshiro/Config.in
```kconfig
config BR2_PACKAGE_YABASANSHIRO
	bool "yabasanshiro"
	select BR2_PACKAGE_BOOST
	select BR2_PACKAGE_BOOST_DATE_TIME
	select BR2_PACKAGE_BOOST_FILESYSTEM
	select BR2_PACKAGE_BOOST_LOCALE
	select BR2_PACKAGE_BOOST_SYSTEM
	select BR2_PACKAGE_LIBGLFW              if BR2_PACKAGE_XORG7 || BR2_PACKAGE_BATOCERA_WAYLAND
	select BR2_PACKAGE_SDL2

	help
	  uoYabause is a unofficial port of
	  Yabause SEGA Saturn Emulator.

	  http://www.uoyabause.org/
```

## package/batocera/emulators/ymir/Config.in
```kconfig
config BR2_PACKAGE_YMIR
	bool "ymir"
	select BR2_PACKAGE_BATOCERA_SDL3
	select BR2_PACKAGE_CEREAL
	select BR2_PACKAGE_CXXOPTS
	select BR2_PACKAGE_RTMIDI
	select BR2_PACKAGE_STB
	select BR2_PACKAGE_TOMLPLUSPLUS

	help
	  Sega Saturn emulator.

	  https://github.com/StrikerX3/Ymir
```

## package/batocera/emulators/yuzu/Config.in
```kconfig
config BR2_PACKAGE_YUZU
    bool "yuzu"
    depends on BR2_x86_64
    depends on BR2_PACKAGE_XORG7
    select BR2_PACKAGE_SDL2
    select BR2_PACKAGE_FMT
    select BR2_PACKAGE_BOOST
    select BR2_PACKAGE_BOOST_CONTEXT
    select BR2_PACKAGE_FFMPEG
    select BR2_PACKAGE_ZSTD
    select BR2_PACKAGE_ZLIB
    select BR2_PACKAGE_LIBZIP
    select BR2_PACKAGE_LZ4
    select BR2_PACKAGE_CATCH2
    select BR2_PACKAGE_OPUS
    select BR2_PACKAGE_JSON_FOR_MODERN_CPP
	# QT6
	select BR2_PACKAGE_QT6
	select BR2_PACKAGE_QT6BASE
	select BR2_PACKAGE_QT6BASE_CONCURRENT
	select BR2_PACKAGE_QT6BASE_DBUS
	select BR2_PACKAGE_QT6BASE_EGLFS
	select BR2_PACKAGE_QT6BASE_FONTCONFIG
	select BR2_PACKAGE_QT6BASE_GIF
	select BR2_PACKAGE_QT6BASE_GUI
	select BR2_PACKAGE_QT6BASE_HARFBUZZ
	select BR2_PACKAGE_QT6BASE_JPEG
	select BR2_PACKAGE_QT6BASE_NETWORK
	select BR2_PACKAGE_QT6BASE_OPENGL_DESKTOP
	select BR2_PACKAGE_QT6BASE_PNG
	select BR2_PACKAGE_QT6BASE_PRINTSUPPORT
	select BR2_PACKAGE_QT6BASE_WIDGETS
	select BR2_PACKAGE_QT6BASE_XCB
	select BR2_PACKAGE_QT6BASE_XML
	select BR2_PACKAGE_QT6SVG
	select BR2_PACKAGE_QT6TOOLS

    help
      A Emulator Yuzu core for Nintendo Switch.

	    https://yuzu-emu.org/
```

## package/batocera/engines/ruffle/Config.in
```kconfig
config BR2_PACKAGE_RUFFLE
	bool "ruffle"
	depends on BR2_PACKAGE_HAS_UDEV
	depends on BR2_PACKAGE_HOST_RUSTC_TARGET_ARCH_SUPPORTS
	select BR2_PACKAGE_ALSA_LIB
	select BR2_PACKAGE_HOST_RUSTC
	select BR2_PACKAGE_NGHTTP2
	select BR2_PACKAGE_OPENSSL

	help
	  ruffle is a Flash Player emulator built in the Rust
	  programming language.

	  https://ruffle.rs/
```
