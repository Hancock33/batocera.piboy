## package/batocera/emulators/retroarch/libretro/libretro-holani/Config.in
```kconfig
config BR2_PACKAGE_LIBRETRO_HOLANI
	bool "libretro-holani"
	depends on BR2_PACKAGE_RETROARCH
	depends on BR2_PACKAGE_HOST_RUSTC_TARGET_ARCH_SUPPORTS
	select BR2_PACKAGE_HOST_RUSTC

	help
	  A cycle-stepped Atari Lynx emulator

	  https://github.com/LLeny/holani-retro
```

## package/batocera/emulators/retroarch/libretro/libretro-jaxe/Config.in
```kconfig
config BR2_PACKAGE_LIBRETRO_JAXE
	bool "libretro-jaxe"
	depends on BR2_PACKAGE_RETROARCH
	depends on BR2_INSTALL_LIBSTDCPP
	depends on BR2_GCC_ENABLE_OPENMP

	help
	  A fully-featured, cross platform XO-CHIP/S-CHIP/CHIP-8 emulator written in C and SDL.

	  https://github.com/kurtjd/jaxe
```

## package/batocera/emulators/retroarch/libretro/libretro-jollycv/Config.in
```kconfig
config BR2_PACKAGE_LIBRETRO_JOLLYCV
	bool "libretro-jollycv"
	depends on BR2_INSTALL_LIBSTDCPP

	help
	  Jolly Good ColecoVision, CreatiVision,
	  and My Vision Emulator

	  http://www.libretro.com

comment "LIBRETRO_JOLLYCV needs a toolchain w/ C++"
	depends on !BR2_INSTALL_LIBSTDCPP
```

## package/batocera/emulators/retroarch/libretro/libretro-jumpnbump/Config.in
```kconfig
config BR2_PACKAGE_LIBRETRO_JUMPNBUMP
	bool "libretro-jumpnbump"
	depends on BR2_PACKAGE_RETROARCH
	depends on BR2_INSTALL_LIBSTDCPP

	help
	  Jump n' Bump libretro core

comment "LIBRETRO_JUMPNBUMP needs a toolchain w/ C++"
	depends on !BR2_INSTALL_LIBSTDCPP
```

## package/batocera/emulators/retroarch/libretro/libretro-lowres-nx/Config.in
```kconfig
config BR2_PACKAGE_LIBRETRO_LOWRESNX
	bool "libretro-lowresnx"
	depends on BR2_PACKAGE_RETROARCH
	depends on BR2_INSTALL_LIBSTDCPP
	help
	  Lowres-nx is an simulated retro game console, which can be programmed in the classic BASIC language.

	  http://www.libretro.com

comment "LIBRETRO_LOWRESNX needs a toolchain w/ C++"
	depends on !BR2_INSTALL_LIBSTDCPP
```

## package/batocera/emulators/retroarch/libretro/libretro-mesen/Config.in
```kconfig
config BR2_PACKAGE_LIBRETRO_MESEN
        bool "libretro-mesen"
	depends on BR2_PACKAGE_RETROARCH
        help
          A libretro Mesen is a NES/Famicom emulator.

	  http://www.libretro.com
```

## package/batocera/emulators/retroarch/libretro/libretro-mess/Config.in
```kconfig
config BR2_PACKAGE_LIBRETRO_MESS
        bool "libretro-mess"
	depends on BR2_PACKAGE_RETROARCH
	depends on BR2_INSTALL_LIBSTDCPP
	select BR2_PACKAGE_SQLITE
        help
          A libretro mess core for MESS.

	  http://www.libretro.com

comment "LIBRETRO_MAME needs a toolchain w/ C++"
	depends on !BR2_INSTALL_LIBSTDCPP
```

## package/batocera/emulators/retroarch/libretro/libretro-mojozork/Config.in
```kconfig
config BR2_PACKAGE_LIBRETRO_MOJOZORK
	bool "libretro-mojozork"
	depends on BR2_PACKAGE_RETROARCH
	depends on BR2_INSTALL_LIBSTDCPP

	help
	  A simple Z-Machine implementation in a single C file.

	  http://www.libretro.com

comment "LIBRETRO_MOJOZORK needs a toolchain w/ C++"
	depends on !BR2_INSTALL_LIBSTDCPP
```

## package/batocera/emulators/retroarch/libretro/libretro-noods/Config.in
```kconfig
config BR2_PACKAGE_LIBRETRO_NOODS
	bool "libretro-noods"
	depends on BR2_INSTALL_LIBSTDCPP

	help
	  Unofficial libretro port of NooDS,
	  the speedy DS emulator.

	  https://github.com/jonian/libretro-noods
```

## package/batocera/emulators/retroarch/libretro/libretro-openlara/Config.in
```kconfig
config BR2_PACKAGE_LIBRETRO_OPENLARA
	bool "libretro-openlara"
	depends on BR2_PACKAGE_RETROARCH
	depends on BR2_INSTALL_LIBSTDCPP
	help
	  Classic Tomb Raider open-source engine.

	  http://www.libretro.com

comment "LIBRETRO_OPENLARA needs a toolchain w/ C++"
	depends on !BR2_INSTALL_LIBSTDCPP
```

## package/batocera/emulators/retroarch/libretro/libretro-p2000t/Config.in
```kconfig
config BR2_PACKAGE_LIBRETRO_P2000T
	bool "libretro-p2000t"
	depends on BR2_PACKAGE_RETROARCH
	depends on BR2_INSTALL_LIBSTDCPP

	help
	  Emulator for the Philips P2000 home computer

	  https://github.com/p2000t/M2000

comment "LIBRETRO_P2000T needs a toolchain w/ C++"
	depends on !BR2_INSTALL_LIBSTDCPP
```

## package/batocera/emulators/retroarch/libretro/libretro-panda3ds/Config.in
```kconfig
config BR2_PACKAGE_LIBRETRO_PANDA3DS
	bool "libretro-panda3ds"
	depends on BR2_INSTALL_LIBSTDCPP
	select BR2_PACKAGE_FDK_AAC
	select BR2_PACKAGE_FFMPEG
	select BR2_PACKAGE_FMT
	select BR2_PACKAGE_LUA

	help
	  Panda3DS is an HLE, red-panda-themed Nintendo 3DS emulator.

	  https://github.com/wheremyfoodat/Panda3DS

comment "LIBRETRO_CITRA needs a toolchain w/ C++"
	depends on !BR2_INSTALL_LIBSTDCPP
```

## package/batocera/emulators/retroarch/libretro/libretro-play/Config.in
```kconfig
config BR2_PACKAGE_LIBRETRO_PLAY
    bool "libretro-play"
    select BR2_PACKAGE_LIBGLEW
      help
        Play! - PlayStation2 Emulator

        https://purei.org/
```

## package/batocera/emulators/retroarch/libretro/libretro-puae2021/Config.in
```kconfig
config BR2_PACKAGE_LIBRETRO_PUAE2021
    bool "libretro-puae2021"
	depends on BR2_PACKAGE_RETROARCH
	depends on BR2_INSTALL_LIBSTDCPP
      help
        A libretro AMIGA emulator core for ARM.

	  http://www.libretro.com

comment "LIBRETRO_PUAE2021 needs a toolchain w/ C++"
	depends on !BR2_INSTALL_LIBSTDCPP
```

## package/batocera/emulators/retroarch/libretro/libretro-quicknes/Config.in
```kconfig
config BR2_PACKAGE_LIBRETRO_QUICKNES
	bool "libretro-quicknes"
	depends on BR2_PACKAGE_RETROARCH
	help
	  QuickNES is the fastest NES emulator available via libretro, though this speed comes at the cost of some accuracy.
	  This core should be used only when performance is of the utmost concern and even FCEUmm is too demanding.

	  http://www.libretro.com
```

## package/batocera/emulators/retroarch/libretro/libretro-race/Config.in
```kconfig
config BR2_PACKAGE_LIBRETRO_RACE
	bool "libretro-race"

	help
	  RACE libretro port ( NGPC emulator emulator).

	  http://www.libretro.com
```

## package/batocera/emulators/retroarch/libretro/libretro-scummvm-mainline/Config.in
```kconfig
config BR2_PACKAGE_LIBRETRO_SCUMMVM_MAINLINE
    bool "libretro-scummvm-mainline"
	depends on BR2_PACKAGE_RETROARCH
	depends on BR2_INSTALL_LIBSTDCPP
      help
        A libretro SCUMMVM emulator core for ARM.

	  http://www.libretro.com

comment "LIBRETRO_SCUMMVM_MAINLINE needs a toolchain w/ C++"
	depends on !BR2_INSTALL_LIBSTDCPP
```

## package/batocera/emulators/retroarch/libretro/libretro-skyemu/Config.in
```kconfig
config BR2_PACKAGE_LIBRETRO_SKYEMU
	bool "libretro-panda3ds"
	depends on BR2_INSTALL_LIBSTDCPP
	select BR2_PACKAGE_SDL2

	help
	  Game Boy Advance, Game Boy, Game Boy Color, and DS Emulator

	  https://github.com/skylersaleh/SkyEmu

comment "LIBRETRO_SKYEMU needs a toolchain w/ C++"
	depends on !BR2_INSTALL_LIBSTDCPP
```

## package/batocera/emulators/retroarch/libretro/libretro-snes9x/Config.in
```kconfig
config BR2_PACKAGE_LIBRETRO_SNES9X
	bool "libretro-snes9x"
	depends on BR2_INSTALL_LIBSTDCPP
	select BR2_PACKAGE_ZLIB

	help
	  Snes9x - Portable Super Nintendo Entertainment System emulator

	  http://www.libretro.com

comment "LIBRETRO_SNES9X needs a toolchain w/ C++"
	depends on !BR2_INSTALL_LIBSTDCPP
```

## package/batocera/emulators/retroarch/libretro/libretro-supafaust/Config.in
```kconfig
config BR2_PACKAGE_LIBRETRO_SUPAFAUST
	bool "libretro-supafaust"

	help
	  A libretro Supafaust is a unsupported SNES emulator for
	  multicore ARM Cortex A7,A9,A15,A53 Linux platforms.

	  http://www.libretro.com
```

## package/batocera/emulators/retroarch/libretro/libretro-superbroswar/Config.in
```kconfig
config BR2_PACKAGE_LIBRETRO_SUPERBROSWAR
	bool "libretro-superbroswar"
	depends on BR2_PACKAGE_RETROARCH
	depends on BR2_INSTALL_LIBSTDCPP
	help
	  A fan-made multiplayer style deathmatch game.

	  http://www.libretro.com
```

## package/batocera/emulators/retroarch/libretro/libretro-supermodel/Config.in
```kconfig
config BR2_PACKAGE_LIBRETRO_SUPERMODEL
	bool "libretro-supermodel"
	depends on BR2_INSTALL_LIBSTDCPP

	help
	  A modernized fork of the Sega Model 3,
	  Supermodel Libretro core.

	  http://www.libretro.com

comment "LIBRETRO_SUPERMODEL needs a toolchain w/ C++"
	depends on !BR2_INSTALL_LIBSTDCPP
```

## package/batocera/emulators/retroarch/libretro/libretro-tamalibretro/Config.in
```kconfig
config BR2_PACKAGE_LIBRETRO_TAMALIBRETRO
	bool "libretro-tamalibretro"
	depends on BR2_PACKAGE_RETROARCH
	depends on BR2_INSTALL_LIBSTDCPP

	help
	  TamaLIBretro is an implementation of the TamaLIB
	  Tamagotchi P1 emulation library as a libretro core.

	  https://github.com/celerizer/tamalibretro
```

## package/batocera/emulators/retroarch/libretro/libretro-uoyabause/Config.in
```kconfig
config BR2_PACKAGE_LIBRETRO_UOYABAUSE
	bool "libretro-uoyabause"
	depends on BR2_PACKAGE_RETROARCH
	depends on BR2_INSTALL_LIBSTDCPP
	help
	  A libretro YABASANSHIRO emulator core.

	  http://www.libretro.com

comment "LIBRETRO_UOYABAUSE needs a toolchain w/ C++"
	depends on !BR2_INSTALL_LIBSTDCPP
```

## package/batocera/emulators/retroarch/libretro/libretro-vaporspec/Config.in
```kconfig
config BR2_PACKAGE_LIBRETRO_VAPORSPEC
	bool "libretro-wasm"
	depends on BR2_PACKAGE_RETROARCH
	depends on BR2_INSTALL_LIBSTDCPP
	depends on BR2_GCC_ENABLE_OPENMP

	help
	  A virtual game platform with capabilities similar to 80s game consoles.

	  https://github.com/minkcv/vm.git
```
