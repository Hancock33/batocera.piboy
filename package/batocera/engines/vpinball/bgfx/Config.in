## package/batocera/engines/vpinball/bgfx/Config.in
```kconfig
config BR2_PACKAGE_BGFX
	bool "bgfx"

	help
	  CMake build scripts for bgfx.
	  Released under public domain.

	  bkaradzic.github.io/bgfx/index.html
```

## package/batocera/engines/vpinball/cargs/Config.in
```kconfig
config BR2_PACKAGE_CARGS
	bool "cargs"

	help
	  cargs - A lightweight cross-platform getopt alternative.
	  Command line argument parser library for C/C++.
	  Can be used to parse argv and argc parameters.

	  https://github.com/likle/cargs
```

## package/batocera/engines/vpinball/libaltsound/Config.in
```kconfig
config BR2_PACKAGE_LIBALTSOUND
	bool "libaltsound"
	select BR2_PACKAGE_ZLIB

	help
	  A cross platform compilation of altsound that is baked
	  directly into VPinMAME.

	  https://github.com/vpinball/libaltsound
	  www.vpforums.org
```

## package/batocera/engines/vpinball/libdmdutil/Config.in
```kconfig
config BR2_PACKAGE_LIBDMDUTIL
	bool "libdmdutil"
	select BR2_PACKAGE_CARGS
	select BR2_PACKAGE_LIBPUPDMD
	select BR2_PACKAGE_LIBSERIALPORT
	select BR2_PACKAGE_LIBSERUM
	select BR2_PACKAGE_LIBVNI
	select BR2_PACKAGE_LIBZEDMD
	select BR2_PACKAGE_SOCKPP

	help
	  A cross platform library for performing DMD tasks.

	  https://github.com/vpinball/libdmdutil
	  www.vpforums.org
```

## package/batocera/engines/vpinball/libvni/Config.in
```kconfig
config BR2_PACKAGE_LIBVNI
	bool "libvni"
	select BR2_PACKAGE_CARGS
	select BR2_PACKAGE_LIBPUPDMD
	select BR2_PACKAGE_LIBSERIALPORT
	select BR2_PACKAGE_LIBSERUM
	select BR2_PACKAGE_LIBZEDMD
	select BR2_PACKAGE_SOCKPP

	help
	  A simple platform-independent conversion to C++
	  of the VNI converter of LibDmd which written in C#,
	  keeping the same license GPLv2. LibDmd is part of
	  DMD Extensions.

	  https://github.com/PPUC/libvni
	  www.vpforums.org
```

## package/batocera/firmwares/rpi-eeprom/Config.in
```kconfig
config BR2_PACKAGE_RPI_EEPROM
	bool "rpi-eeprom"
	select BR2_PACKAGE_RPI_UTILS

	help
	  Installation scripts and binaries for the closed sourced Raspberry Pi 4 EEPROMs.

	  https://github.com/raspberrypi/rpi-eeprom.git
```

## package/batocera/firmwares/rpi-userland-batocera/Config.in
```kconfig
config BR2_PACKAGE_RPI_USERLAND_BATOCERA
	bool "rpi-userland-batocera"

	help
	  Raspberry Pi Userland contains the necessary library to use
	  the VideoCore driver.

	  https://github.com/raspberrypi/userland/

comment "rpi-userland needs a toolchain w/ C++, threads, dynamic library"
	depends on BR2_arm
	depends on !BR2_INSTALL_LIBSTDCPP || !BR2_TOOLCHAIN_HAS_THREADS || \
	  BR2_STATIC_LIBS
```

## package/batocera/firmwares/rpi-utils/Config.in
```kconfig
config BR2_PACKAGE_RPI_UTILS
	bool "rpi-utils"
	depends on !BR2_STATIC_LIBS # dtc
	select BR2_PACKAGE_DTC

	help
	  A collection of scripts and simple applications for the
	  Raspberry Pi.

	  https://github.com/raspberrypi/utils/
```

## package/batocera/firmwares/sound-open-firmware/Config.in
```kconfig
config BR2_PACKAGE_SOUND_OPEN_FIRMWARE
	bool "sound-open-firmware"
	select BR2_PACKAGE_ALLLINUXFIRMWARES
	select BR2_PACKAGE_ALSA_LIB
	select BR2_PACKAGE_ALSA_UTILS

	help
	  Open source audio DSP firmware and development tools.

	  https://www.sofproject.org/
```

## package/batocera/gpu/gl4es/glu/Config.in
```kconfig
config BR2_PACKAGE_GLU
	bool "glu"
	help
	  Graphics Library Utilities (GLU)
	  https://github.com/ptitSeb/GLU
```

## package/batocera/gpu/nvidia/batocera-nvidia/Config.in
```kconfig
config BR2_PACKAGE_BATOCERA_NVIDIA
	bool "batocera-nvidia"

	# drivers
	select BR2_PACKAGE_NVIDIA_OPEN_DRIVER       # the latest driver

	# xorg
	select BR2_PACKAGE_NVIDIA_OPEN_DRIVER_XORG

	# kernel modules
	select BR2_PACKAGE_NVIDIA_OPEN_DRIVER_MODULE

	# cuda
	select BR2_PACKAGE_NVIDIA_OPEN_DRIVER_CUDA

	help
	  This package helps switch between the different nvidia drivers
```

## package/batocera/gpu/vulkan/shaderc/Config.in
```kconfig
config BR2_PACKAGE_SHADERC
	bool "shaderc"
	select BR2_PACKAGE_GLSLANG
	select BR2_PACKAGE_HOST_PYTHON3
	select BR2_PACKAGE_HOST_PYTHON3_SSL
	select BR2_PACKAGE_SPIRV_TOOLS
	select BR2_PACKAGE_VULKAN_HEADERS
	select BR2_PACKAGE_VULKAN_LOADER
	select BR2_PACKAGE_WAYLAND				if BR2_PACKAGE_BATOCERA_WAYLAND

	help
	  A collection of tools, libraries, and tests for
	  Vulkan shader compilation.

	  https://github.com/google/shaderc.git
```

## package/batocera/gpu/vulkan/spirv-cross/Config.in
```kconfig
config BR2_PACKAGE_SPIRV_CROSS
	bool "spirv-cross"
	depends on BR2_INSTALL_LIBSTDCPP
	depends on !BR2_STATIC_LIBS
	depends on BR2_TOOLCHAIN_GCC_AT_LEAST_8 # C++17 filesystem
	select BR2_PACKAGE_SPIRV_HEADERS
	help
	  SPIRV-Cross is a tool designed for parsing and converting 
	  SPIR-V to other shader languages.

	  https://github.com/KhronosGroup/SPIRV-Cross

comment "spirv-tools needs a toolchain w/ C++, dynamic library, gcc >= 8"
	depends on !BR2_INSTALL_LIBSTDCPP || BR2_STATIC_LIBS || \
		!BR2_TOOLCHAIN_GCC_AT_LEAST_8
```

## package/batocera/gpu/vulkan/vulkan-volk/Config.in
```kconfig
config BR2_PACKAGE_VULKAN_VOLK
  bool "vulkan-volk"
  depends on BR2_PACKAGE_WAYLAND || BR2_PACKAGE_XORG7
  select BR2_PACKAGE_VULKAN_HEADERS
  select BR2_PACKAGE_VULKAN_LOADER
  help
    Meta loader for Vulkan API
```

## package/batocera/hardware/dockerpi-powerboard/Config.in
```kconfig
config BR2_PACKAGE_DOCKERPI_POWERBOARD
	bool "dockerpi-powerboard"

	help
	  Docker Pi Powerboard module for compatible RPi boards.

	  https://github.com/geeekpi/dockerpi
```

## package/batocera/kodi/kodi-audiodecoder-openmpt/Config.in
```kconfig
config BR2_PACKAGE_KODI_AUDIODECODER_OPENMPT
	bool "kodi-audiodecoder-openmpt"
	select BR2_PACKAGE_LIBOPENMPT
	select BR2_PACKAGE_ZLIB

	help
	  This is a Kodi audio decoder addon for tracker module files.

	  https://github.com/xbmc/audiodecoder.openmpt
```

## package/batocera/kodi/kodi-p8-platform/Config.in
```kconfig
config BR2_PACKAGE_KODI_P8_PLATFORM
	bool "kodi-p8-platform"
	help
	  Platform support library used by libCEC and binary add-ons for Kodi

	  https://github.com/xbmc/platform
```

## package/batocera/kodi/kodi-platform/Config.in
```kconfig
config BR2_PACKAGE_KODI_PLATFORM
	bool "kodi-platform"
	help

	  https://github.com/xbmc/kodi-platform
```

## package/batocera/kodi/kodi-pvr-freebox/Config.in
```kconfig
config BR2_PACKAGE_KODI_PVR_FREEBOX
	bool "kodi-pvr-freebox"
	select BR2_PACKAGE_JSON_FOR_MODERN_CPP

	help
	  Freebox PVR client addon for Kodi

	  https://github.com/aassif/pvr.freebox
```

## package/batocera/libraries/cpuinfo/Config.in
```kconfig
config BR2_PACKAGE_CPUINFO
	bool "cpuinfo"
	depends on BR2_INSTALL_LIBSTDCPP

	help
	  CPU INFOrmation library (x86/x86-64/ARM/ARM64, Linux/Windows/Android/macOS/iOS)

	  https://github.com/pytorch/cpuinfo.git

comment "BR2_PACKAGE_CPUINFO needs a toolchain w/ C++"
	depends on !BR2_INSTALL_LIBSTDCPP
```

## package/batocera/libraries/cxxopts/Config.in
```kconfig
config BR2_PACKAGE_CXXOPTS
	bool "cxxopts"

	help
	  Lightweight C++ command line option parser.
```

## package/batocera/libraries/discord-rpc/Config.in
```kconfig
config BR2_PACKAGE_DISCORD_RPC
	bool "discord-rpc"
	depends on BR2_INSTALL_LIBSTDCPP

	help
	  This is a library for interfacing your game with a locally running Discord desktop client

	  discordapp.com/developers

comment "BR2_PACKAGE_DISCORD_RPC needs a toolchain w/ C++"
	depends on !BR2_INSTALL_LIBSTDCPP
```

## package/batocera/libraries/freepats/Config.in
```kconfig
config BR2_PACKAGE_FREEPATS
    bool "freepats"
    help
      Free and Open general MIDI sound set

      https://freepats.zenvoid.org/SoundSets/general-midi.html
```

## package/batocera/libraries/iir/Config.in
```kconfig
config BR2_PACKAGE_IIR
	bool "iir"

	help
	  An infinite impulse response (IIR) filter library for Linux,
	  Mac OSX and Windows which implements Butterworth, RBJ,
	  Chebychevfilters and can easily import coefficients
	  generated by Python (scipy).
```

## package/batocera/libraries/kddocwidgets/Config.in
```kconfig
config BR2_PACKAGE_KDDOCWIDGETS
	bool "kddocwidgets"
	depends on BR2_PACKAGE_BATOCERA_QT6
	select BR2_PACKAGE_FMT
	select BR2_PACKAGE_JSON_FOR_MODERN_CPP
	select BR2_PACKAGE_SPDLOG

	help
	  KDABs Dock Widget Framework for Qt

	  https://www.kdab.com/software-technologies/developer-tools/kddockwidgets/
```
