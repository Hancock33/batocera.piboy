## package/batocera/desktop/wip/qtermwidget/Config.in
```kconfig
config BR2_PACKAGE_QTERMWIDGET
	bool "qtermwidget"
	select BR2_PACKAGE_BATOCERA_QT6
	select BR2_PACKAGE_QTXDG_TOOLS
	select BR2_PACKAGE_KWINDOWSYSTEM
	select BR2_PACKAGE_POLKITQT

	help
	  The terminal widget for QTerminal

	  https://lxqt-project.org/
```

## package/batocera/desktop/wip/screengrab/Config.in
```kconfig
config BR2_PACKAGE_SCREENGRAB
	bool "screengrab"
	select BR2_PACKAGE_BATOCERA_QT6
	select BR2_PACKAGE_QTXDG_TOOLS
	select BR2_PACKAGE_KWINDOWSYSTEM
	select BR2_PACKAGE_POLKITQT

	help
	  Crossplatform tool for fast making screenshots.

	  https://lxqt-project.org/
```

## package/batocera/desktop/wip/xdg_desktop_portal_lxqt/Config.in
```kconfig
config BR2_PACKAGE_XDG_DESKTOP_PORTAL_LXQT
	bool "xdg_desktop_portal_lxqt"
	select BR2_PACKAGE_BATOCERA_QT6
	select BR2_PACKAGE_QTXDG_TOOLS
	select BR2_PACKAGE_KWINDOWSYSTEM
	select BR2_PACKAGE_POLKITQT

	help
	  A backend implementation for xdg-desktop-portal

	  https://lxqt-project.org/
```

## package/batocera/emulators/applewin/Config.in
```kconfig
config BR2_PACKAGE_APPLEWIN
	bool "applewin"
	select BR2_PACKAGE_LIBPCAP
	select BR2_PACKAGE_SDL2
	select BR2_PACKAGE_SDL2_IMAGE
	select BR2_PACKAGE_SLIRP

	help
	  AppleWin linux / libretro port

	  https://github.com/audetto/AppleWin
```

## package/batocera/emulators/ares/Config.in
```kconfig
config BR2_PACKAGE_ARES
	bool "ares"
	select BR2_PACKAGE_CAIRO
	select BR2_PACKAGE_LIBGTK3
	select BR2_PACKAGE_PANGO
	select BR2_PACKAGE_SDL2
	select BR2_PACKAGE_ZLIB

	help
	  ares is a cross-platform, open source, multi-system emulator, focusing on accuracy and preservation.

	  https://ares-emu.net/
```

## package/batocera/emulators/citra/Config.in
```kconfig
config BR2_PACKAGE_CITRA
    bool "citra"
    select BR2_PACKAGE_FMT
    select BR2_PACKAGE_BOOST
    select BR2_PACKAGE_FFMPEG
    select BR2_PACKAGE_SDL2
    select BR2_PACKAGE_FDK_AAC
	# QT6
	select BR2_PACKAGE_QT6
	select BR2_PACKAGE_QT6BASE
	select BR2_PACKAGE_QT6BASE_CONCURRENT
	select BR2_PACKAGE_QT6BASE_DBUS
	select BR2_PACKAGE_QT6BASE_EGLFS
	select BR2_PACKAGE_QT6BASE_FONTCONFIG
	select BR2_PACKAGE_QT6BASE_GIF
	select BR2_PACKAGE_QT6BASE_GUI
	select BR2_PACKAGE_QT6BASE_HARFBUZZ
	select BR2_PACKAGE_QT6BASE_JPEG
	select BR2_PACKAGE_QT6BASE_NETWORK
	select BR2_PACKAGE_QT6BASE_OPENGL_DESKTOP
	select BR2_PACKAGE_QT6BASE_PNG
	select BR2_PACKAGE_QT6BASE_PRINTSUPPORT
	select BR2_PACKAGE_QT6BASE_WIDGETS
	select BR2_PACKAGE_QT6BASE_XCB
	select BR2_PACKAGE_QT6BASE_XML
	select BR2_PACKAGE_QT6SVG
	select BR2_PACKAGE_QT6TOOLS
	select BR2_PACKAGE_QT6MULTIMEDIA
    help
      Citra is an open-source emulator for the Nintendo 3DS.

	    https://citra-emu.org/
```

## package/batocera/emulators/citron/Config.in
```kconfig
config BR2_PACKAGE_CITRON
	bool "citron"
	depends on BR2_x86_64
	depends on BR2_PACKAGE_XORG7
	select BR2_PACKAGE_BATOCERA_QT6
	select BR2_PACKAGE_BOOST
	select BR2_PACKAGE_BOOST_CONTEXT
	select BR2_PACKAGE_CATCH2
	select BR2_PACKAGE_FFMPEG
	select BR2_PACKAGE_FMT
	select BR2_PACKAGE_JSON_FOR_MODERN_CPP
	select BR2_PACKAGE_LIBZIP
	select BR2_PACKAGE_LZ4
	select BR2_PACKAGE_OPUS
	select BR2_PACKAGE_SDL2
	select BR2_PACKAGE_VULKAN_HEADERS
	select BR2_PACKAGE_VULKAN_LOADER
	select BR2_PACKAGE_VULKAN_VALIDATIONLAYERS
	select BR2_PACKAGE_ZLIB
	select BR2_PACKAGE_ZSTD

	help
	  A familiar, open source, and powerful
	  Nintendo Switch emulator.

	  https://citron-emu.org/
```

## package/batocera/emulators/dolphin-emu/Config.in
```kconfig
config BR2_PACKAGE_DOLPHIN_EMU
	bool "dolphin-emu"
	depends on BR2_x86_64 || BR2_aarch64
	select BR2_PACKAGE_XORG7		        if BR2_PACKAGE_BATOCERA_TARGET_X86_64_ANY
	select BR2_PACKAGE_LIBEVDEV
	select BR2_PACKAGE_FFMPEG
	select BR2_PACKAGE_ZLIB
	select BR2_PACKAGE_XZ
	select BR2_PACKAGE_LIBPNG
	select BR2_PACKAGE_LZO
	select BR2_PACKAGE_LIBUSB
	select BR2_PACKAGE_LIBCURL
	select BR2_PACKAGE_BLUEZ5_UTILS
	select BR2_PACKAGE_HIDAPI
	# QT6
	select BR2_PACKAGE_QT6
	select BR2_PACKAGE_QT6BASE
	select BR2_PACKAGE_QT6BASE_CONCURRENT
	select BR2_PACKAGE_QT6BASE_DBUS
	select BR2_PACKAGE_QT6BASE_EGLFS
	select BR2_PACKAGE_QT6BASE_FONTCONFIG
	select BR2_PACKAGE_QT6BASE_GIF
	select BR2_PACKAGE_QT6BASE_GUI
	select BR2_PACKAGE_QT6BASE_HARFBUZZ
	select BR2_PACKAGE_QT6BASE_JPEG
	select BR2_PACKAGE_QT6BASE_NETWORK
	select BR2_PACKAGE_QT6BASE_OPENGL_DESKTOP
	select BR2_PACKAGE_QT6BASE_PNG
	select BR2_PACKAGE_QT6BASE_PRINTSUPPORT
	select BR2_PACKAGE_QT6BASE_WIDGETS
	select BR2_PACKAGE_QT6BASE_XCB
	select BR2_PACKAGE_QT6BASE_XML

	help
	  Gamecube/Wii emulator

        comment "DOLPHIN_EMU needs a toolchain w/ C++, OpenGL"
        depends on !BR2_INSTALL_LIBSTDCPP || !BR2_PACKAGE_HAS_LIBGL
```

## package/batocera/emulators/dolphin-triforce/Config.in
```kconfig
config BR2_PACKAGE_DOLPHIN_TRIFORCE
	bool "dolphin-triforce"

	help
	  TriForce arcade emulator

comment "DOLPHIN_TRIFORCE needs a toolchain w/ C++, OpenGL"
```

## package/batocera/emulators/duckstation-legacy/Config.in
```kconfig
config BR2_PACKAGE_DUCKSTATION_LEGACY
	bool "duckstation-legacy"
	select BR2_PACKAGE_BOOST
	select BR2_PACKAGE_DBUS
	select BR2_PACKAGE_ECM
	select BR2_PACKAGE_FFMPEG
	select BR2_PACKAGE_FMT
	select BR2_PACKAGE_LIBCURL
	select BR2_PACKAGE_LIBDRM
	select BR2_PACKAGE_LIBEVDEV
	select BR2_PACKAGE_LIBXKBCOMMON
	select BR2_PACKAGE_SDL2
	select BR2_PACKAGE_SHADERC
	select BR2_PACKAGE_WEBP
	select BR2_PACKAGE_WEBP_DEMUX
	select BR2_PACKAGE_WEBP_MUX
	select BR2_PACKAGE_ZSTD

	help
		DuckStation - PlayStation 1, aka. PSX Emulator
		https://github.com/stenzek/duckstation
```

## package/batocera/emulators/duckstation/Config.in
```kconfig
config BR2_PACKAGE_DUCKSTATION
	bool "duckstation"
	select BR2_PACKAGE_BATOCERA_QT6    if BR2_x86_64
	select BR2_PACKAGE_BATOCERA_SDL3
	select BR2_PACKAGE_BOOST
	select BR2_PACKAGE_CPUINFO
	select BR2_PACKAGE_DUCKSTATION_COMMON
	select BR2_PACKAGE_ECM
	select BR2_PACKAGE_FFMPEG
	select BR2_PACKAGE_FMT
	select BR2_PACKAGE_LIBBACKTRACE
	select BR2_PACKAGE_LIBCURL
	select BR2_PACKAGE_LIBDRM
	select BR2_PACKAGE_LIBEVDEV
	select BR2_PACKAGE_LIBSOUNDTOUCH
	select BR2_PACKAGE_LIBXKBCOMMON
	select BR2_PACKAGE_NOTO_CJK_FONTS
	select BR2_PACKAGE_PLUTOSVG
	select BR2_PACKAGE_PLUTOVG
	select BR2_PACKAGE_QT6WAYLAND      if BR2_PACKAGE_BATOCERA_WAYLAND
	select BR2_PACKAGE_STENZEK_SHADERC
	select BR2_PACKAGE_SPIRV_CROSS
	select BR2_PACKAGE_WEBP
	select BR2_PACKAGE_WEBP_DEMUX
	select BR2_PACKAGE_WEBP_MUX
	select BR2_PACKAGE_ZSTD

	help
	  DuckStation - PlayStation 1, aka. PSX Emulator
	  https://github.com/stenzek/duckstation
```

## package/batocera/emulators/eden/Config.in
```kconfig
config BR2_PACKAGE_EDEN
	bool "eden"
	depends on BR2_x86_64
	depends on BR2_PACKAGE_XORG7
	select BR2_PACKAGE_BATOCERA_QT6
	select BR2_PACKAGE_BOOST
	select BR2_PACKAGE_BOOST_CONTEXT
	select BR2_PACKAGE_BOOST_FIBER
	select BR2_PACKAGE_CATCH2
	select BR2_PACKAGE_ENET
	select BR2_PACKAGE_FFMPEG
	select BR2_PACKAGE_FMT
	select BR2_PACKAGE_JSON_FOR_MODERN_CPP
	select BR2_PACKAGE_LIBVA
	select BR2_PACKAGE_LIBZIP
	select BR2_PACKAGE_LZ4
	select BR2_PACKAGE_OPUS
	select BR2_PACKAGE_SDL2
	select BR2_PACKAGE_VULKAN_HEADERS
	select BR2_PACKAGE_VULKAN_LOADER
	select BR2_PACKAGE_VULKAN_VALIDATIONLAYERS
	select BR2_PACKAGE_ZLIB
	select BR2_PACKAGE_ZSTD

	help
	  Eden: Nintendo Switch Emulator

	  https://eden-emu.dev/
```

## package/batocera/emulators/flycast/Config.in
```kconfig
config BR2_PACKAGE_FLYCAST
	bool "flycast"
	depends on BR2_GCC_ENABLE_OPENMP
	select BR2_PACKAGE_LIBEVDEV
	select BR2_PACKAGE_LIBAO
	select BR2_PACKAGE_LIBCURL
	select BR2_PACKAGE_LIBMINIUPNPC
	select BR2_PACKAGE_LIBPNG
	select BR2_PACKAGE_LIBZIP
	select BR2_PACKAGE_SDL2

	help
	  Flycast is a multi-platform Sega emulator for
	  - Dreamcast
	  - Naomi
	  - Atomiswave
```

## package/batocera/emulators/flycast2022/Config.in
```kconfig
config BR2_PACKAGE_FLYCAST2022
    bool "flycast2022"
    depends on BR2_PACKAGE_SDL2
    depends on BR2_PACKAGE_LIBPNG
    depends on BR2_PACKAGE_LIBZIP
    depends on BR2_GCC_ENABLE_OPENMP
    select BR2_PACKAGE_LIBAO
    select BR2_PACKAGE_PULSEAUDIO_UTILS #libpulse

    help
        Flycast is a multi-platform Sega Dreamcast, Naomi and Atomiswave emulator.
```

## package/batocera/emulators/fpinball/Config.in
```kconfig
config BR2_PACKAGE_FPINBALL
	bool "fpinball"
	depends on BR2_x86_64
	depends on BR2_PACKAGE_BATOCERA_WINE
	help
	  Future Pinball precompiled for 32bit Windows running through Wine.

	  https://futurepinball.com

	  Updated Better Arcade Mode (BAM)

	  https://ravarcade.pl
```

## package/batocera/emulators/fsuae/Config.in
```kconfig
config BR2_PACKAGE_FSUAE
	bool "fs-uae"
	depends on BR2_PACKAGE_LIBGLIB2
	depends on BR2_PACKAGE_XORG7
	select BR2_PACKAGE_LIBCAPSIMAGE
	select BR2_PACKAGE_LIBMPEG2
	select BR2_PACKAGE_LIBPNG
	select BR2_PACKAGE_OPENAL
	select BR2_PACKAGE_SDL3
	select BR2_PACKAGE_SDL3_IMAGE
	select BR2_PACKAGE_SDL3_TTF
	select BR2_PACKAGE_ZLIB

	help
	  A crossplatform amiga emulator
```

## package/batocera/emulators/hatari/Config.in
```kconfig
config BR2_PACKAGE_HATARI
	bool "hatari"
	select BR2_PACKAGE_LIBCAPSIMAGE
	select BR2_PACKAGE_LIBPNG
	select BR2_PACKAGE_SDL2
	select BR2_PACKAGE_ZLIB

	help
	  An Atari ST/STe/TT/Falcon emulator
```

## package/batocera/emulators/hcl/Config.in
```kconfig
config BR2_PACKAGE_HCL
	bool "hcl"
	depends on BR2_PACKAGE_SDL2
	depends on BR2_PACKAGE_SDL2_MIXER
	depends on BR2_INSTALL_LIBSTDCPP
	help
	  Hydra Castle Labyrinth is a platform game with some old school action. Its also reminiscent of games of the 16 bit era.

	  http://ptitseb.github.io/hydracastlelabyrinth

comment "BR2_PACKAGE_hcl needs a toolchain w/ C++"
	depends on !BR2_INSTALL_LIBSTDCPP
```

## package/batocera/emulators/jdk/jdk-rpi3/Config.in
```kconfig
config BR2_PACKAGE_JDK_RPI3
    bool "jdk-rpi3"
    help
      openJDK precompiled for RPI3

      https://github.com/Hancock33/openjdk-batocera
```

## package/batocera/emulators/jdk/jdk-rpi4/Config.in
```kconfig
config BR2_PACKAGE_JDK_RPI4
    bool "jdk-rpi4"
    select BR2_PACKAGE_XLIB_LIBXTST
    help
      openJDK precompiled for RPI4

      https://github.com/Hancock33/openjdk-batocera
```

## package/batocera/emulators/jdk/jdk-x86_64/Config.in
```kconfig
config BR2_PACKAGE_JDK_X86_64
    bool "jdk-x86_64"
    help
      openJDK precompiled for X86_64

      https://github.com/Hancock33/openjdk-batocera
```

## package/batocera/emulators/linapple/Config.in
```kconfig
config BR2_PACKAGE_LINAPPLE
	bool "linapple"
	depends on BR2_INSTALL_LIBSTDCPP
	depends on BR2_PACKAGE_SDL
	depends on BR2_PACKAGE_SDL_IMAGE
	depends on BR2_PACKAGE_SDL_IMAGE_BMP
	depends on BR2_PACKAGE_SDL_IMAGE_XPM
	depends on BR2_PACKAGE_LIBCURL
	depends on BR2_PACKAGE_ZLIB
	depends on BR2_PACKAGE_LIBZIP
	help
	  LinApple is an emulator for Apple II, Apple II+, Apple //e, and Enhanced Apple //e computers.

	  https://github.com/linappleii/linapple

comment "LinApple needs a toolchain w/ C++, and following librarie : sdl, sdl_image (bmp, xpm), curl, zlib and libzip"
	depends on !BR2_INSTALL_LIBSTDCPP || !BR2_PACKAGE_SDL || !BR2_PACKAGE_SDL_IMAGE || !BR2_PACKAGE_SDL_IMAGE_BMP || !BR2_PACKAGE_SDL_IMAGE_XPM || !BR2_PACKAGE_ZLIB || !BR2_PACKAGE_LIBZIP
```

## package/batocera/emulators/melonds/Config.in
```kconfig
config BR2_PACKAGE_MELONDS
    bool "melonDS"
    select BR2_PACKAGE_LIBARCHIVE
    select BR2_PACKAGE_LIBEPOXY
    select BR2_PACKAGE_SDL2
    select BR2_PACKAGE_SLIRP
	# QT6
	select BR2_PACKAGE_QT6
	select BR2_PACKAGE_QT6BASE
	select BR2_PACKAGE_QT6BASE_CONCURRENT
	select BR2_PACKAGE_QT6BASE_DBUS
	select BR2_PACKAGE_QT6BASE_EGLFS
	select BR2_PACKAGE_QT6BASE_FONTCONFIG
	select BR2_PACKAGE_QT6BASE_GIF
	select BR2_PACKAGE_QT6BASE_GUI
	select BR2_PACKAGE_QT6BASE_HARFBUZZ
	select BR2_PACKAGE_QT6BASE_JPEG
	select BR2_PACKAGE_QT6BASE_NETWORK
	select BR2_PACKAGE_QT6BASE_OPENGL_DESKTOP
	select BR2_PACKAGE_QT6BASE_PNG
	select BR2_PACKAGE_QT6BASE_PRINTSUPPORT
	select BR2_PACKAGE_QT6BASE_WIDGETS
	select BR2_PACKAGE_QT6BASE_XCB
	select BR2_PACKAGE_QT6BASE_XML
	select BR2_PACKAGE_QT6SVG
	select BR2_PACKAGE_QT6TOOLS
	select BR2_PACKAGE_QT6MULTIMEDIA

    help
      Ninteno DS emulator, sorta

	    http://melonds.kuribo64.net/
```

## package/batocera/emulators/panda3ds/Config.in
```kconfig
config BR2_PACKAGE_PANDA3DS
	bool "panda3ds"
	select BR2_PACKAGE_BATOCERA_QT6
	select BR2_PACKAGE_FMT
	select BR2_PACKAGE_BOOST
	select BR2_PACKAGE_BOOST_CONTAINER
	select BR2_PACKAGE_BOOST_IOSTREAMS
	select BR2_PACKAGE_BOOST_LOCALE
	select BR2_PACKAGE_BOOST_REGEX
	select BR2_PACKAGE_BOOST_SERIALIZATION
	select BR2_PACKAGE_CATCH2
	select BR2_PACKAGE_CUBEB
	select BR2_PACKAGE_FFMPEG
	select BR2_PACKAGE_SDL2
	select BR2_PACKAGE_FDK_AAC
	select BR2_PACKAGE_LIBBACKTRACE

	help
	  Panda3DS is an HLE, red-panda-themed Nintendo 3DS emulator.
	  https://panda3ds.com/
```

## package/batocera/emulators/pcsx2-avx2/Config.in
```kconfig
config BR2_PACKAGE_PCSX2_AVX2
    bool "pcsx2-avx2"
	depends on BR2_x86_64
	depends on BR2_PACKAGE_XORG7
	select BR2_PACKAGE_FMT
	select BR2_PACKAGE_ALSA_LIB
	select BR2_PACKAGE_FREETYPE
	select BR2_PACKAGE_ZLIB
	select BR2_PACKAGE_LIBPNG
	select BR2_PACKAGE_LIBAIO
	select BR2_PACKAGE_PORTAUDIO
	select BR2_PACKAGE_LIBSOUNDTOUCH
	select BR2_PACKAGE_LIBSAMPLERATE
	select BR2_PACKAGE_SDL2
	select BR2_PACKAGE_DEJAVU
	select BR2_PACKAGE_LIBPCAP
	select BR2_PACKAGE_YAML_CPP
	select BR2_PACKAGE_LIBGTK3
	select BR2_PACKAGE_BATOCERA_VULKAN
	# QT6
	select BR2_PACKAGE_QT6
	select BR2_PACKAGE_QT6BASE
	select BR2_PACKAGE_QT6BASE_CONCURRENT
	select BR2_PACKAGE_QT6BASE_DBUS
	select BR2_PACKAGE_QT6BASE_EGLFS
	select BR2_PACKAGE_QT6BASE_FONTCONFIG
	select BR2_PACKAGE_QT6BASE_GIF
	select BR2_PACKAGE_QT6BASE_GUI
	select BR2_PACKAGE_QT6BASE_HARFBUZZ
	select BR2_PACKAGE_QT6BASE_JPEG
	select BR2_PACKAGE_QT6BASE_NETWORK
	select BR2_PACKAGE_QT6BASE_OPENGL_DESKTOP
	select BR2_PACKAGE_QT6BASE_PNG
	select BR2_PACKAGE_QT6BASE_PRINTSUPPORT
	select BR2_PACKAGE_QT6BASE_WIDGETS
	select BR2_PACKAGE_QT6BASE_XCB
	select BR2_PACKAGE_QT6BASE_XML
	select BR2_PACKAGE_QT6SVG
	select BR2_PACKAGE_QT6TOOLS

    help
        PCSX2 is a free and open-source PlayStation 2 (PS2) emulator.

		https://github.com/PCSX2/pcsx2
```
