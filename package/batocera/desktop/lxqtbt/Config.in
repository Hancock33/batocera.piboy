## package/batocera/desktop/lxqtbt/Config.in
```kconfig
config BR2_PACKAGE_LXQTBT
	bool "lxqtbt"
	select BR2_PACKAGE_BATOCERA_QT6

	help
	  Various packaging tools and scripts for LXQt applications.

	  https://lxqt-project.org/
```

## package/batocera/desktop/lxqtmenudata/Config.in
```kconfig
config BR2_PACKAGE_LXQTMENUDATA
	bool "lxqtmenudata"
	select BR2_PACKAGE_BATOCERA_QT6
	select BR2_PACKAGE_LXQTBT

	help
	  Library used to query system info and statistics

	  https://lxqt-project.org/
```

## package/batocera/desktop/pcmanfmqt6/Config.in
```kconfig
config BR2_PACKAGE_PCMANFMQT6
	bool "pcmanfmqt6"
	select BR2_PACKAGE_BATOCERA_QT6
	BR2_PACKAGE_LAYERSHELLQT
	select BR2_PACKAGE_LIBEXIF
	select BR2_PACKAGE_LIBFMQT6
	select BR2_PACKAGE_LIBLXQT
	select BR2_PACKAGE_LXQTMENUDATA

	help
	  Core library of PCManFM-Qt (Qt binding for libfm)

	  https://lxqt-project.org/
```

## package/batocera/desktop/polkitqt/Config.in
```kconfig
config BR2_PACKAGE_POLKITQT
	bool "polkitqt"
	select BR2_PACKAGE_BATOCERA_QT6
	select BR2_PACKAGE_POLKIT

	help
	  Qt wrapper around Polkit-1 client libraries

	  https://community.kde.org/Frameworks
```

## package/batocera/desktop/qtxdg-tools/Config.in
```kconfig
config BR2_PACKAGE_QTXDG_TOOLS
	bool "qtxdg-tools"
	select BR2_PACKAGE_BATOCERA_QT6
	select BR2_PACKAGE_LIBQTXDG

	help
	  Qt implementation of freedesktop.org xdg specs

	  https://lxqt-project.org/
```

## package/batocera/desktop/wip/lximage_qt/Config.in
```kconfig
config BR2_PACKAGE_LXIMAGE_QT
	bool "lximage_qt"
	select BR2_PACKAGE_BATOCERA_QT6
	select BR2_PACKAGE_QTXDG_TOOLS
	select BR2_PACKAGE_KWINDOWSYSTEM
	select BR2_PACKAGE_POLKITQT

	help
	  The image viewer and screenshot tool for lxqt

	  https://lxqt-project.org/
```

## package/batocera/desktop/wip/lxqt_about/Config.in
```kconfig
config BR2_PACKAGE_LXQT_ABOUT
	bool "lxqt_about"
	select BR2_PACKAGE_BATOCERA_QT6
	select BR2_PACKAGE_QTXDG_TOOLS
	select BR2_PACKAGE_KWINDOWSYSTEM
	select BR2_PACKAGE_POLKITQT

	help
	  Dialogue window providing information about LXQt
	  and the system it's running on

	  https://lxqt-project.org/
```

## package/batocera/desktop/wip/lxqt_admin/Config.in
```kconfig
config BR2_PACKAGE_LXQT_ADMIN
	bool "lxqt_admin"
	select BR2_PACKAGE_BATOCERA_QT6
	select BR2_PACKAGE_QTXDG_TOOLS
	select BR2_PACKAGE_KWINDOWSYSTEM
	select BR2_PACKAGE_POLKITQT

	help
	  LXQt system administration tool

	  https://lxqt-project.org/
```

## package/batocera/desktop/wip/lxqt_archiver/Config.in
```kconfig
config BR2_PACKAGE_LXQT_ARCHIVER
	bool "lxqt_archiver
"
	select BR2_PACKAGE_BATOCERA_QT6
	select BR2_PACKAGE_QTXDG_TOOLS
	select BR2_PACKAGE_KWINDOWSYSTEM
	select BR2_PACKAGE_POLKITQT

	help
	  A simple & lightweight desktop-agnostic Qt file archiver

	  https://lxqt-project.org/
```

## package/batocera/desktop/wip/lxqt_config/Config.in
```kconfig
config BR2_PACKAGE_LXQT_CONFIG
	bool "lxqt_config"
	select BR2_PACKAGE_BATOCERA_QT6
	select BR2_PACKAGE_QTXDG_TOOLS
	select BR2_PACKAGE_KWINDOWSYSTEM
	select BR2_PACKAGE_POLKITQT

	help
	  Tools to configure LXQt and the underlying operating system

	  https://lxqt-project.org/
```

## package/batocera/desktop/wip/lxqt_globalkeys/Config.in
```kconfig
config BR2_PACKAGE_LXQT_GLOBALKEYS
	bool "lxqt_globalkeys"
	select BR2_PACKAGE_BATOCERA_QT6
	select BR2_PACKAGE_QTXDG_TOOLS
	select BR2_PACKAGE_KWINDOWSYSTEM
	select BR2_PACKAGE_POLKITQT

	help
	  Daemon used to register global keyboard shortcuts

	  https://lxqt-project.org/
```

## package/batocera/desktop/wip/lxqt_notificationd/Config.in
```kconfig
config BR2_PACKAGE_LXQT_NOTIFICATIOND
	bool "lxqt_notificationd"
	select BR2_PACKAGE_BATOCERA_QT6
	select BR2_PACKAGE_QTXDG_TOOLS
	select BR2_PACKAGE_KWINDOWSYSTEM
	select BR2_PACKAGE_POLKITQT

	help
	  The LXQt notification daemon

	  https://lxqt-project.org/
```

## package/batocera/desktop/wip/lxqt_openssh_askpass/Config.in
```kconfig
config BR2_PACKAGE_LXQT_OPENSSH_ASKPASS
	bool "lxqt_openssh_askpass"
	select BR2_PACKAGE_BATOCERA_QT6
	select BR2_PACKAGE_QTXDG_TOOLS
	select BR2_PACKAGE_KWINDOWSYSTEM
	select BR2_PACKAGE_POLKITQT

	help
	  GUI to query passwords on behalf of SSH agents.

	  https://lxqt-project.org/
```

## package/batocera/desktop/wip/lxqt_panel/Config.in
```kconfig
config BR2_PACKAGE_LXQT_PANEL
	bool "lxqt_panel"
	select BR2_PACKAGE_BATOCERA_QT6
	select BR2_PACKAGE_QTXDG_TOOLS
	select BR2_PACKAGE_KWINDOWSYSTEM
	select BR2_PACKAGE_POLKITQT

	help
	  The LXQt desktop panel.

	  https://lxqt-project.org/
```

## package/batocera/desktop/wip/lxqt_policykit/Config.in
```kconfig
config BR2_PACKAGE_LXQT_POLICYKIT
	bool "lxqt_policykit"
	select BR2_PACKAGE_BATOCERA_QT6
	select BR2_PACKAGE_QTXDG_TOOLS
	select BR2_PACKAGE_KWINDOWSYSTEM
	select BR2_PACKAGE_POLKITQT

	help
	  The LXQt PolicyKit agent

	  https://lxqt-project.org/
```

## package/batocera/desktop/wip/lxqt_powermanagement/Config.in
```kconfig
config BR2_PACKAGE_LXQT_POWERMANAGEMENT
	bool "lxqt_powermanagement"
	select BR2_PACKAGE_BATOCERA_QT6
	select BR2_PACKAGE_QTXDG_TOOLS
	select BR2_PACKAGE_KWINDOWSYSTEM
	select BR2_PACKAGE_POLKITQT

	help
	  Power management module for LXQt

	  https://lxqt-project.org/
```

## package/batocera/desktop/wip/lxqt_qtplugin/Config.in
```kconfig
config BR2_PACKAGE_LXQT_QTPLUGIN
	bool "lxqt_qtplugin"
	select BR2_PACKAGE_BATOCERA_QT6
	select BR2_PACKAGE_QTXDG_TOOLS
	select BR2_PACKAGE_KWINDOWSYSTEM
	select BR2_PACKAGE_POLKITQT

	help
	  LXQt Qt platform integration plugin

	  https://lxqt-project.org/
```

## package/batocera/desktop/wip/lxqt_runner/Config.in
```kconfig
config BR2_PACKAGE_LXQT_RUNNER
	bool "lxqt_runner"
	select BR2_PACKAGE_BATOCERA_QT6
	select BR2_PACKAGE_QTXDG_TOOLS
	select BR2_PACKAGE_KWINDOWSYSTEM
	select BR2_PACKAGE_POLKITQT

	help
	  Tool used to launch programs quickly by typing their names

	  https://lxqt-project.org/
```

## package/batocera/desktop/wip/lxqt_session/Config.in
```kconfig
config BR2_PACKAGE_LXQT_SESSION
	bool "lxqt_session"
	select BR2_PACKAGE_BATOCERA_QT6
	select BR2_PACKAGE_QTXDG_TOOLS
	select BR2_PACKAGE_KWINDOWSYSTEM
	select BR2_PACKAGE_POLKITQT

	help
	  The LXQt session manager

	  https://lxqt-project.org/
```

## package/batocera/desktop/wip/lxqt_sudo/Config.in
```kconfig
config BR2_PACKAGE_LXQT_SUDO
	bool "lxqt_sudo"
	select BR2_PACKAGE_BATOCERA_QT6
	select BR2_PACKAGE_QTXDG_TOOLS
	select BR2_PACKAGE_KWINDOWSYSTEM
	select BR2_PACKAGE_POLKITQT

	help
	  GUI frontend for sudo/su

	  https://lxqt-project.org/
```

## package/batocera/desktop/wip/lxqt_themes/Config.in
```kconfig
config BR2_PACKAGE_LXQT_THEMES
	bool "lxqt_themes"
	select BR2_PACKAGE_BATOCERA_QT6
	select BR2_PACKAGE_QTXDG_TOOLS
	select BR2_PACKAGE_KWINDOWSYSTEM
	select BR2_PACKAGE_POLKITQT

	help
	  Themes, graphics and icons for LXQt

	  https://lxqt-project.org/
```

## package/batocera/desktop/wip/obconf_qt/Config.in
```kconfig
config BR2_PACKAGE_OBCONF_QT
	bool "obconf_qt"
	select BR2_PACKAGE_BATOCERA_QT6
	select BR2_PACKAGE_QTXDG_TOOLS
	select BR2_PACKAGE_KWINDOWSYSTEM
	select BR2_PACKAGE_POLKITQT

	help
	  The Qt port of obconf, the Openbox configuration tool

	  https://lxqt-project.org/
```

## package/batocera/desktop/wip/pavucontrol_qt/Config.in
```kconfig
config BR2_PACKAGE_PAVUCONTROL_QT
	bool "pavucontrol_qt"
	select BR2_PACKAGE_BATOCERA_QT6
	select BR2_PACKAGE_QTXDG_TOOLS
	select BR2_PACKAGE_KWINDOWSYSTEM
	select BR2_PACKAGE_POLKITQT

	help
	  A Pulseaudio mixer in Qt (port of pavucontrol)

	  https://lxqt-project.org/
```

## package/batocera/desktop/wip/qps/Config.in
```kconfig
config BR2_PACKAGE_QPS
	bool "QPS"
	select BR2_PACKAGE_BATOCERA_QT6
	select BR2_PACKAGE_QTXDG_TOOLS
	select BR2_PACKAGE_KWINDOWSYSTEM
	select BR2_PACKAGE_POLKITQT

	help
	  Qt process viewer and manager

	  https://lxqt-project.org/
```

## package/batocera/desktop/wip/qterminal/Config.in
```kconfig
config BR2_PACKAGE_QTERMINAL
	bool "qterminal"
	select BR2_PACKAGE_BATOCERA_QT6
	select BR2_PACKAGE_QTXDG_TOOLS
	select BR2_PACKAGE_KWINDOWSYSTEM
	select BR2_PACKAGE_POLKITQT

	help
	  A lightweight Qt-based terminal emulator

	  https://lxqt-project.org/
```
