## package/batocera/boot/rockpro64-blobs/Config.in
```kconfig
config BR2_PACKAGE_ROCKPRO64_BLOBS
	bool "rockpro64-blobs"

	help
	  Binary boot blobs for the Pine64 RockPro64 board.

	  https://github.com/batocera-linux/rockpro64-blobs
```

## package/batocera/controllers/pads/keyboardtopads/Config.in
```kconfig
config BR2_PACKAGE_KEYBOARDTOPADS
	bool "keyboardtopads"
	select BR2_PACKAGE_EVSIEVE

	help
	  Maps keyboard input to virtual gamepads, using evsieve.
```

## package/batocera/controllers/pads/uinput-joystick/Config.in
```kconfig
config BR2_PACKAGE_UINPUT_JOYSTICK
	bool "uinput-joystick"

	help
	  The uinput_joystick and fftest utilities.

	  https://github.com/shantigilbert/uinput_joystick
```

## package/batocera/controllers/wheels/hid-t150/Config.in
```kconfig
config BR2_PACKAGE_HID_T150
	bool "hid-t150"

	help
	  Linux kernel driver for the Thrustmaster T150 racing wheel.

	  https://github.com/scarburato/t150_driver
```

## package/batocera/core/batocera-drminfo/Config.in
```kconfig
config BR2_PACKAGE_BATOCERA_DRMINFO
	bool "batocera-drminfo"
	depends on BR2_PACKAGE_LIBDRM

	help
	  Utility that reports DRM/KMS display information.
```

## package/batocera/emulators/drastic/Config.in
```kconfig
config BR2_PACKAGE_DRASTIC
	bool "drastic"
	select BR2_PACKAGE_SDL2
	select BR2_PACKAGE_BATOCERA_LAUNCH_DRASTIC

	help
	  Drastic is a Nintendo DS emulator.
	  This is an Aarch64 specific binary.
	  https://www.drastic-ds.com/
```

## package/batocera/emulators/eka2l1/Config.in
```kconfig
config BR2_PACKAGE_EKA2L1
	bool "eka2l1"
	select BR2_PACKAGE_BATOCERA_QT6
	select BR2_PACKAGE_GTK_LAYER_SHELL if BR2_PACKAGE_WAYLAND
	select BR2_PACKAGE_LIBGTK3
	select BR2_PACKAGE_PYTHON_GOBJECT

	help
	  Symbian OS / N-Gage emulator

	  https://github.com/EKA2L1/EKA2L1
```

## package/batocera/emulators/retroarch/libretro/libretro-amiberry/Config.in
```kconfig
config BR2_PACKAGE_LIBRETRO_AMIBERRY
	bool "libretro-amiberry"
	depends on BR2_INSTALL_LIBSTDCPP
	select BR2_PACKAGE_ZLIB

	help
	  Amiberry libretro core, an optimised Amiga emulator based on
	  UAE, for the Amiga 500, 1200, CD32 and CDTV.

	  The Kickstart ROMs are required in bios/amiga.

	  https://github.com/BlitterStudio/amiberry

comment "LIBRETRO_AMIBERRY needs a toolchain w/ C++"
	depends on !BR2_INSTALL_LIBSTDCPP
```

## package/batocera/emulators/retroarch/libretro/libretro-armsx2/Config.in
```kconfig
config BR2_PACKAGE_LIBRETRO_ARMSX2
	bool "libretro-armsx2"
	depends on BR2_INSTALL_LIBSTDCPP

	help
	  A libretro core for PS2

	  http://www.libretro.com

comment "LIBRETRO_ARMSX2 needs a toolchain w/ C++"
	depends on !BR2_INSTALL_LIBSTDCPP
```

## package/batocera/emulators/retroarch/libretro/libretro-eduke32/Config.in
```kconfig
config BR2_PACKAGE_LIBRETRO_EDUKE32
	bool "libretro-eduke32"
	depends on BR2_INSTALL_LIBSTDCPP

	help
	  EDuke32 libretro core, a Build Engine source port for playing
	  Duke Nukem 3D.

	  The game data (for example DUKE3D.GRP) is required.

	  https://github.com/cscd98/eduke32-libretro

comment "LIBRETRO_EDUKE32 needs a toolchain w/ C++"
	depends on !BR2_INSTALL_LIBSTDCPP
```

## package/batocera/emulators/retroarch/libretro/libretro-eka2l1/Config.in
```kconfig
config BR2_PACKAGE_LIBRETRO_EKA2L1
	bool "libretro-eka2l1"
	depends on BR2_INSTALL_LIBSTDCPP
	depends on BR2_x86_64 || BR2_aarch64
	select BR2_PACKAGE_ZLIB

	help
	  EKA2L1 libretro core, a Symbian OS and Nokia N-Gage emulator.

	  https://github.com/WizzardSK/eka2l1-libretro

comment "LIBRETRO_EKA2L1 needs a toolchain w/ C++, and an x86_64 or aarch64 target"
	depends on !BR2_INSTALL_LIBSTDCPP || !(BR2_x86_64 || BR2_aarch64)
```

## package/batocera/emulators/retroarch/libretro/libretro-gametank/Config.in
```kconfig
config BR2_PACKAGE_LIBRETRO_GAMETANK
	bool "libretro-gametank"
	depends on BR2_INSTALL_LIBSTDCPP

	help
	  GameTank libretro core, for the GameTank 8-bit homebrew game
	  console built around two 65C02 CPUs. Based on GameTankEmulator.

	  https://github.com/SundownerSport/gametank-libretro
	  https://gametank.zone/

comment "LIBRETRO_GAMETANK needs a toolchain w/ C++"
	depends on !BR2_INSTALL_LIBSTDCPP
```

## package/batocera/emulators/retroarch/libretro/libretro-parallel-dc/Config.in
```kconfig
config BR2_PACKAGE_LIBRETRO_PARALLEL_DC
	bool "libretro-parallel-dc"
	depends on BR2_INSTALL_LIBSTDCPP
	depends on BR2_GCC_ENABLE_OPENMP
	depends on (BR2_PACKAGE_HAS_LIBGLES || BR2_PACKAGE_HAS_LIBGL)

	help
	  ParaLLEl-DC libretro core: Sega Dreamcast, Naomi, Naomi 2 and
	  Atomiswave emulation for RetroArch. Derived from Flycast by
	  flyinghead.

	  https://github.com/libretro/parallel-dc

comment "LIBRETRO_PARALLEL_DC needs a toolchain w/ C++, OpenMP and OpenGL ES or OpenGL"
	depends on !BR2_INSTALL_LIBSTDCPP || !BR2_GCC_ENABLE_OPENMP || \
	  (!BR2_PACKAGE_HAS_LIBGLES && !BR2_PACKAGE_HAS_LIBGL)
```

## package/batocera/emulators/retroarch/libretro/libretro-parallel-gx1/Config.in
```kconfig
config BR2_PACKAGE_LIBRETRO_PARALLEL_GX1
	bool "libretro-parallel-gx1"
	depends on BR2_INSTALL_LIBSTDCPP
	depends on BR2_TOOLCHAIN_HAS_THREADS

	help
	  ParaLLEl GX1: Nintendo GameCube and Wii (Dolphin based)
	  libretro core. Builds for x86_64 and aarch64 only.

	  https://github.com/libretro/parallel-gx1

comment "LIBRETRO_PARALLEL_GX1 needs a toolchain w/ C++ and threads"
	depends on !BR2_INSTALL_LIBSTDCPP || !BR2_TOOLCHAIN_HAS_THREADS
```

## package/batocera/emulators/retroarch/libretro/libretro-sameboy/Config.in
```kconfig
config BR2_PACKAGE_LIBRETRO_SAMEBOY
	bool "libretro-sameboy"
	select BR2_PACKAGE_RGBDS

	help
	  A libretro Sameboy is a Gameboy and Gameboy Colour emulator.

	  http://www.libretro.com
```

## package/batocera/emulators/retroarch/libretro/libretro-uzdoom/Config.in
```kconfig
config BR2_PACKAGE_LIBRETRO_UZDOOM
	bool "libretro-uzdoom"
	depends on BR2_INSTALL_LIBSTDCPP
	select BR2_PACKAGE_BZIP2
	select BR2_PACKAGE_HOST_PYTHON3
	select BR2_PACKAGE_LIBVPX
	select BR2_PACKAGE_OPENAL

	help
	  UZDoom libretro core, a 3D-accelerated Doom source port,
	  continuation of ZDoom and GZDoom.

	  A Doom IWAD (doom.wad, doom2.wad, freedoom...) is required.

	  https://github.com/cscd98/UZDoom-libretro
```

## package/batocera/emulators/retroarch/libretro/libretro-zcdi/Config.in
```kconfig
config BR2_PACKAGE_LIBRETRO_ZCDI
	bool "libretro-zcdi"
	depends on BR2_INSTALL_LIBSTDCPP

	help
	  zcdi, a Philips CD-i (Mono-I) emulator libretro core, with
	  support for the Digital Video Cartridge.

	  The cdi200.rom (NTSC) or cdi220b.rom (PAL) BIOS is required in
	  the system directory.

	  https://github.com/pastisme/zcdi

comment "LIBRETRO_ZCDI needs a toolchain w/ C++"
	depends on !BR2_INSTALL_LIBSTDCPP
```

## package/batocera/emulators/retroarch/retroarch/Config.in
```kconfig
config BR2_PACKAGE_RETROARCH
	bool "Retroarch"
	depends on (BR2_PACKAGE_HAS_LIBGLES || BR2_PACKAGE_HAS_LIBEGL || BR2_PACKAGE_HAS_LIBGL)
	depends on BR2_PACKAGE_BATOCERA_LAUNCH
	depends on BR2_PACKAGE_PYTHON_BATOCERA_COMMON
	select BR2_PACKAGE_BATOCERA_LAUNCH_LIBRETRO
	select BR2_PACKAGE_FLAC
	select BR2_PACKAGE_LIBRETRO_CORE_INFO
	select BR2_PACKAGE_NOTO_CJK_FONTS
	select BR2_PACKAGE_RETROARCH_ASSETS
	select BR2_PACKAGE_SLANG_SHADERS		if BR2_PACKAGE_VULKAN_LOADER && BR2_PACKAGE_VULKAN_HEADERS
	select dejavu

	help
	  A multi emulator frontend.

	  http://www.libretro.com

comment "Retroarch depends on EGL or OpenGLES"
	depends on !(BR2_PACKAGE_HAS_LIBEGL || BR2_PACKAGE_HAS_LIBGLES || BR2_PACKAGE_HAS_LIBGL)
```

## package/batocera/engines/vpinball/libspatialaudio/Config.in
```kconfig
config BR2_PACKAGE_LIBSPATIALAUDIO
	bool "libspatialaudio"

	help
	  Ambisonic encoding, decoding and binaural rendering library.

	  https://github.com/videolan/libspatialaudio
```

## package/batocera/engines/vpinball/libzedmd/Config.in
```kconfig
config BR2_PACKAGE_LIBZEDMD
	bool "libzedmd"
	select BR2_PACKAGE_CARGS
	select BR2_PACKAGE_LIBFRAMEUTIL
	select BR2_PACKAGE_LIBGPIOD2		if BR2_aarch64
	select BR2_PACKAGE_LIBSERIALPORT
	select BR2_PACKAGE_SOCKPP

	help
	  ZeDMD communication library.

	  https://github.com/PPUC/libzedmd
```

## package/batocera/hardware/gpicase/Config.in
```kconfig
config BR2_PACKAGE_GPICASE
	bool "gpicase"
	depends on BR2_PACKAGE_MESA3D

	help
	  Installation helper for the Retroflag GPi Case.

comment "gpicase"
	depends on BR2_PACKAGE_MESA3D
```

## package/batocera/libraries/asio/Config.in
```kconfig
config BR2_PACKAGE_ASIO
	bool "asio"
	select BR2_PACKAGE_NCURSES
	help
	  asio is a cross-platform C++ library for network and
	  low-level I/O programming that provides developers with
	  a consistent asynchronous model using a modern C++ approach.

	  https://sourceforge.net/projects/bvi
```

## package/batocera/libraries/libfyaml/Config.in
```kconfig
config BR2_PACKAGE_LIBFYAML
	bool "libfyaml"
	depends on BR2_TOOLCHAIN_HAS_THREADS

	help
	  Fully feature complete YAML parser and emitter

	  https://pantoniou.github.io/libfyaml/
```

## package/batocera/libraries/tomlplusplus/Config.in
```kconfig
config BR2_PACKAGE_TOMLPLUSPLUS
	bool "tomlplusplus"

	help
	  Header-only TOML config file parser and serialiser
	  for C++17.

	  https://github.com/marzer/tomlplusplus
```

## package/batocera/ports/cgenius/Config.in
```kconfig
config BR2_PACKAGE_CGENIUS
	bool "cgenius"
	select BR2_PACKAGE_BATOCERA_LAUNCH_CGENIUS
	select BR2_PACKAGE_BOOST
	select BR2_PACKAGE_PYTHON_CONFIGOBJ
	select BR2_PACKAGE_SDL3
	select BR2_PACKAGE_SDL3_IMAGE
	select BR2_PACKAGE_SDL3_MIXER
	select BR2_PACKAGE_SDL3_TTF
	select BR2_PACKAGE_XXD

	help
	  Commander Genius - Commander Keen Engine

	  https://github.com/gerstrong/Commander-Genius
```
