## unsupported/Config.in
```kconfig
menu "batocera.linux"

menu "System"
  menu "Boot"
    source "$BR2_EXTERNAL_BATOCERA_PATH/package/batocera/boot/rk3128-blobs/Config.in"
    source "$BR2_EXTERNAL_BATOCERA_PATH/package/batocera/boot/rocknix-abl/Config.in"
    source "$BR2_EXTERNAL_BATOCERA_PATH/package/batocera/boot/rockpro64-blobs/Config.in"
    source "$BR2_EXTERNAL_BATOCERA_PATH/package/batocera/boot/uboot-anbernic-rgxx3/Config.in"
    source "$BR2_EXTERNAL_BATOCERA_PATH/package/batocera/boot/uboot-bananapi-m7/Config.in"
    source "$BR2_EXTERNAL_BATOCERA_PATH/package/batocera/boot/uboot-evb-rk3399/Config.in"
    source "$BR2_EXTERNAL_BATOCERA_PATH/package/batocera/boot/uboot-firefly-station-m2/Config.in"
    source "$BR2_EXTERNAL_BATOCERA_PATH/package/batocera/boot/uboot-firefly-station-p2/Config.in"
    source "$BR2_EXTERNAL_BATOCERA_PATH/package/batocera/boot/uboot-hugsun-x99/Config.in"
    source "$BR2_EXTERNAL_BATOCERA_PATH/package/batocera/boot/uboot-multiboard/Config.in"
    source "$BR2_EXTERNAL_BATOCERA_PATH/package/batocera/boot/uboot-nanopi-m6/Config.in"
    source "$BR2_EXTERNAL_BATOCERA_PATH/package/batocera/boot/uboot-odroid-goa/Config.in"
    source "$BR2_EXTERNAL_BATOCERA_PATH/package/batocera/boot/uboot-odroid-m1/Config.in"
    source "$BR2_EXTERNAL_BATOCERA_PATH/package/batocera/boot/uboot-odroid-m1s/Config.in"
    source "$BR2_EXTERNAL_BATOCERA_PATH/package/batocera/boot/uboot-odroid-xu4/Config.in"
    source "$BR2_EXTERNAL_BATOCERA_PATH/package/batocera/boot/uboot-orangepi-3b/Config.in"
    source "$BR2_EXTERNAL_BATOCERA_PATH/package/batocera/boot/uboot-orangepi-4-lts/Config.in"
    source "$BR2_EXTERNAL_BATOCERA_PATH/package/batocera/boot/uboot-orangepi-4a/Config.in"
    source "$BR2_EXTERNAL_BATOCERA_PATH/package/batocera/boot/uboot-orangepi-5-max/Config.in"
    source "$BR2_EXTERNAL_BATOCERA_PATH/package/batocera/boot/uboot-orangepi-5-pro/Config.in"
    source "$BR2_EXTERNAL_BATOCERA_PATH/package/batocera/boot/uboot-orangepi-5-ultra/Config.in"
    source "$BR2_EXTERNAL_BATOCERA_PATH/package/batocera/boot/uboot-orangepi-5b/Config.in"
    source "$BR2_EXTERNAL_BATOCERA_PATH/package/batocera/boot/uboot-orangepi-800/Config.in"
    source "$BR2_EXTERNAL_BATOCERA_PATH/package/batocera/boot/uboot-powkiddy-a13/Config.in"
    source "$BR2_EXTERNAL_BATOCERA_PATH/package/batocera/boot/uboot-powkiddy-x55/Config.in"
    source "$BR2_EXTERNAL_BATOCERA_PATH/package/batocera/boot/uboot-ps5000/Config.in"
    source "$BR2_EXTERNAL_BATOCERA_PATH/package/batocera/boot/uboot-ps7000/Config.in"
    source "$BR2_EXTERNAL_BATOCERA_PATH/package/batocera/boot/uboot-radxa-zero-3/Config.in"
    source "$BR2_EXTERNAL_BATOCERA_PATH/package/batocera/boot/uboot-rk3326/Config.in"
    source "$BR2_EXTERNAL_BATOCERA_PATH/package/batocera/boot/uboot-rk356x/Config.in"
    source "$BR2_EXTERNAL_BATOCERA_PATH/package/batocera/boot/uboot-rk3588/Config.in"
    source "$BR2_EXTERNAL_BATOCERA_PATH/package/batocera/boot/uboot-rock-3a/Config.in"
    source "$BR2_EXTERNAL_BATOCERA_PATH/package/batocera/boot/uboot-rock-3c/Config.in"
    source "$BR2_EXTERNAL_BATOCERA_PATH/package/batocera/boot/uboot-vim1s/Config.in"
    source "$BR2_EXTERNAL_BATOCERA_PATH/package/batocera/boot/uboot-vim4/Config.in"
    source "$BR2_EXTERNAL_BATOCERA_PATH/package/batocera/boot/uboot-visionfive2/Config.in"
  endmenu

  menu "Firmwares"
    source "$BR2_EXTERNAL_BATOCERA_PATH/package/batocera/firmwares/extralinuxfirmwares/Config.in"
    source "$BR2_EXTERNAL_BATOCERA_PATH/package/batocera/firmwares/firmware-armbian/Config.in"
    source "$BR2_EXTERNAL_BATOCERA_PATH/package/batocera/firmwares/firmware-esp8089/Config.in"
    source "$BR2_EXTERNAL_BATOCERA_PATH/package/batocera/firmwares/firmware-khadas-vim4/Config.in"
    source "$BR2_EXTERNAL_BATOCERA_PATH/package/batocera/firmwares/firmware-orangepi/Config.in"
    source "$BR2_EXTERNAL_BATOCERA_PATH/package/batocera/firmwares/firmware-radxa-rkwifibt/Config.in"
    source "$BR2_EXTERNAL_BATOCERA_PATH/package/batocera/firmwares/firmware-rk3588/Config.in"
  endmenu

  menu "GPU"
    source "$BR2_EXTERNAL_BATOCERA_PATH/package/batocera/gpu/batocera-amd/Config.in"
    source "$BR2_EXTERNAL_BATOCERA_PATH/package/batocera/gpu/gl4es/Config.in"
    source "$BR2_EXTERNAL_BATOCERA_PATH/package/batocera/gpu/gtk-layer-shell/Config.in"
    source "$BR2_EXTERNAL_BATOCERA_PATH/package/batocera/gpu/nvidia/batocera-nvidia/Config.in"
    source "$BR2_EXTERNAL_BATOCERA_PATH/package/batocera/gpu/nvidia/nv-codec-headers/Config.in"
    source "$BR2_EXTERNAL_BATOCERA_PATH/package/batocera/gpu/nvidia/nvidia-open-driver/Config.in"
    source "$BR2_EXTERNAL_BATOCERA_PATH/package/batocera/gpu/nvidia/nvidia580-legacy-driver/Config.in"
    source "$BR2_EXTERNAL_BATOCERA_PATH/package/batocera/gpu/vulkan/glslang/Config.in"
    source "$BR2_EXTERNAL_BATOCERA_PATH/package/batocera/gpu/vulkan/shaderc/Config.in"
    source "$BR2_EXTERNAL_BATOCERA_PATH/package/batocera/gpu/vulkan/spirv-cross/Config.in"
    source "$BR2_EXTERNAL_BATOCERA_PATH/package/batocera/gpu/vulkan/stenzek-shaderc/Config.in"
    source "$BR2_EXTERNAL_BATOCERA_PATH/package/batocera/gpu/vulkan/vulkan-utility-libraries/Config.in"
    source "$BR2_EXTERNAL_BATOCERA_PATH/package/batocera/gpu/vulkan/vulkan-validationlayers/Config.in"
  endmenu

  menu "Network"
    source "$BR2_EXTERNAL_BATOCERA_PATH/package/batocera/network/aic8800/Config.in"
    source "$BR2_EXTERNAL_BATOCERA_PATH/package/batocera/network/qualcomm/pd-mapper/Config.in"
    source "$BR2_EXTERNAL_BATOCERA_PATH/package/batocera/network/qualcomm/qrtr/Config.in"
    source "$BR2_EXTERNAL_BATOCERA_PATH/package/batocera/network/qualcomm/rmtfs/Config.in"
    source "$BR2_EXTERNAL_BATOCERA_PATH/package/batocera/network/qualcomm/tqftpserv/Config.in"
  endmenu
endmenu
```
