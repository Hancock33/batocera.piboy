## configs/batocera-aarch32-subsystem_defconfig
```kconfig
# Target definition
BR2_arm=y
BR2_cortex_a72=y
BR2_ARM_ENABLE_NEON=y
BR2_ARM_ENABLE_VFP=y
BR2_ARM_FPU_VFPV3=y
BR2_PACKAGE_BATOCERA_TARGET_AARCH32_SUBSYSTEM=y
# Toolchain definition
BR2_BINUTILS_VERSION_2_38_X=y
BR2_BINUTILS_ENABLE_LTO=y
BR2_GCC_VERSION_12_X=y
BR2_GCC_ENABLE_GRAPHITE=y
BR2_GCC_ENABLE_LTO=y
BR2_OPTIMIZE_S=y
BR2_TARGET_OPTIMIZATION="-pipe"
BR2_SHARED_STATIC_LIBS=y
BR2_TOOLCHAIN_BUILDROOT_GLIBC=y
# required for utf-8
BR2_TOOLCHAIN_GLIBC_GCONV_LIBS_COPY=y
BR2_TOOLCHAIN_BUILDROOT_CXX=y
BR2_PACKAGE_UTIL_LINUX_LIBMOUNT=y
BR2_PACKAGE_UTIL_LINUX_LIBSMARTCOLS=y
BR2_ENABLE_LOCALE_WHITELIST="C ar ca cy_GB de el es es_MX eu_ES fr hu it ja_JP ko nb_NO nl nn_NO oc_FR.UTF-8 pl pt_PT pt_BR ru_RU uk_UA sv_SE tr zh_CN zh_TW"
BR2_GENERATE_LOCALE="en_US.UTF-8 ar_YE.UTF-8 ca_ES.UTF-8 cy_GB.UTF-8 de_DE.UTF-8 el_GR.UTF-8 es_ES.UTF-8 es_MX.UTF-8 eu_ES.UTF-8 fr_FR.UTF-8 hu_HU.UTF-8 it_IT.UTF-8 ja_JP.UTF-8 ko_KR.UTF-8 nb_NO.UTF-8 nl_NL.UTF-8 nn_NO.UTF-8 oc_FR.UTF-8 pl_PL.UTF-8 pt_BR.UTF-8 pt_PT.UTF-8 ru_RU.UTF-8 uk_UA.UTF-8 sv_SE.UTF-8 tr_TR.UTF-8 zh_CN.UTF-8 zh_TW.UTF-8"
BR2_GLOBAL_PATCH_DIR="$(BR2_EXTERNAL_BATOCERA_PATH)/board/batocera/patches"
BR2_TARGET_TZ_INFO=y

# Linux headers same as kernel, a 5.18 series
BR2_PACKAGE_HOST_LINUX_HEADERS_CUSTOM_5_18=y

# Kernel
BR2_LINUX_KERNEL=n
BR2_LINUX_KERNEL_CUSTOM_TARBALL=y
BR2_LINUX_KERNEL_CUSTOM_TARBALL_LOCATION="$(call github,raspberrypi,linux,7838840b5606a2051b31da4c598466df7b1c3005)/7838840b5606a2051b31da4c598466df7b1c3005.tar.gz"
BR2_LINUX_KERNEL_DEFCONFIG="bcm2711"
BR2_LINUX_KERNEL_PATCH="$(BR2_EXTERNAL_BATOCERA_PATH)/board/batocera/raspberrypi/linux_patches"
BR2_LINUX_KERNEL_CONFIG_FRAGMENT_FILES="$(BR2_EXTERNAL_BATOCERA_PATH)/board/batocera/raspberrypi/linux-defconfig-fragment.config"
BR2_LINUX_KERNEL_NEEDS_HOST_OPENSSL=y

# BR2_TARGET_ROOTFS_TAR is not set
BR2_ROOTFS_DEVICE_CREATION_DYNAMIC_EUDEV=y

# (Fake) system as we only build 32-bit ARM subsystem
BR2_PACKAGE_BATOCERA_RPI_MESA3D=y
BR2_PACKAGE_BATOCERA_SBC_XORG=y
BR2_PACKAGE_BATOCERA_XORG=y
BR2_PACKAGE_BATOCERA_VULKAN=y
BR2_PACKAGE_MESA3D_VULKAN_DRIVER_BROADCOM=y

# Batocera system
BR2_PACKAGE_BATOCERA_SYSTEM=n
BR2_PACKAGE_BATOCERA_EXTRAS=n
BR2_PACKAGE_BATOCERA_TOOLS=n
BR2_PACKAGE_BATOCERA_ALL_SYSTEMS=n
BR2_PACKAGE_BATOCERA_LINUX_FIRMWARES=n
BR2_PACKAGE_BATOCERA_RPI_ANY=y
BR2_PACKAGE_BUSYBOX_SHOW_OTHERS=y

#audio
BR2_PACKAGE_ALSA_LIB=y
BR2_PACKAGE_ALSA_UTILS=y
BR2_PACKAGE_FLAC=y
BR2_PACKAGE_LIBMODPLUG=y
BR2_PACKAGE_LIBOGG=y
BR2_PACKAGE_LIBSNDFILE=y
BR2_PACKAGE_LIBVORBIS=y
BR2_PACKAGE_MPG123=y
BR2_PACKAGE_OPENAL=y
BR2_PACKAGE_OPUS=y
BR2_PACKAGE_OPUSFILE=y
BR2_PACKAGE_PIPEWIRE=y
BR2_PACKAGE_PULSEAUDIO=y
BR2_PACKAGE_PULSEAUDIO_UTILS=y
BR2_PACKAGE_SDL2_MIXER=y

#compress
BR2_PACKAGE_BZIP2=y
BR2_PACKAGE_LIBZIP=y
BR2_PACKAGE_ZLIB=y
BR2_PACKAGE_ZSTD=y

#devel
BR2_PACKAGE_GMP=y
BR2_PACKAGE_LIBCAP=y
BR2_PACKAGE_LIBFFI=y
BR2_PACKAGE_LIBFRIBIDI=y
BR2_PACKAGE_LIBGLIB2=y
BR2_PACKAGE_LIBTOOL=y
BR2_PACKAGE_PCRE=y

#emulators
BR2_PACKAGE_BENNUGD_BGDC=y
BR2_PACKAGE_BENNUGD_BGDI=y
BR2_PACKAGE_BOX86=y
BR2_PACKAGE_DROIDPORTS=y

#graphics
BR2_PACKAGE_CAIRO=y
BR2_PACKAGE_FREETYPE=y
BR2_PACKAGE_HARFBUZZ=y
BR2_PACKAGE_LIBDRM=y
BR2_PACKAGE_LIBPNG=y
BR2_PACKAGE_SDL2_IMAGE=y

#multimedia
BR2_PACKAGE_FFMPEG=y
BR2_PACKAGE_LIBASS=y
BR2_PACKAGE_SDL2=y

#security
BR2_PACKAGE_GNUTLS=y
BR2_PACKAGE_NETTLE=y
BR2_PACKAGE_OPENSSL=y
#sysutils
BR2_PACKAGE_DBUS=y
BR2_PACKAGE_LIBEVDEV=y
BR2_PACKAGE_LIBUSB=y

#textproc
BR2_PACKAGE_EXPAT=y
BR2_PACKAGE_LIBIDN2=y
BR2_PACKAGE_LIBTRE=y
BR2_PACKAGE_LIBXML2=y

#x11
BR2_PACKAGE_FONTCONFIG=y
BR2_PACKAGE_LIBPCIACCESS=y
BR2_PACKAGE_PIXMAN=y
BR2_PACKAGE_XUTIL_UTIL_MACROS=y


# Enables ccache
BR2_CCACHE=y
```

## package/batocera/audio/cubeb/Config.in
```kconfig
config BR2_PACKAGE_CUBEB
	bool "cubeb"
	select BR2_PACKAGE_ALSA_LIB
	select BR2_PACKAGE_JACK2
	select BR2_PACKAGE_PULSEAUDIO
	select BR2_PACKAGE_SPEEX

	help
	  Cross platform audio library
```

## package/batocera/audio/libaltsound/Config.in
```kconfig
config BR2_PACKAGE_LIBALTSOUND
	bool "libaltsound"

	help
	  A cross platform compilation of altsound that is baked directly into VPinMAME.

		https://github.com/jsm174/libaltsound.git
```

## package/batocera/audio/libopenmpt/Config.in
```kconfig
config BR2_PACKAGE_LIBOPENMPT
	bool "libopenmpt"
	select BR2_PACKAGE_HOST_DOXYGEN
	select BR2_PACKAGE_ZLIB
	select BR2_PACKAGE_MPG123

	help
	  libopenmpt is a cross-platform C++ and C module playback library.
	  It is based on the player code of the Open ModPlug Tracker project.
	  It offers high-quality module playback on a variety of platforms.

	  https://lib.openmpt.org/libopenmpt/
```

## package/batocera/audio/portmidi/Config.in
```kconfig
config BR2_PACKAGE_PORTMIDI
	bool "portmidi"
	select BR2_PACKAGE_ALSA_LIB

	help
	  Cross platform library for interfacing with OS MIDI I/O APIs

	  https://github.com/portmidi/portmidi
```

## package/batocera/boot/uboot-anbernic-rgxx3/Config.in
```kconfig
config BR2_PACKAGE_UBOOT_ANBERNIC_RGXX3
	bool "U-Boot for Anbernic RG353 / RG503 family"
	select BR2_PACKAGE_HOST_DTC

	help
	  U-Boot for the Anbernic RGxx3 devices & Powkiddy clones.

	  https://u-boot.org/
```

## package/batocera/boot/uboot-odroid-goa/Config.in
```kconfig
config BR2_PACKAGE_UBOOT_ODROID_GOA
	bool "uboot files for odroidgoa"
	select BR2_TOOLCHAIN_EXTERNAL_LINARO_AARCH64

	help
	  uboot files for odroidgoa
```

## package/batocera/controllers/pads/joycond/Config.in
```kconfig
config BR2_PACKAGE_JOYCOND
	bool "joycond"
	select BR2_PACKAGE_ACL
	select BR2_PACKAGE_HAS_UDEV
	select BR2_PACKAGE_LIBEVDEV

	help
	  Joycond is a linux daemon which uses the evdev devices
	  provided by hid-nintendo to implement joycon pairing.

	  https://github.com/DanielOgorchock/joycond
```

## package/batocera/controllers/pads/sdl2-gamecontrollerdb/Config.in
```kconfig
config BR2_PACKAGE_SDL2_GAMECONTROLLERDB
	bool "sdl2-gamecontrollerdb"
	select BR2_PACKAGE_SDL2

	help
	  Kernel module to support hardware from piboy (experimental pi)
```

## package/batocera/controllers/pads/xpi_gamecon_rpi/Config.in
```kconfig
config BR2_PACKAGE_XPI_GAMECON_RPI
	bool "xpi_gamecon_rpi"
	select BR2_PACKAGE_BATOCERA_ES_PIBOY
	depends on BR2_LINUX_KERNEL

	help
	  Kernel module to support hardware from piboy (experimental pi)

comment "xpi_gamecon_rpi needs a kernel and headers"
	depends on !BR2_LINUX_KERNEL
```

## package/batocera/controllers/xpi_gamecon_rpi/Config.in
```kconfig
config BR2_PACKAGE_XPI_GAMECON_RPI
	bool "xpi_gamecon_rpi"
	depends on BR2_LINUX_KERNEL
	depends on BR2_PACKAGE_PULSEAUDIO_UTILS
	help
	  Kernel module to support hardware from piboy (experimental pi)

comment "xpi_gamecon_rpi needs a kernel and headers"
	depends on !BR2_LINUX_KERNEL
```

## package/batocera/controllers/xpi_gamecon_rpi4/Config.in
```kconfig
config BR2_PACKAGE_XPI_GAMECON_RPI4
	bool "xpi_gamecon_rpi4"
	depends on BR2_LINUX_KERNEL
	depends on BR2_PACKAGE_PULSEAUDIO_UTILS
	help
	  Kernel module to support hardware from piboy (experimental pi)

comment "xpi_gamecon_rpi needs a kernel and headers"
	depends on !BR2_LINUX_KERNEL
```

## package/batocera/core/batocera-audio-alsa/Config.in
```kconfig
config BR2_PACKAGE_BATOCERA_AUDIO_ALSA
	bool "batocera-audio"
	select BR2_PACKAGE_ALSA_PLUGINS
	select BR2_PACKAGE_ALSA_UTILS
	select BR2_PACKAGE_ALSA_UTILS_AMIXER
	select BR2_PACKAGE_ALSA_UTILS_APLAY
	select BR2_PACKAGE_BLUEZ_ALSA

	help
	  Audio support and scripts for batocera.linux (ALSA)
```

## package/batocera/core/batocera-configgen/Config.in
```kconfig
config BR2_PACKAGE_BATOCERA_CONFIGGEN
	bool "batocera configgen"
	select BR2_PACKAGE_MANGOHUD            if (BR2_PACKAGE_BATOCERA_WAYLAND || BR2_PACKAGE_XORG7 || BR2_PACKAGE_LIBDRM) && !BR2_PACKAGE_BATOCERA_TARGET_S905
	select BR2_PACKAGE_PYTHON_CONFIGOBJ
	select BR2_PACKAGE_FFMPEG_PYTHON
	select BR2_PACKAGE_PYTHON_PILLOW
	select BR2_PACKAGE_PYTHON_QRCODE       # for retroachievement urls
	select BR2_PACKAGE_PYTHON_PSUTIL
	select BR2_PACKAGE_PYTHON_PYUDEV       # for guns
	select BR2_PACKAGE_PYTHON_PYYAML
	select BR2_PACKAGE_PYTHON_REQUESTS
	select BR2_PACKAGE_PYTHON_RUAMEL_YAML
	select BR2_PACKAGE_PYSDL2
	select BR2_PACKAGE_PYTHON_TOML

	help
	  This is Batoceras configuration utility.

	  The purpose of this utility is to automatically configure
	  emulators using the environment variables provided by Batocera.
	  Its main entry point is emulatorlauncher.py, which accepts 13
	  parameters describing the system and the configuration of up to
	  four controllers.
```

## package/batocera/core/batocera-desktopapps/Config.in
```kconfig
config BR2_PACKAGE_BATOCERA_DESKTOPAPPS
	bool "batocera-desktopapps"
	depends on BR2_PACKAGE_XORG7
	depends on BR2_PACKAGE_PCMANFM     # file manager
	select BR2_PACKAGE_YAD             if BR2_PACKAGE_BATOCERA_WINE

	help
	  Batocera desktop applications
```

## package/batocera/core/batocera-image/Config.in
```kconfig
config BR2_PACKAGE_BATOCERA_IMAGE
	bool "batocera-image"
	select BR2_PACKAGE_HOST_GENEXT2FS
	select BR2_PACKAGE_HOST_GENIMAGE

	help
	  Utilities needed to build Batocera.linux images
```

## package/batocera/core/batocera-scripts/Config.in
```kconfig
config BR2_PACKAGE_BATOCERA_SCRIPTS
	bool "batocera-scripts"
	select BR2_PACKAGE_BASH
	select BR2_PACKAGE_DBUS_PYTHON       # required for bluetooth scripts
	select BR2_PACKAGE_JQ                # for vulkan parsing
	select BR2_PACKAGE_PCIUTILS
	select BR2_PACKAGE_PYTHON_GOBJECT    # for bluetooth agent
	select BR2_PACKAGE_PYTHON3

	help
	  Batocera scripts
```

## package/batocera/desktop/kwindowsystem/Config.in
```kconfig
config BR2_PACKAGE_KWINDOWSYSTEM
	bool "kwindowsystem"
	select BR2_PACKAGE_BATOCERA_QT6
	select BR2_PACKAGE_ECM

	help
	  KWindowSystem provides information about the windowing system
	  and allows interaction with the windowing system.

	  https://community.kde.org/Frameworks
```

## package/batocera/desktop/layershellqt/Config.in
```kconfig
config BR2_PACKAGE_LAYERSHELLQT
	bool "layershellqt"
	select BR2_PACKAGE_BATOCERA_QT6
	select BR2_PACKAGE_ECM
	select BR2_PACKAGE_KWINDOWSYSTEM

	help
	  Qt component to allow applications to make use of the
	  Wayland wl-layer-shell protocol.

	  https://community.kde.org/Frameworks
```

## package/batocera/desktop/libdbusmenu/Config.in
```kconfig
config BR2_PACKAGE_LIBDBUSMENU
	bool "libdbusmenu"
	select BR2_PACKAGE_BATOCERA_QT6
	select BR2_PACKAGE_LIBLXQT

	help
	  This library provides a Qt implementation of the
	  DBusMenu protocol.

	  https://lxqt-project.org/
```

## package/batocera/desktop/libfmqt6/Config.in
```kconfig
config BR2_PACKAGE_LIBFMQT6
	bool "libfmqt6"
	select BR2_PACKAGE_BATOCERA_QT6
	select BR2_PACKAGE_LIBEXIF
	select BR2_PACKAGE_LIBLXQT
	select BR2_PACKAGE_LXQTMENUDATA

	help
	  Core library of PCManFM-Qt (Qt binding for libfm)

	  https://lxqt-project.org/
```

## package/batocera/desktop/liblxqt/Config.in
```kconfig
config BR2_PACKAGE_LIBLXQT
	bool "liblxqt"
	select BR2_PACKAGE_BATOCERA_QT6
	select BR2_PACKAGE_QTXDG_TOOLS
	select BR2_PACKAGE_KWINDOWSYSTEM
	select BR2_PACKAGE_POLKITQT

	help
	  Core utility library for all LXQt components

	  https://lxqt-project.org/
```

## package/batocera/desktop/libqtxdg/Config.in
```kconfig
config BR2_PACKAGE_LIBQTXDG
	bool "libqtxdg"
	select BR2_PACKAGE_BATOCERA_QT6
	select BR2_PACKAGE_LIBXKBCOMMON

	help
	  libqtxdg user tools

	  https://lxqt-project.org/
```

## package/batocera/desktop/libsysstat/Config.in
```kconfig
config BR2_PACKAGE_LIBSYSSTAT
	bool "libsysstat"
	select BR2_PACKAGE_BATOCERA_QT6
	select BR2_PACKAGE_LIBLXQT

	help
	  Library used to query system info and statistics

	  https://lxqt-project.org/
```
